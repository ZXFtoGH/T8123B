// SPDX-License-Identifier: GPL-2.0
/*
 * Copyright (c) 2021 MediaTek Inc.
 * Author: Wy Chuang<wy.chuang@mediatek.com>
 *
 */

&mtk_gauge {
	DIFFERENCE_FULLOCV_ITH = <(200)>;
	/* Charging termination current */
	SHUTDOWN_1_TIME = <(5)>;
	/* If ui_soc shows 1% more than X minites, system will shutdown */
	KEEP_100_PERCENT = <(1)>;
	R_FG_VALUE = <(5)>;
	/* R_sense resistance */
	EMBEDDED_SEL = <(0)>;
	/* Configures whether using embedded battery or not */
	PMIC_SHUTDOWN_CURRENT = <(20)>;
	/* System shutdown current */
	FG_METER_RESISTANCE = <(70)>;
	/* The resistance of PCB */
	CAR_TUNE_VALUE = <(101)>;
	/* Tune value for current measurement */
	PMIC_MIN_VOL = <(33500)>;
	/* vboot voltage for gauge 0%*/
	POWERON_SYSTEM_IBOOT = <(500)>;
	/* power on system iboot */
	SHUTDOWN_GAUGE0_VOLTAGE = <(34000)>;
	/* shutdown gauge 0% voltage */
	TEMPERATURE_T0 = <(50)>;
	/* Battery temperature T0 */
	TEMPERATURE_T1 = <(25)>;
	/* Battery temperature T1 */
	TEMPERATURE_T2 = <(10)>;
	/* Battery temperature T2 */
	TEMPERATURE_T3 = <(0)>;
	/* Battery temperature T3 */
	TEMPERATURE_T4 = <(-10)>;
	/* Battery temperature T4 */
	g_FG_PSEUDO100_T0 = <(100)>;
	/* Pseudo 100% percentage at T0 */
	g_FG_PSEUDO100_T1 = <(100)>;
	/* Pseudo 100% percentage at T1 */
	g_FG_PSEUDO100_T2 = <(100)>;
	/* Pseudo 100% percentage at T2 */
	g_FG_PSEUDO100_T3 = <(100)>;
	/* Pseudo 100% percentage at T3 */
	g_FG_PSEUDO100_T4 = <(100)>;
	/* Pseudo 100% percentage at T4 */
	Q_MAX_SYS_VOLTAGE_BAT0 = <(3350)>;
	/* Pseudo1 for hide percentage */
	Q_MAX_SYS_VOLTAGE_BAT1 = <(3350)>;
	/* Pseudo1 for hide percentage */
	Q_MAX_SYS_VOLTAGE_BAT2 = <(3350)>;
	/* Pseudo1 for hide percentage */
	Q_MAX_SYS_VOLTAGE_BAT3 = <(3350)>;
	/* Pseudo1 for hide percentage */
	COM_FG_METER_RESISTANCE = <(100)>;
	/* compensate The resistance of PCB */
	COM_R_FG_VALUE = <(0)>;
	/* compensate R_sense resistance */
	enable_tmp_intr_suspend = <(0)>;
	/* Enable update temp when suspend */
	ACTIVE_TABLE = <(5)>;
	/* Table numbers per battery */
	MULTI_TEMP_GAUGE0 = <(1)>;
	/* Multi gauge0 enable */
	RBAT_PULL_UP_VOLT = <(2800)>;


/* mt6789_battery_prop_dim2_ext.dtsi  start */

	/*vboot voltage for gauge 0%*/
	g_PMIC_MIN_VOL_row = <4>;
	g_PMIC_MIN_VOL_col = <10>;
	g_PMIC_MIN_VOL =
	<
		33500  33500  33500  33500
		33000  33000  33000  33000
		33000  33000  33000  33000
		32200  32200  32200  32200
		31000  31000  31000  31000
		31500  31500  31500  31500
		31000  31000  31000  31000
		31000  31000  31000  31000
		31000  31000  31000  31000
		31000  31000  31000  31200
	>;
	/*boot_up current for gauge 0%*/
	g_PON_SYS_IBOOT_row = <4>;
	g_PON_SYS_IBOOT_col = <10>;
	g_PON_SYS_IBOOT =
	<
		5000  5000  5000  5000
		5000  5000  5000  5000
		5000  5000  5000  5000
		5000  5000  5000  5000
		5000  5000  5000  5000
		5000  5000  5000  5000
		5000  5000  5000  5000
		5000  5000  5000  5000
		5000  5000  5000  5000
		5000  5000  5000  5000
	>;
	/*Pseudo1 hide percentage*/
	g_QMAX_SYS_VOL_row = <4>;
	g_QMAX_SYS_VOL_col = <10>;
	g_QMAX_SYS_VOL =
	<
		34950  34950  34950  34950
		34950  34950  34950  34950
		34250  34250  34250  34250
		34250  34250  34250  34250
		34250  34250  34250  34250
		32500  32500  32500  32500
		32800  32800  32800  32800
		32800  32800  32800  32800
		32800  32800  32800  32800
		32800  32800  32800  32800
	>;
	/*Pseudo100 percentage setting*/
	g_FG_PSEUDO100_row = <4>;
	g_FG_PSEUDO100_col = <10>;
	g_FG_PSEUDO100 =
	<
		100  100  100  100
		100  100  100  100
		100  100  100  100
		100  100  100  100
		100  100  100  100
		100  100  100  100
		100  100  100  100
		100  100  100  100
		100  100  100  100
		100  100  100  100
	>;

	/* charge_r  pseudo100 setting*/
	g_FG_charge_PSEUDO100_row = <4>;
	g_FG_charge_PSEUDO100_col = <10>;
	g_FG_charge_PSEUDO100 =
	<
		100   100  100  100
		100   100  100  100
		100   100  100  100
		100   100  100  100
		100   100  100  100
		100   100  100  100
		100   100  100  100
		100   100  100  100
		100   100  100  100
		100   100  100  100
	>;
/* mt6789_battery_prop_dim2_ext.dtsi  end */

/* mt6789_battery_table.dtsi start */

battery0_profile_t0_num = <100>;
battery0_profile_t0_col = <3>;
battery0_profile_t0 =
<
0       43500   600
803     43162   600
1606    43025   575
2409    42913   575
3212    42796   554
4015    42678   550
4818    42559   534
5621    42443   531
6424    42331   550
7227    42218   550
8030    42106   550
8833    41993   550
9636    41871   550
10439   41758   528
11242   41646   538
12045   41544   573
12848   41431   550
13652   41319   550
14455   41215   573
15258   41104   550
16061   40993   553
16864   40889   557
17667   40780   550
18470   40674   573
19273   40567   564
20076   40471   571
20879   40375   550
21682   40305   575
22485   40251   623
23288   40150   654
24091   40004   675
24894   39859   655
25697   39718   640
26500   39600   600
27303   39510   560
28106   39454   575
28909   39414   595
29712   39363   661
30515   39278   674
31318   39188   682
32121   39093   694
32924   38981   675
33727   38844   577
34530   38716   498
35333   38620   458
36136   38536   418
36939   38465   422
37742   38395   387
38545   38337   400
39348   38282   383
40152   38228   392
40955   38173   375
41758   38125   375
42561   38076   375
43364   38028   375
44167   37973   358
44970   37932   375
45773   37894   386
46576   37847   375
47379   37815   394
48182   37773   375
48985   37741   399
49788   37698   375
50591   37666   375
51394   37634   375
52197   37602   375
53000   37570   375
53803   37548   400
54606   37516   400
55409   37484   380
56212   37452   375
57015   37409   375
57818   37371   375
58621   37325   350
59424   37293   350
60227   37251   350
61030   37218   373
61833   37170   350
62636   37135   350
63439   37111   372
64242   37075   375
65045   37047   425
65848   36999   442
66652   36928   425
67455   36864   402
68258   36819   450
69061   36764   475
69864   36684   475
70667   36610   433
71470   36571   377
72273   36565   400
73076   36550   404
73879   36535   406
74682   36526   459
75485   36501   475
76288   36457   636
77091   36304   952
77894   35935   1173
78697   35446   1414
79500   34830   1850
>;
battery0_profile_t1_num = <100>;
battery0_profile_t1_col = <3>;
battery0_profile_t1 =
<
0       43500   600
803     43162   600
1606    43025   575
2409    42913   575
3212    42796   554
4015    42678   550
4818    42559   534
5621    42443   531
6424    42331   550
7227    42218   550
8030    42106   550
8833    41993   550
9636    41871   550
10439   41758   528
11242   41646   538
12045   41544   573
12848   41431   550
13652   41319   550
14455   41215   573
15258   41104   550
16061   40993   553
16864   40889   557
17667   40780   550
18470   40674   573
19273   40567   564
20076   40471   571
20879   40375   550
21682   40305   575
22485   40251   623
23288   40150   654
24091   40004   675
24894   39859   655
25697   39718   640
26500   39600   600
27303   39510   560
28106   39454   575
28909   39414   595
29712   39363   661
30515   39278   674
31318   39188   682
32121   39093   694
32924   38981   675
33727   38844   577
34530   38716   498
35333   38620   458
36136   38536   418
36939   38465   422
37742   38395   387
38545   38337   400
39348   38282   383
40152   38228   392
40955   38173   375
41758   38125   375
42561   38076   375
43364   38028   375
44167   37973   358
44970   37932   375
45773   37894   386
46576   37847   375
47379   37815   394
48182   37773   375
48985   37741   399
49788   37698   375
50591   37666   375
51394   37634   375
52197   37602   375
53000   37570   375
53803   37548   400
54606   37516   400
55409   37484   380
56212   37452   375
57015   37409   375
57818   37371   375
58621   37325   350
59424   37293   350
60227   37251   350
61030   37218   373
61833   37170   350
62636   37135   350
63439   37111   372
64242   37075   375
65045   37047   425
65848   36999   442
66652   36928   425
67455   36864   402
68258   36819   450
69061   36764   475
69864   36684   475
70667   36610   433
71470   36571   377
72273   36565   400
73076   36550   404
73879   36535   406
74682   36526   459
75485   36501   475
76288   36457   636
77091   36304   952
77894   35935   1173
78697   35446   1414
79500   34830   1850
>;
battery0_profile_t2_num = <100>;
battery0_profile_t2_col = <3>;
battery0_profile_t2 =
<
0       43500   600
803     43162   600
1606    43025   575
2409    42913   575
3212    42796   554
4015    42678   550
4818    42559   534
5621    42443   531
6424    42331   550
7227    42218   550
8030    42106   550
8833    41993   550
9636    41871   550
10439   41758   528
11242   41646   538
12045   41544   573
12848   41431   550
13652   41319   550
14455   41215   573
15258   41104   550
16061   40993   553
16864   40889   557
17667   40780   550
18470   40674   573
19273   40567   564
20076   40471   571
20879   40375   550
21682   40305   575
22485   40251   623
23288   40150   654
24091   40004   675
24894   39859   655
25697   39718   640
26500   39600   600
27303   39510   560
28106   39454   575
28909   39414   595
29712   39363   661
30515   39278   674
31318   39188   682
32121   39093   694
32924   38981   675
33727   38844   577
34530   38716   498
35333   38620   458
36136   38536   418
36939   38465   422
37742   38395   387
38545   38337   400
39348   38282   383
40152   38228   392
40955   38173   375
41758   38125   375
42561   38076   375
43364   38028   375
44167   37973   358
44970   37932   375
45773   37894   386
46576   37847   375
47379   37815   394
48182   37773   375
48985   37741   399
49788   37698   375
50591   37666   375
51394   37634   375
52197   37602   375
53000   37570   375
53803   37548   400
54606   37516   400
55409   37484   380
56212   37452   375
57015   37409   375
57818   37371   375
58621   37325   350
59424   37293   350
60227   37251   350
61030   37218   373
61833   37170   350
62636   37135   350
63439   37111   372
64242   37075   375
65045   37047   425
65848   36999   442
66652   36928   425
67455   36864   402
68258   36819   450
69061   36764   475
69864   36684   475
70667   36610   433
71470   36571   377
72273   36565   400
73076   36550   404
73879   36535   406
74682   36526   459
75485   36501   475
76288   36457   636
77091   36304   952
77894   35935   1173
78697   35446   1414
79500   34830   1850
>;
battery0_profile_t3_num = <100>;
battery0_profile_t3_col = <3>;
battery0_profile_t3 =
<
0       43500   600
803     43162   600
1606    43025   575
2409    42913   575
3212    42796   554
4015    42678   550
4818    42559   534
5621    42443   531
6424    42331   550
7227    42218   550
8030    42106   550
8833    41993   550
9636    41871   550
10439   41758   528
11242   41646   538
12045   41544   573
12848   41431   550
13652   41319   550
14455   41215   573
15258   41104   550
16061   40993   553
16864   40889   557
17667   40780   550
18470   40674   573
19273   40567   564
20076   40471   571
20879   40375   550
21682   40305   575
22485   40251   623
23288   40150   654
24091   40004   675
24894   39859   655
25697   39718   640
26500   39600   600
27303   39510   560
28106   39454   575
28909   39414   595
29712   39363   661
30515   39278   674
31318   39188   682
32121   39093   694
32924   38981   675
33727   38844   577
34530   38716   498
35333   38620   458
36136   38536   418
36939   38465   422
37742   38395   387
38545   38337   400
39348   38282   383
40152   38228   392
40955   38173   375
41758   38125   375
42561   38076   375
43364   38028   375
44167   37973   358
44970   37932   375
45773   37894   386
46576   37847   375
47379   37815   394
48182   37773   375
48985   37741   399
49788   37698   375
50591   37666   375
51394   37634   375
52197   37602   375
53000   37570   375
53803   37548   400
54606   37516   400
55409   37484   380
56212   37452   375
57015   37409   375
57818   37371   375
58621   37325   350
59424   37293   350
60227   37251   350
61030   37218   373
61833   37170   350
62636   37135   350
63439   37111   372
64242   37075   375
65045   37047   425
65848   36999   442
66652   36928   425
67455   36864   402
68258   36819   450
69061   36764   475
69864   36684   475
70667   36610   433
71470   36571   377
72273   36565   400
73076   36550   404
73879   36535   406
74682   36526   459
75485   36501   475
76288   36457   636
77091   36304   952
77894   35935   1173
78697   35446   1414
79500   34830   1850
>;
battery0_profile_t4_num = <100>;
battery0_profile_t4_col = <3>;
battery0_profile_t4 =
<
0       43500   600
803     43162   600
1606    43025   575
2409    42913   575
3212    42796   554
4015    42678   550
4818    42559   534
5621    42443   531
6424    42331   550
7227    42218   550
8030    42106   550
8833    41993   550
9636    41871   550
10439   41758   528
11242   41646   538
12045   41544   573
12848   41431   550
13652   41319   550
14455   41215   573
15258   41104   550
16061   40993   553
16864   40889   557
17667   40780   550
18470   40674   573
19273   40567   564
20076   40471   571
20879   40375   550
21682   40305   575
22485   40251   623
23288   40150   654
24091   40004   675
24894   39859   655
25697   39718   640
26500   39600   600
27303   39510   560
28106   39454   575
28909   39414   595
29712   39363   661
30515   39278   674
31318   39188   682
32121   39093   694
32924   38981   675
33727   38844   577
34530   38716   498
35333   38620   458
36136   38536   418
36939   38465   422
37742   38395   387
38545   38337   400
39348   38282   383
40152   38228   392
40955   38173   375
41758   38125   375
42561   38076   375
43364   38028   375
44167   37973   358
44970   37932   375
45773   37894   386
46576   37847   375
47379   37815   394
48182   37773   375
48985   37741   399
49788   37698   375
50591   37666   375
51394   37634   375
52197   37602   375
53000   37570   375
53803   37548   400
54606   37516   400
55409   37484   380
56212   37452   375
57015   37409   375
57818   37371   375
58621   37325   350
59424   37293   350
60227   37251   350
61030   37218   373
61833   37170   350
62636   37135   350
63439   37111   372
64242   37075   375
65045   37047   425
65848   36999   442
66652   36928   425
67455   36864   402
68258   36819   450
69061   36764   475
69864   36684   475
70667   36610   433
71470   36571   377
72273   36565   400
73076   36550   404
73879   36535   406
74682   36526   459
75485   36501   475
76288   36457   636
77091   36304   952
77894   35935   1173
78697   35446   1414
79500   34830   1850
>;

/* mt6789_battery_table.dtsi end */
};
