// SPDX-License-Identifier: GPL-2.0+
/*
 * Copyright (c) 2022 MediaTek Inc.
 *
 */
&mtk_gauge {
	DIFFERENCE_FULLOCV_ITH = <(400)>;
/*	Charging termination current*/
	SHUTDOWN_1_TIME = <(30)>;
/*	If ui_soc shows 1% more than X minites, system will shutdown*/
	KEEP_100_PERCENT = <(5)>;
/*	The ui_soc will keep 100% until SOC drop X percents after unplugged*/
	R_FG_VALUE = <(5)>;
/*	R_sense resistance*/
	EMBEDDED_SEL = <(0)>;
/*	Configures whether using embedded battery or not*/
	PMIC_SHUTDOWN_CURRENT = <(20)>;
/*	System shutdown current*/
	FG_METER_RESISTANCE = <(100)>;
/*	The resistance of PCB*/
	CAR_TUNE_VALUE = <(100)>;
/*	Tune value for current measurement*/
	PMIC_MIN_VOL = <(33500)>;
/*	vboot voltage for gauge 0%*/
	POWERON_SYSTEM_IBOOT = <(500)>;
/*	power on system iboot*/
	SHUTDOWN_GAUGE0_VOLTAGE = <(34000)>;
/*	shutdown gauge 0% voltage*/
	TEMPERATURE_T0 = <(50)>;
/*	Battery temperature T0*/
	TEMPERATURE_T1 = <(25)>;
/*	Battery temperature T1*/
	TEMPERATURE_T2 = <(10)>;
/*	Battery temperature T2*/
	TEMPERATURE_T3 = <(0)>;
/*	Battery temperature T3*/
	TEMPERATURE_T4 = <(-6)>;
/*	Battery temperature T4*/
	TEMPERATURE_T5 = <(-10)>;
/*	Battery temperature T5*/
	g_FG_PSEUDO100_T0 = <(100)>;
/*	Pseudo 100% percentage at T0*/
	g_FG_PSEUDO100_T1 = <(100)>;
/*	Pseudo 100% percentage at T1*/
	g_FG_PSEUDO100_T2 = <(100)>;
/*	Pseudo 100% percentage at T2*/
	g_FG_PSEUDO100_T3 = <(100)>;
/*	Pseudo 100% percentage at T3*/
	g_FG_PSEUDO100_T4 = <(100)>;
/*	Pseudo 100% percentage at T4*/
	Q_MAX_SYS_VOLTAGE_BAT0 = <(3350)>;
/*	Pseudo1 for hide percentage*/
	Q_MAX_SYS_VOLTAGE_BAT1 = <(3350)>;
/*	Pseudo1 for hide percentage*/
	Q_MAX_SYS_VOLTAGE_BAT2 = <(3350)>;
/*	Pseudo1 for hide percentage*/
	Q_MAX_SYS_VOLTAGE_BAT3 = <(3350)>;
/*	Pseudo1 for hide percentage*/
	COM_FG_METER_RESISTANCE = <(100)>;
/*	compensate The resistance of PCB*/
	COM_R_FG_VALUE = <(0)>;
/*	compensate R_sense resistance*/
	enable_tmp_intr_suspend = <(0)>;
/* Enable update temp when suspend */
	ACTIVE_TABLE = <(6)>;
/* Table numbers per battery*/
	MULTI_TEMP_GAUGE0 = <(1)>;

	/*Pseudo1 hide percentage*/
	g_QMAX_SYS_VOL_row = <4>;
	g_QMAX_SYS_VOL_col = <10>;
	g_QMAX_SYS_VOL =
	<
		32500  32500  32500  32500
		32500  32500  32500  32500
		32500  32500  32500  32500
		32500  32500  32500  32500
		32500  32500  32500  32500
		32500  32500  32500  32500
		32800  32800  32800  32800
		32800  32800  32800  32800
		32800  32800  32800  32800
		32800  32800  32800  32800
	>;

battery0_profile_t0_num = <100>;
battery0_profile_t0_col = <3>;
battery0_profile_t0 =
<
0	43313	1168
525	43152	1168
1050	43020	1180
1575	42897	1182
2100	42778	1187
2626	42659	1182
3151	42548	1193
3676	42433	1189
4201	42320	1192
4726	42209	1202
5251	42098	1209
5776	41989	1207
6301	41878	1200
6827	41770	1204
7352	41664	1216
7877	41557	1218
8402	41451	1220
8927	41345	1222
9452	41239	1227
9977	41138	1237
10502	41033	1235
11027	40931	1243
11553	40834	1251
12078	40753	1265
12603	40687	1279
13128	40608	1283
13653	40498	1284
14178	40363	1279
14703	40223	1277
15228	40100	1287
15753	39998	1298
16279	39913	1310
16804	39841	1323
17329	39778	1341
17854	39716	1362
18379	39651	1377
18904	39577	1384
19429	39498	1394
19954	39411	1388
20480	39319	1388
21005	39217	1377
21530	39103	1334
22055	38992	1287
22580	38888	1245
23105	38798	1220
23630	38721	1210
24155	38652	1204
24680	38588	1193
25206	38530	1190
25731	38475	1189
26256	38425	1190
26781	38376	1189
27306	38330	1188
27831	38286	1187
28356	38244	1195
28881	38204	1199
29406	38163	1202
29932	38125	1200
30457	38089	1209
30982	38054	1210
31507	38021	1215
32032	37988	1220
32557	37957	1220
33082	37926	1222
33607	37896	1224
34133	37868	1227
34658	37839	1224
35183	37810	1232
35708	37781	1230
36233	37753	1225
36758	37724	1220
37283	37695	1220
37808	37667	1220
38333	37637	1213
38859	37607	1212
39384	37576	1211
39909	37541	1204
40434	37509	1209
40959	37475	1210
41484	37443	1210
42009	37408	1208
42534	37372	1220
43060	37327	1220
43585	37272	1218
44110	37215	1220
44635	37159	1223
45160	37101	1230
45685	37030	1225
46210	36958	1214
46735	36913	1210
47260	36892	1220
47786	36877	1236
48311	36860	1255
48836	36835	1282
49361	36790	1316
49886	36684	1341
50411	36393	1303
50936	35910	1295
51461	35250	1314
51986	34312	1378
>;
battery0_profile_t1_num = <100>;
battery0_profile_t1_col = <3>;
battery0_profile_t1 =
<
0	43313	1168
525	43152	1168
1050	43020	1180
1575	42897	1182
2100	42778	1187
2626	42659	1182
3151	42548	1193
3676	42433	1189
4201	42320	1192
4726	42209	1202
5251	42098	1209
5776	41989	1207
6301	41878	1200
6827	41770	1204
7352	41664	1216
7877	41557	1218
8402	41451	1220
8927	41345	1222
9452	41239	1227
9977	41138	1237
10502	41033	1235
11027	40931	1243
11553	40834	1251
12078	40753	1265
12603	40687	1279
13128	40608	1283
13653	40498	1284
14178	40363	1279
14703	40223	1277
15228	40100	1287
15753	39998	1298
16279	39913	1310
16804	39841	1323
17329	39778	1341
17854	39716	1362
18379	39651	1377
18904	39577	1384
19429	39498	1394
19954	39411	1388
20480	39319	1388
21005	39217	1377
21530	39103	1334
22055	38992	1287
22580	38888	1245
23105	38798	1220
23630	38721	1210
24155	38652	1204
24680	38588	1193
25206	38530	1190
25731	38475	1189
26256	38425	1190
26781	38376	1189
27306	38330	1188
27831	38286	1187
28356	38244	1195
28881	38204	1199
29406	38163	1202
29932	38125	1200
30457	38089	1209
30982	38054	1210
31507	38021	1215
32032	37988	1220
32557	37957	1220
33082	37926	1222
33607	37896	1224
34133	37868	1227
34658	37839	1224
35183	37810	1232
35708	37781	1230
36233	37753	1225
36758	37724	1220
37283	37695	1220
37808	37667	1220
38333	37637	1213
38859	37607	1212
39384	37576	1211
39909	37541	1204
40434	37509	1209
40959	37475	1210
41484	37443	1210
42009	37408	1208
42534	37372	1220
43060	37327	1220
43585	37272	1218
44110	37215	1220
44635	37159	1223
45160	37101	1230
45685	37030	1225
46210	36958	1214
46735	36913	1210
47260	36892	1220
47786	36877	1236
48311	36860	1255
48836	36835	1282
49361	36790	1316
49886	36684	1341
50411	36393	1303
50936	35910	1295
51461	35250	1314
51986	34312	1378
>;
battery0_profile_t2_num = <100>;
battery0_profile_t2_col = <3>;
battery0_profile_t2 =
<
0	43313	1168
525	43152	1168
1050	43020	1180
1575	42897	1182
2100	42778	1187
2626	42659	1182
3151	42548	1193
3676	42433	1189
4201	42320	1192
4726	42209	1202
5251	42098	1209
5776	41989	1207
6301	41878	1200
6827	41770	1204
7352	41664	1216
7877	41557	1218
8402	41451	1220
8927	41345	1222
9452	41239	1227
9977	41138	1237
10502	41033	1235
11027	40931	1243
11553	40834	1251
12078	40753	1265
12603	40687	1279
13128	40608	1283
13653	40498	1284
14178	40363	1279
14703	40223	1277
15228	40100	1287
15753	39998	1298
16279	39913	1310
16804	39841	1323
17329	39778	1341
17854	39716	1362
18379	39651	1377
18904	39577	1384
19429	39498	1394
19954	39411	1388
20480	39319	1388
21005	39217	1377
21530	39103	1334
22055	38992	1287
22580	38888	1245
23105	38798	1220
23630	38721	1210
24155	38652	1204
24680	38588	1193
25206	38530	1190
25731	38475	1189
26256	38425	1190
26781	38376	1189
27306	38330	1188
27831	38286	1187
28356	38244	1195
28881	38204	1199
29406	38163	1202
29932	38125	1200
30457	38089	1209
30982	38054	1210
31507	38021	1215
32032	37988	1220
32557	37957	1220
33082	37926	1222
33607	37896	1224
34133	37868	1227
34658	37839	1224
35183	37810	1232
35708	37781	1230
36233	37753	1225
36758	37724	1220
37283	37695	1220
37808	37667	1220
38333	37637	1213
38859	37607	1212
39384	37576	1211
39909	37541	1204
40434	37509	1209
40959	37475	1210
41484	37443	1210
42009	37408	1208
42534	37372	1220
43060	37327	1220
43585	37272	1218
44110	37215	1220
44635	37159	1223
45160	37101	1230
45685	37030	1225
46210	36958	1214
46735	36913	1210
47260	36892	1220
47786	36877	1236
48311	36860	1255
48836	36835	1282
49361	36790	1316
49886	36684	1341
50411	36393	1303
50936	35910	1295
51461	35250	1314
51986	34312	1378
>;
battery0_profile_t3_num = <100>;
battery0_profile_t3_col = <3>;
battery0_profile_t3 =
<
0	43313	1168
525	43152	1168
1050	43020	1180
1575	42897	1182
2100	42778	1187
2626	42659	1182
3151	42548	1193
3676	42433	1189
4201	42320	1192
4726	42209	1202
5251	42098	1209
5776	41989	1207
6301	41878	1200
6827	41770	1204
7352	41664	1216
7877	41557	1218
8402	41451	1220
8927	41345	1222
9452	41239	1227
9977	41138	1237
10502	41033	1235
11027	40931	1243
11553	40834	1251
12078	40753	1265
12603	40687	1279
13128	40608	1283
13653	40498	1284
14178	40363	1279
14703	40223	1277
15228	40100	1287
15753	39998	1298
16279	39913	1310
16804	39841	1323
17329	39778	1341
17854	39716	1362
18379	39651	1377
18904	39577	1384
19429	39498	1394
19954	39411	1388
20480	39319	1388
21005	39217	1377
21530	39103	1334
22055	38992	1287
22580	38888	1245
23105	38798	1220
23630	38721	1210
24155	38652	1204
24680	38588	1193
25206	38530	1190
25731	38475	1189
26256	38425	1190
26781	38376	1189
27306	38330	1188
27831	38286	1187
28356	38244	1195
28881	38204	1199
29406	38163	1202
29932	38125	1200
30457	38089	1209
30982	38054	1210
31507	38021	1215
32032	37988	1220
32557	37957	1220
33082	37926	1222
33607	37896	1224
34133	37868	1227
34658	37839	1224
35183	37810	1232
35708	37781	1230
36233	37753	1225
36758	37724	1220
37283	37695	1220
37808	37667	1220
38333	37637	1213
38859	37607	1212
39384	37576	1211
39909	37541	1204
40434	37509	1209
40959	37475	1210
41484	37443	1210
42009	37408	1208
42534	37372	1220
43060	37327	1220
43585	37272	1218
44110	37215	1220
44635	37159	1223
45160	37101	1230
45685	37030	1225
46210	36958	1214
46735	36913	1210
47260	36892	1220
47786	36877	1236
48311	36860	1255
48836	36835	1282
49361	36790	1316
49886	36684	1341
50411	36393	1303
50936	35910	1295
51461	35250	1314
51986	34312	1378
>;
battery0_profile_t4_num = <100>;
battery0_profile_t4_col = <3>;
battery0_profile_t4 =
<
0	43313	1168
525	43152	1168
1050	43020	1180
1575	42897	1182
2100	42778	1187
2626	42659	1182
3151	42548	1193
3676	42433	1189
4201	42320	1192
4726	42209	1202
5251	42098	1209
5776	41989	1207
6301	41878	1200
6827	41770	1204
7352	41664	1216
7877	41557	1218
8402	41451	1220
8927	41345	1222
9452	41239	1227
9977	41138	1237
10502	41033	1235
11027	40931	1243
11553	40834	1251
12078	40753	1265
12603	40687	1279
13128	40608	1283
13653	40498	1284
14178	40363	1279
14703	40223	1277
15228	40100	1287
15753	39998	1298
16279	39913	1310
16804	39841	1323
17329	39778	1341
17854	39716	1362
18379	39651	1377
18904	39577	1384
19429	39498	1394
19954	39411	1388
20480	39319	1388
21005	39217	1377
21530	39103	1334
22055	38992	1287
22580	38888	1245
23105	38798	1220
23630	38721	1210
24155	38652	1204
24680	38588	1193
25206	38530	1190
25731	38475	1189
26256	38425	1190
26781	38376	1189
27306	38330	1188
27831	38286	1187
28356	38244	1195
28881	38204	1199
29406	38163	1202
29932	38125	1200
30457	38089	1209
30982	38054	1210
31507	38021	1215
32032	37988	1220
32557	37957	1220
33082	37926	1222
33607	37896	1224
34133	37868	1227
34658	37839	1224
35183	37810	1232
35708	37781	1230
36233	37753	1225
36758	37724	1220
37283	37695	1220
37808	37667	1220
38333	37637	1213
38859	37607	1212
39384	37576	1211
39909	37541	1204
40434	37509	1209
40959	37475	1210
41484	37443	1210
42009	37408	1208
42534	37372	1220
43060	37327	1220
43585	37272	1218
44110	37215	1220
44635	37159	1223
45160	37101	1230
45685	37030	1225
46210	36958	1214
46735	36913	1210
47260	36892	1220
47786	36877	1236
48311	36860	1255
48836	36835	1282
49361	36790	1316
49886	36684	1341
50411	36393	1303
50936	35910	1295
51461	35250	1314
51986	34312	1378
>;
battery0_profile_t5_num = <100>;
battery0_profile_t5_col = <3>;
battery0_profile_t5 =
<
0	43313	1168
525	43152	1168
1050	43020	1180
1575	42897	1182
2100	42778	1187
2626	42659	1182
3151	42548	1193
3676	42433	1189
4201	42320	1192
4726	42209	1202
5251	42098	1209
5776	41989	1207
6301	41878	1200
6827	41770	1204
7352	41664	1216
7877	41557	1218
8402	41451	1220
8927	41345	1222
9452	41239	1227
9977	41138	1237
10502	41033	1235
11027	40931	1243
11553	40834	1251
12078	40753	1265
12603	40687	1279
13128	40608	1283
13653	40498	1284
14178	40363	1279
14703	40223	1277
15228	40100	1287
15753	39998	1298
16279	39913	1310
16804	39841	1323
17329	39778	1341
17854	39716	1362
18379	39651	1377
18904	39577	1384
19429	39498	1394
19954	39411	1388
20480	39319	1388
21005	39217	1377
21530	39103	1334
22055	38992	1287
22580	38888	1245
23105	38798	1220
23630	38721	1210
24155	38652	1204
24680	38588	1193
25206	38530	1190
25731	38475	1189
26256	38425	1190
26781	38376	1189
27306	38330	1188
27831	38286	1187
28356	38244	1195
28881	38204	1199
29406	38163	1202
29932	38125	1200
30457	38089	1209
30982	38054	1210
31507	38021	1215
32032	37988	1220
32557	37957	1220
33082	37926	1222
33607	37896	1224
34133	37868	1227
34658	37839	1224
35183	37810	1232
35708	37781	1230
36233	37753	1225
36758	37724	1220
37283	37695	1220
37808	37667	1220
38333	37637	1213
38859	37607	1212
39384	37576	1211
39909	37541	1204
40434	37509	1209
40959	37475	1210
41484	37443	1210
42009	37408	1208
42534	37372	1220
43060	37327	1220
43585	37272	1218
44110	37215	1220
44635	37159	1223
45160	37101	1230
45685	37030	1225
46210	36958	1214
46735	36913	1210
47260	36892	1220
47786	36877	1236
48311	36860	1255
48836	36835	1282
49361	36790	1316
49886	36684	1341
50411	36393	1303
50936	35910	1295
51461	35250	1314
51986	34312	1378
>;
};