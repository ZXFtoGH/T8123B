// SPDX-License-Identifier: GPL-2.0
/*
 * Copyright (c) 2021 MediaTek Inc.
 * Author: Wy Chuang<wy.chuang@mediatek.com>
 *
 */

&mtk_gauge {
	DIFFERENCE_FULLOCV_ITH = <(200)>;
	/* Charging termination current */
	SHUTDOWN_1_TIME = <(5)>;
	/* If ui_soc shows 1% more than X minites, system will shutdown */
	KEEP_100_PERCENT = <(1)>;
	R_FG_VALUE = <(5)>;
	/* R_sense resistance */
	EMBEDDED_SEL = <(0)>;
	/* Configures whether using embedded battery or not */
	PMIC_SHUTDOWN_CURRENT = <(20)>;
	/* System shutdown current */
	FG_METER_RESISTANCE = <(70)>;
	/* The resistance of PCB */
	CAR_TUNE_VALUE = <(101)>;
	/* Tune value for current measurement */
	PMIC_MIN_VOL = <(33500)>;
	/* vboot voltage for gauge 0%*/
	POWERON_SYSTEM_IBOOT = <(500)>;
	/* power on system iboot */
	SHUTDOWN_GAUGE0_VOLTAGE = <(34000)>;
	/* shutdown gauge 0% voltage */
	TEMPERATURE_T0 = <(50)>;
	/* Battery temperature T0 */
	TEMPERATURE_T1 = <(25)>;
	/* Battery temperature T1 */
	TEMPERATURE_T2 = <(10)>;
	/* Battery temperature T2 */
	TEMPERATURE_T3 = <(0)>;
	/* Battery temperature T3 */
	TEMPERATURE_T4 = <(-10)>;
	/* Battery temperature T4 */
	g_FG_PSEUDO100_T0 = <(100)>;
	/* Pseudo 100% percentage at T0 */
	g_FG_PSEUDO100_T1 = <(100)>;
	/* Pseudo 100% percentage at T1 */
	g_FG_PSEUDO100_T2 = <(100)>;
	/* Pseudo 100% percentage at T2 */
	g_FG_PSEUDO100_T3 = <(100)>;
	/* Pseudo 100% percentage at T3 */
	g_FG_PSEUDO100_T4 = <(100)>;
	/* Pseudo 100% percentage at T4 */
	Q_MAX_SYS_VOLTAGE_BAT0 = <(3350)>;
	/* Pseudo1 for hide percentage */
	Q_MAX_SYS_VOLTAGE_BAT1 = <(3350)>;
	/* Pseudo1 for hide percentage */
	Q_MAX_SYS_VOLTAGE_BAT2 = <(3350)>;
	/* Pseudo1 for hide percentage */
	Q_MAX_SYS_VOLTAGE_BAT3 = <(3350)>;
	/* Pseudo1 for hide percentage */
	COM_FG_METER_RESISTANCE = <(100)>;
	/* compensate The resistance of PCB */
	COM_R_FG_VALUE = <(0)>;
	/* compensate R_sense resistance */
	enable_tmp_intr_suspend = <(0)>;
	/* Enable update temp when suspend */
	ACTIVE_TABLE = <(5)>;
	/* Table numbers per battery */
	MULTI_TEMP_GAUGE0 = <(1)>;
	/* Multi gauge0 enable */
	RBAT_PULL_UP_VOLT = <(2800)>;


/* mt6789_battery_prop_dim2_ext.dtsi  start */

	/*vboot voltage for gauge 0%*/
	g_PMIC_MIN_VOL_row = <4>;
	g_PMIC_MIN_VOL_col = <10>;
	g_PMIC_MIN_VOL =
	<
		33500  33500  33500  33500
		33000  33000  33000  33000
		33000  33000  33000  33000
		32200  32200  32200  32200
		31000  31000  31000  31000
		31500  31500  31500  31500
		31000  31000  31000  31000
		31000  31000  31000  31000
		31000  31000  31000  31000
		31000  31000  31000  31200
	>;
	/*boot_up current for gauge 0%*/
	g_PON_SYS_IBOOT_row = <4>;
	g_PON_SYS_IBOOT_col = <10>;
	g_PON_SYS_IBOOT =
	<
		5000  5000  5000  5000
		5000  5000  5000  5000
		5000  5000  5000  5000
		5000  5000  5000  5000
		5000  5000  5000  5000
		5000  5000  5000  5000
		5000  5000  5000  5000
		5000  5000  5000  5000
		5000  5000  5000  5000
		5000  5000  5000  5000
	>;
	/*Pseudo1 hide percentage*/
	g_QMAX_SYS_VOL_row = <4>;
	g_QMAX_SYS_VOL_col = <10>;
	g_QMAX_SYS_VOL =
	<
		34950  34950  34950  34950
		34950  34950  34950  34950
		34250  34250  34250  34250
		34250  34250  34250  34250
		34250  34250  34250  34250
		32500  32500  32500  32500
		32800  32800  32800  32800
		32800  32800  32800  32800
		32800  32800  32800  32800
		32800  32800  32800  32800
	>;
	/*Pseudo100 percentage setting*/
	g_FG_PSEUDO100_row = <4>;
	g_FG_PSEUDO100_col = <10>;
	g_FG_PSEUDO100 =
	<
		100  100  100  100
		100  100  100  100
		100  100  100  100
		100  100  100  100
		100  100  100  100
		100  100  100  100
		100  100  100  100
		100  100  100  100
		100  100  100  100
		100  100  100  100
	>;

	/* charge_r  pseudo100 setting*/
	g_FG_charge_PSEUDO100_row = <4>;
	g_FG_charge_PSEUDO100_col = <10>;
	g_FG_charge_PSEUDO100 =
	<
		100   100  100  100
		100   100  100  100
		100   100  100  100
		100   100  100  100
		100   100  100  100
		100   100  100  100
		100   100  100  100
		100   100  100  100
		100   100  100  100
		100   100  100  100
	>;
/* mt6789_battery_prop_dim2_ext.dtsi  end */

/* mt6789_battery_table.dtsi start */

battery0_profile_t0_num = <100>;
battery0_profile_t0_col = <3>;
battery0_profile_t0 =
<
0	43730	1390
695	43600	1390
1389	43477	1397
2084	43361	1400
2778	43244	1395
3473	43122	1390
4167	43003	1390
4862	42889	1390
5556	42768	1390
6251	42654	1390
6945	42541	1397
7640	42429	1400
8335	42311	1400
9029	42192	1400
9724	42078	1400
10418	41965	1400
11113	41853	1400
11807	41747	1408
12502	41637	1404
13196	41529	1405
13891	41421	1410
14585	41311	1412
15280	41205	1419
15975	41093	1410
16669	40988	1410
17364	40891	1417
18058	40796	1426
18753	40714	1444
19447	40647	1470
20142	40572	1488
20836	40440	1480
21531	40283	1480
22225	40143	1488
22920	40024	1490
23615	39938	1501
24309	39880	1518
25004	39831	1535
25698	39768	1550
26393	39690	1550
27087	39603	1550
27782	39515	1557
28476	39416	1548
29171	39302	1520
29865	39180	1482
30560	39061	1443
31255	38950	1417
31949	38854	1391
32644	38775	1382
33338	38704	1373
34033	38640	1370
34727	38584	1370
35422	38529	1367
36116	38471	1362
36811	38428	1370
37505	38376	1370
38200	38331	1370
38895	38288	1370
39589	38244	1370
40284	38201	1370
40978	38160	1370
41673	38125	1371
42367	38091	1380
43062	38056	1380
43756	38021	1380
44451	37986	1374
45145	37956	1365
45840	37930	1363
46535	37902	1368
47229	37868	1360
47924	37842	1360
48618	37816	1368
49313	37783	1363
50007	37754	1365
50702	37723	1366
51396	37689	1357
52091	37654	1350
52785	37619	1350
53480	37585	1350
54175	37542	1350
54869	37505	1350
55564	37470	1355
56258	37436	1364
56953	37399	1372
57647	37352	1380
58342	37283	1380
59036	37222	1380
59731	37161	1387
60425	37089	1390
61120	37011	1381
61815	36951	1370
62509	36928	1373
63204	36920	1391
63898	36911	1418
64593	36902	1444
65287	36880	1470
65982	36833	1496
66676	36673	1494
67371	36343	1481
68065	35960	1613
68760	35960	2290
>;
battery0_profile_t1_num = <100>;
battery0_profile_t1_col = <3>;
battery0_profile_t1 =
<
0	43730	1390
695	43600	1390
1389	43477	1397
2084	43361	1400
2778	43244	1395
3473	43122	1390
4167	43003	1390
4862	42889	1390
5556	42768	1390
6251	42654	1390
6945	42541	1397
7640	42429	1400
8335	42311	1400
9029	42192	1400
9724	42078	1400
10418	41965	1400
11113	41853	1400
11807	41747	1408
12502	41637	1404
13196	41529	1405
13891	41421	1410
14585	41311	1412
15280	41205	1419
15975	41093	1410
16669	40988	1410
17364	40891	1417
18058	40796	1426
18753	40714	1444
19447	40647	1470
20142	40572	1488
20836	40440	1480
21531	40283	1480
22225	40143	1488
22920	40024	1490
23615	39938	1501
24309	39880	1518
25004	39831	1535
25698	39768	1550
26393	39690	1550
27087	39603	1550
27782	39515	1557
28476	39416	1548
29171	39302	1520
29865	39180	1482
30560	39061	1443
31255	38950	1417
31949	38854	1391
32644	38775	1382
33338	38704	1373
34033	38640	1370
34727	38584	1370
35422	38529	1367
36116	38471	1362
36811	38428	1370
37505	38376	1370
38200	38331	1370
38895	38288	1370
39589	38244	1370
40284	38201	1370
40978	38160	1370
41673	38125	1371
42367	38091	1380
43062	38056	1380
43756	38021	1380
44451	37986	1374
45145	37956	1365
45840	37930	1363
46535	37902	1368
47229	37868	1360
47924	37842	1360
48618	37816	1368
49313	37783	1363
50007	37754	1365
50702	37723	1366
51396	37689	1357
52091	37654	1350
52785	37619	1350
53480	37585	1350
54175	37542	1350
54869	37505	1350
55564	37470	1355
56258	37436	1364
56953	37399	1372
57647	37352	1380
58342	37283	1380
59036	37222	1380
59731	37161	1387
60425	37089	1390
61120	37011	1381
61815	36951	1370
62509	36928	1373
63204	36920	1391
63898	36911	1418
64593	36902	1444
65287	36880	1470
65982	36833	1496
66676	36673	1494
67371	36343	1481
68065	35960	1613
68760	35960	2290
>;
battery0_profile_t2_num = <100>;
battery0_profile_t2_col = <3>;
battery0_profile_t2 =
<
0	43730	1390
695	43600	1390
1389	43477	1397
2084	43361	1400
2778	43244	1395
3473	43122	1390
4167	43003	1390
4862	42889	1390
5556	42768	1390
6251	42654	1390
6945	42541	1397
7640	42429	1400
8335	42311	1400
9029	42192	1400
9724	42078	1400
10418	41965	1400
11113	41853	1400
11807	41747	1408
12502	41637	1404
13196	41529	1405
13891	41421	1410
14585	41311	1412
15280	41205	1419
15975	41093	1410
16669	40988	1410
17364	40891	1417
18058	40796	1426
18753	40714	1444
19447	40647	1470
20142	40572	1488
20836	40440	1480
21531	40283	1480
22225	40143	1488
22920	40024	1490
23615	39938	1501
24309	39880	1518
25004	39831	1535
25698	39768	1550
26393	39690	1550
27087	39603	1550
27782	39515	1557
28476	39416	1548
29171	39302	1520
29865	39180	1482
30560	39061	1443
31255	38950	1417
31949	38854	1391
32644	38775	1382
33338	38704	1373
34033	38640	1370
34727	38584	1370
35422	38529	1367
36116	38471	1362
36811	38428	1370
37505	38376	1370
38200	38331	1370
38895	38288	1370
39589	38244	1370
40284	38201	1370
40978	38160	1370
41673	38125	1371
42367	38091	1380
43062	38056	1380
43756	38021	1380
44451	37986	1374
45145	37956	1365
45840	37930	1363
46535	37902	1368
47229	37868	1360
47924	37842	1360
48618	37816	1368
49313	37783	1363
50007	37754	1365
50702	37723	1366
51396	37689	1357
52091	37654	1350
52785	37619	1350
53480	37585	1350
54175	37542	1350
54869	37505	1350
55564	37470	1355
56258	37436	1364
56953	37399	1372
57647	37352	1380
58342	37283	1380
59036	37222	1380
59731	37161	1387
60425	37089	1390
61120	37011	1381
61815	36951	1370
62509	36928	1373
63204	36920	1391
63898	36911	1418
64593	36902	1444
65287	36880	1470
65982	36833	1496
66676	36673	1494
67371	36343	1481
68065	35960	1613
68760	35960	2290
>;
battery0_profile_t3_num = <100>;
battery0_profile_t3_col = <3>;
battery0_profile_t3 =
<
0	43730	1390
695	43600	1390
1389	43477	1397
2084	43361	1400
2778	43244	1395
3473	43122	1390
4167	43003	1390
4862	42889	1390
5556	42768	1390
6251	42654	1390
6945	42541	1397
7640	42429	1400
8335	42311	1400
9029	42192	1400
9724	42078	1400
10418	41965	1400
11113	41853	1400
11807	41747	1408
12502	41637	1404
13196	41529	1405
13891	41421	1410
14585	41311	1412
15280	41205	1419
15975	41093	1410
16669	40988	1410
17364	40891	1417
18058	40796	1426
18753	40714	1444
19447	40647	1470
20142	40572	1488
20836	40440	1480
21531	40283	1480
22225	40143	1488
22920	40024	1490
23615	39938	1501
24309	39880	1518
25004	39831	1535
25698	39768	1550
26393	39690	1550
27087	39603	1550
27782	39515	1557
28476	39416	1548
29171	39302	1520
29865	39180	1482
30560	39061	1443
31255	38950	1417
31949	38854	1391
32644	38775	1382
33338	38704	1373
34033	38640	1370
34727	38584	1370
35422	38529	1367
36116	38471	1362
36811	38428	1370
37505	38376	1370
38200	38331	1370
38895	38288	1370
39589	38244	1370
40284	38201	1370
40978	38160	1370
41673	38125	1371
42367	38091	1380
43062	38056	1380
43756	38021	1380
44451	37986	1374
45145	37956	1365
45840	37930	1363
46535	37902	1368
47229	37868	1360
47924	37842	1360
48618	37816	1368
49313	37783	1363
50007	37754	1365
50702	37723	1366
51396	37689	1357
52091	37654	1350
52785	37619	1350
53480	37585	1350
54175	37542	1350
54869	37505	1350
55564	37470	1355
56258	37436	1364
56953	37399	1372
57647	37352	1380
58342	37283	1380
59036	37222	1380
59731	37161	1387
60425	37089	1390
61120	37011	1381
61815	36951	1370
62509	36928	1373
63204	36920	1391
63898	36911	1418
64593	36902	1444
65287	36880	1470
65982	36833	1496
66676	36673	1494
67371	36343	1481
68065	35960	1613
68760	35960	2290
>;
battery0_profile_t4_num = <100>;
battery0_profile_t4_col = <3>;
battery0_profile_t4 =
<
0	43730	1390
695	43600	1390
1389	43477	1397
2084	43361	1400
2778	43244	1395
3473	43122	1390
4167	43003	1390
4862	42889	1390
5556	42768	1390
6251	42654	1390
6945	42541	1397
7640	42429	1400
8335	42311	1400
9029	42192	1400
9724	42078	1400
10418	41965	1400
11113	41853	1400
11807	41747	1408
12502	41637	1404
13196	41529	1405
13891	41421	1410
14585	41311	1412
15280	41205	1419
15975	41093	1410
16669	40988	1410
17364	40891	1417
18058	40796	1426
18753	40714	1444
19447	40647	1470
20142	40572	1488
20836	40440	1480
21531	40283	1480
22225	40143	1488
22920	40024	1490
23615	39938	1501
24309	39880	1518
25004	39831	1535
25698	39768	1550
26393	39690	1550
27087	39603	1550
27782	39515	1557
28476	39416	1548
29171	39302	1520
29865	39180	1482
30560	39061	1443
31255	38950	1417
31949	38854	1391
32644	38775	1382
33338	38704	1373
34033	38640	1370
34727	38584	1370
35422	38529	1367
36116	38471	1362
36811	38428	1370
37505	38376	1370
38200	38331	1370
38895	38288	1370
39589	38244	1370
40284	38201	1370
40978	38160	1370
41673	38125	1371
42367	38091	1380
43062	38056	1380
43756	38021	1380
44451	37986	1374
45145	37956	1365
45840	37930	1363
46535	37902	1368
47229	37868	1360
47924	37842	1360
48618	37816	1368
49313	37783	1363
50007	37754	1365
50702	37723	1366
51396	37689	1357
52091	37654	1350
52785	37619	1350
53480	37585	1350
54175	37542	1350
54869	37505	1350
55564	37470	1355
56258	37436	1364
56953	37399	1372
57647	37352	1380
58342	37283	1380
59036	37222	1380
59731	37161	1387
60425	37089	1390
61120	37011	1381
61815	36951	1370
62509	36928	1373
63204	36920	1391
63898	36911	1418
64593	36902	1444
65287	36880	1470
65982	36833	1496
66676	36673	1494
67371	36343	1481
68065	35960	1613
68760	35960	2290
>;

/* mt6789_battery_table.dtsi end */
};
