// SPDX-License-Identifier: GPL-2.0
/*
 * Copyright (c) 2021 MediaTek Inc.
 * Author: Wy Chuang<wy.chuang@mediatek.com>
 *
 */

&mtk_gauge {
	DIFFERENCE_FULLOCV_ITH = <(200)>;
	/* Charging termination current */
	SHUTDOWN_1_TIME = <(5)>;
	/* If ui_soc shows 1% more than X minites, system will shutdown */
	KEEP_100_PERCENT = <(1)>;
	R_FG_VALUE = <(5)>;
	/* R_sense resistance */
	EMBEDDED_SEL = <(0)>;
	/* Configures whether using embedded battery or not */
	PMIC_SHUTDOWN_CURRENT = <(20)>;
	/* System shutdown current */
	FG_METER_RESISTANCE = <(70)>;
	/* The resistance of PCB */
	CAR_TUNE_VALUE = <(103)>;
	/* Tune value for current measurement */
	PMIC_MIN_VOL = <(33500)>;
	/* vboot voltage for gauge 0%*/
	POWERON_SYSTEM_IBOOT = <(500)>;
	/* power on system iboot */
	SHUTDOWN_GAUGE0_VOLTAGE = <(34000)>;
	/* shutdown gauge 0% voltage */
	TEMPERATURE_T0 = <(50)>;
	/* Battery temperature T0 */
	TEMPERATURE_T1 = <(25)>;
	/* Battery temperature T1 */
	TEMPERATURE_T2 = <(10)>;
	/* Battery temperature T2 */
	TEMPERATURE_T3 = <(0)>;
	/* Battery temperature T3 */
	TEMPERATURE_T4 = <(-10)>;
	/* Battery temperature T4 */
	g_FG_PSEUDO100_T0 = <(100)>;
	/* Pseudo 100% percentage at T0 */
	g_FG_PSEUDO100_T1 = <(100)>;
	/* Pseudo 100% percentage at T1 */
	g_FG_PSEUDO100_T2 = <(100)>;
	/* Pseudo 100% percentage at T2 */
	g_FG_PSEUDO100_T3 = <(100)>;
	/* Pseudo 100% percentage at T3 */
	g_FG_PSEUDO100_T4 = <(100)>;
	/* Pseudo 100% percentage at T4 */
	Q_MAX_SYS_VOLTAGE_BAT0 = <(3350)>;
	/* Pseudo1 for hide percentage */
	Q_MAX_SYS_VOLTAGE_BAT1 = <(3350)>;
	/* Pseudo1 for hide percentage */
	Q_MAX_SYS_VOLTAGE_BAT2 = <(3350)>;
	/* Pseudo1 for hide percentage */
	Q_MAX_SYS_VOLTAGE_BAT3 = <(3350)>;
	/* Pseudo1 for hide percentage */
	COM_FG_METER_RESISTANCE = <(100)>;
	/* compensate The resistance of PCB */
	COM_R_FG_VALUE = <(0)>;
	/* compensate R_sense resistance */
	enable_tmp_intr_suspend = <(0)>;
	/* Enable update temp when suspend */
	ACTIVE_TABLE = <(5)>;
	/* Table numbers per battery */
	MULTI_TEMP_GAUGE0 = <(1)>;
	/* Multi gauge0 enable */
	RBAT_PULL_UP_VOLT = <(2800)>;


/* mt6789_battery_prop_dim2_ext.dtsi  start */

	/*vboot voltage for gauge 0%*/
	g_PMIC_MIN_VOL_row = <4>;
	g_PMIC_MIN_VOL_col = <10>;
	g_PMIC_MIN_VOL =
	<
		33500  33500  33500  33500
		33000  33000  33000  33000
		33000  33000  33000  33000
		32200  32200  32200  32200
		31000  31000  31000  31000
		31500  31500  31500  31500
		31000  31000  31000  31000
		31000  31000  31000  31000
		31000  31000  31000  31000
		31000  31000  31000  31200
	>;
	/*boot_up current for gauge 0%*/
	g_PON_SYS_IBOOT_row = <4>;
	g_PON_SYS_IBOOT_col = <10>;
	g_PON_SYS_IBOOT =
	<
		5000  5000  5000  5000
		5000  5000  5000  5000
		5000  5000  5000  5000
		5000  5000  5000  5000
		5000  5000  5000  5000
		5000  5000  5000  5000
		5000  5000  5000  5000
		5000  5000  5000  5000
		5000  5000  5000  5000
		5000  5000  5000  5000
	>;
	/*Pseudo1 hide percentage*/
	g_QMAX_SYS_VOL_row = <4>;
	g_QMAX_SYS_VOL_col = <10>;
	g_QMAX_SYS_VOL =
	<
		34950  34950  34950  34950
		34950  34950  34950  34950
		34250  34250  34250  34250
		34250  34250  34250  34250
		34250  34250  34250  34250
		32500  32500  32500  32500
		32800  32800  32800  32800
		32800  32800  32800  32800
		32800  32800  32800  32800
		32800  32800  32800  32800
	>;

/* mt6789_battery_table.dtsi start */

battery1_profile_t0_num = <100>;
battery1_profile_t0_col = <3>;
battery1_profile_t0 =
<
0	43279	610
816	43098	611
1632	42945	677
2448	42797	615
3265	42681	688
4081	42550	683
4897	42408	621
5713	42291	640
6529	42178	627
7345	42074	697
8162	41959	672
8978	41842	607
9794	41716	571
10610	41620	611
11426	41506	606
12242	41399	659
13059	41299	674
13875	41205	716
14691	41096	703
15507	40992	686
16323	40903	710
17139	40799	681
17956	40696	692
18772	40599	699
19588	40512	706
20404	40423	716
21220	40322	697
22036	40218	667
22853	40114	632
23669	40037	647
24485	39967	657
25301	39886	695
26117	39804	720
26933	39734	728
27749	39662	722
28566	39585	730
29382	39496	740
30198	39413	729
31014	39344	729
31830	39263	706
32646	39191	744
33463	39095	732
34279	38991	727
35095	38890	747
35911	38778	699
36727	38695	722
37543	38604	644
38360	38559	633
39176	38504	688
39992	38442	643
40808	38370	623
41624	38336	674
42440	38304	723
43257	38262	715
44073	38202	628
44889	38174	682
45705	38132	665
46521	38090	690
47337	38056	656
48154	38009	627
48970	37994	704
49786	37966	693
50602	37912	632
51418	37903	703
52234	37866	661
53051	37826	643
53867	37808	692
54683	37789	710
55499	37763	736
56315	37708	703
57131	37643	687
57947	37568	647
58764	37502	645
59580	37456	665
60396	37424	682
61212	37389	708
62028	37345	695
62844	37307	707
63661	37264	660
64477	37229	662
65293	37189	667
66109	37134	681
66925	37060	622
67741	37015	618
68558	36957	659
69374	36892	661
70190	36822	652
71006	36781	639
71822	36765	643
72638	36754	653
73455	36742	727
74271	36724	703
75087	36675	751
75903	36488	698
76719	36133	760
77535	35639	795
78352	34984	779
79168	34046	905
79984	34008	910
80800	34008	910
>;
battery1_profile_t1_num = <100>;
battery1_profile_t1_col = <3>;
battery1_profile_t1 =
<
0	43405	725
816	43221	725
1632	43064	735
2448	42923	739
3265	42793	729
4081	42668	717
4897	42547	719
5713	42431	727
6529	42315	725
7345	42200	722
8162	42087	724
8978	41976	726
9794	41867	724
10610	41761	740
11426	41656	755
12242	41549	761
13059	41442	764
13875	41336	769
14691	41230	773
15507	41124	774
16323	41019	774
17139	40919	783
17956	40833	805
18772	40770	831
19588	40723	861
20404	40652	867
21220	40521	836
22036	40343	810
22853	40168	799
23669	40025	801
24485	39914	813
25301	39828	825
26117	39768	838
26933	39728	859
27749	39694	883
28566	39649	897
29382	39584	887
30198	39511	881
31014	39436	886
31830	39361	897
32646	39284	906
33463	39196	903
34279	39098	886
35095	38989	846
35911	38880	796
36727	38781	756
37543	38696	739
38360	38622	735
39176	38559	740
39992	38501	738
40808	38447	740
41624	38397	740
42440	38350	737
43257	38305	735
44073	38262	738
44889	38222	743
45705	38183	745
46521	38147	748
47337	38111	752
48154	38077	748
48970	38045	749
49786	38014	754
50602	37983	757
51418	37954	756
52234	37929	763
53051	37904	772
53867	37878	781
54683	37854	789
55499	37830	793
56315	37804	795
57131	37775	794
57947	37745	787
58764	37712	773
59580	37677	760
60396	37641	751
61212	37604	748
62028	37562	739
62844	37519	732
63661	37481	730
64477	37452	742
65293	37423	757
66109	37384	763
66925	37332	767
67741	37270	762
68558	37213	767
69374	37156	774
70190	37082	771
71006	37001	772
71822	36956	772
72638	36939	782
73455	36927	793
74271	36914	812
75087	36894	830
75903	36858	857
76719	36753	878
77535	36433	859
78352	35959	893
79168	35332	945
79984	34432	1033
80800	34414	1035
>;
battery1_profile_t2_num = <100>;
battery1_profile_t2_col = <3>;
battery1_profile_t2 =
<
0	43416	1085
816	43247	1085
1632	43100	1093
2448	42966	1095
3265	42843	1103
4081	42725	1104
4897	42610	1097
5713	42495	1090
6529	42382	1092
7345	42270	1091
8162	42160	1097
8978	42052	1096
9794	41945	1099
10610	41839	1101
11426	41734	1098
12242	41627	1102
13059	41521	1107
13875	41416	1112
14691	41312	1120
15507	41206	1134
16323	41103	1139
17139	41003	1140
17956	40915	1148
18772	40852	1170
19588	40808	1211
20404	40751	1248
21220	40645	1249
22036	40470	1217
22853	40262	1175
23669	40080	1160
24485	39943	1170
25301	39841	1186
26117	39758	1194
26933	39689	1210
27749	39634	1233
28566	39594	1263
29382	39556	1285
30198	39506	1292
31014	39437	1281
31830	39353	1262
32646	39261	1235
33463	39163	1201
34279	39065	1163
35095	38965	1123
35911	38872	1089
36727	38787	1065
37543	38712	1049
38360	38643	1033
39176	38581	1028
39992	38524	1025
40808	38469	1020
41624	38419	1023
42440	38373	1025
43257	38327	1025
44073	38285	1031
44889	38246	1038
45705	38207	1046
46521	38170	1051
47337	38134	1059
48154	38101	1066
48970	38067	1071
49786	38036	1076
50602	38006	1083
51418	37978	1093
52234	37950	1093
53051	37923	1095
53867	37897	1102
54683	37872	1106
55499	37848	1108
56315	37825	1110
57131	37804	1111
57947	37785	1114
58764	37766	1115
59580	37745	1114
60396	37720	1111
61212	37690	1104
62028	37655	1095
62844	37619	1091
63661	37584	1090
64477	37552	1094
65293	37517	1104
66109	37479	1119
66925	37429	1128
67741	37369	1133
68558	37311	1138
69374	37256	1153
70190	37192	1163
71006	37111	1161
71822	37046	1162
72638	37014	1176
73455	36996	1198
74271	36981	1228
75087	36964	1267
75903	36938	1325
76719	36886	1411
77535	36735	1480
78352	36376	1450
79168	35865	1507
79984	35178	1615
80800	34177	1815
>;
battery1_profile_t3_num = <100>;
battery1_profile_t3_col = <3>;
battery1_profile_t3 =
<
0	43414	1748
816	43223	1751
1632	43058	1940
2448	42913	1930
3265	42784	1916
4081	42664	1738
4897	42547	1838
5713	42433	1913
6529	42319	1912
7345	42209	1905
8162	42100	1890
8978	41992	1884
9794	41888	1904
10610	41783	1908
11426	41681	1887
12242	41578	1910
13059	41473	1922
13875	41368	1896
14691	41263	1891
15507	41160	1904
16323	41062	1904
17139	40974	1907
17956	40909	1950
18772	40861	2015
19588	40804	2072
20404	40711	2095
21220	40557	2082
22036	40349	2008
22853	40144	1931
23669	39980	1901
24485	39855	1903
25301	39758	1900
26117	39675	1910
26933	39605	1924
27749	39544	1929
28566	39491	1935
29382	39443	1965
30198	39387	1962
31014	39325	1950
31830	39250	1912
32646	39167	1868
33463	39081	1858
34279	38993	1807
35095	38908	1769
35911	38827	1774
36727	38750	1743
37543	38679	1726
38360	38613	1701
39176	38554	1719
39992	38497	1700
40808	38444	1680
41624	38394	1700
42440	38346	1713
43257	38302	1721
44073	38259	1739
44889	38219	1773
45705	38181	1754
46521	38145	1719
47337	38109	1757
48154	38076	1771
48970	38043	1796
49786	38013	1802
50602	37985	1829
51418	37957	1821
52234	37929	1839
53051	37904	1842
53867	37881	1873
54683	37862	1859
55499	37845	1880
56315	37829	1906
57131	37813	1904
57947	37798	1935
58764	37781	1944
59580	37763	1961
60396	37744	1983
61212	37721	1983
62028	37695	2016
62844	37667	2031
63661	37637	2042
64477	37600	2049
65293	37561	2053
66109	37517	2089
66925	37467	2139
67741	37415	2147
68558	37359	2172
69374	37298	2230
70190	37228	2264
71006	37157	2259
71822	37101	2300
72638	37060	2336
73455	37031	2416
74271	37008	2569
75087	36978	2719
75903	36930	2920
76719	36840	3145
77535	36666	3319
78352	36351	3441
79168	35875	3620
79984	35201	3985
80800	34200	4628
>;
battery1_profile_t4_num = <100>;
battery1_profile_t4_col = <3>;
battery1_profile_t4 =
<
0	43443	4053
816	43233	4059
1632	43058	4386
2448	42911	4476
3265	42773	4461
4081	42646	4470
4897	42525	4442
5713	42406	4368
6529	42291	4366
7345	42179	4347
8162	42073	4331
8978	41965	4280
9794	41860	4289
10610	41754	4278
11426	41648	4249
12242	41541	4218
13059	41436	4213
13875	41332	4184
14691	41228	4140
15507	41130	4157
16323	41047	4188
17139	40976	4225
17956	40909	4277
18772	40831	4349
19588	40721	4340
20404	40568	4272
21220	40375	4167
22036	40178	4023
22853	40005	3929
23669	39865	3891
24485	39748	3851
25301	39648	3839
26117	39559	3781
26933	39478	3779
27749	39405	3812
28566	39338	3825
29382	39276	3822
30198	39213	3822
31014	39146	3809
31830	39078	3793
32646	39007	3770
33463	38934	3742
34279	38863	3731
35095	38792	3723
35911	38725	3711
36727	38661	3715
37543	38599	3720
38360	38540	3720
39176	38486	3727
39992	38433	3732
40808	38383	3748
41624	38334	3771
42440	38289	3792
43257	38248	3821
44073	38207	3842
44889	38168	3865
45705	38130	3890
46521	38094	3912
47337	38060	3885
48154	38029	3682
48970	37998	3964
49786	37972	4045
50602	37948	4088
51418	37925	4030
52234	37907	3898
53051	37887	4176
53867	37869	4261
54683	37850	4322
55499	37831	4375
56315	37811	4427
57131	37791	4485
57947	37769	4542
58764	37746	4595
59580	37721	4656
60396	37695	4721
61212	37666	4787
62028	37634	4861
62844	37601	4938
63661	37564	5015
64477	37523	5097
65293	37480	5185
66109	37433	5277
66925	37385	5379
67741	37337	5488
68558	37289	5618
69374	37242	5768
70190	37197	5948
71006	37150	6158
71822	37102	6410
72638	37046	6691
73455	36979	7011
74271	36895	7363
75087	36787	7751
75903	36644	8165
76719	36443	8602
77535	36161	9084
78352	35783	9658
79168	35286	10316
79984	34648	11046
80800	34159	10398
>;

/* mt6789_battery_table.dtsi end */
};
