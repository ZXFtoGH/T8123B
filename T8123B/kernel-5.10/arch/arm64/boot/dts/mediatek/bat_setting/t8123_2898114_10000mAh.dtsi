// SPDX-License-Identifier: GPL-2.0
/*
 * Copyright (c) 2021 MediaTek Inc.
 * Author: Wy Chuang<wy.chuang@mediatek.com>
 *
 */

&mtk_gauge {
	DIFFERENCE_FULLOCV_ITH = <(200)>;
	/* Charging termination current */
	SHUTDOWN_1_TIME = <(5)>;
	/* If ui_soc shows 1% more than X minites, system will shutdown */
	KEEP_100_PERCENT = <(1)>;
	R_FG_VALUE = <(5)>;
	/* R_sense resistance */
	EMBEDDED_SEL = <(0)>;
	/* Configures whether using embedded battery or not */
	PMIC_SHUTDOWN_CURRENT = <(20)>;
	/* System shutdown current */
	FG_METER_RESISTANCE = <(70)>;
	/* The resistance of PCB */
	CAR_TUNE_VALUE = <(103)>;
	/* Tune value for current measurement */
	PMIC_MIN_VOL = <(33500)>;
	/* vboot voltage for gauge 0%*/
	POWERON_SYSTEM_IBOOT = <(500)>;
	/* power on system iboot */
	SHUTDOWN_GAUGE0_VOLTAGE = <(34000)>;
	/* shutdown gauge 0% voltage */
	TEMPERATURE_T0 = <(50)>;
	/* Battery temperature T0 */
	TEMPERATURE_T1 = <(25)>;
	/* Battery temperature T1 */
	TEMPERATURE_T2 = <(10)>;
	/* Battery temperature T2 */
	TEMPERATURE_T3 = <(0)>;
	/* Battery temperature T3 */
	TEMPERATURE_T4 = <(-10)>;
	/* Battery temperature T4 */
	g_FG_PSEUDO100_T0 = <(100)>;
	/* Pseudo 100% percentage at T0 */
	g_FG_PSEUDO100_T1 = <(100)>;
	/* Pseudo 100% percentage at T1 */
	g_FG_PSEUDO100_T2 = <(100)>;
	/* Pseudo 100% percentage at T2 */
	g_FG_PSEUDO100_T3 = <(100)>;
	/* Pseudo 100% percentage at T3 */
	g_FG_PSEUDO100_T4 = <(100)>;
	/* Pseudo 100% percentage at T4 */
	Q_MAX_SYS_VOLTAGE_BAT0 = <(3350)>;
	/* Pseudo1 for hide percentage */
	Q_MAX_SYS_VOLTAGE_BAT1 = <(3350)>;
	/* Pseudo1 for hide percentage */
	Q_MAX_SYS_VOLTAGE_BAT2 = <(3350)>;
	/* Pseudo1 for hide percentage */
	Q_MAX_SYS_VOLTAGE_BAT3 = <(3350)>;
	/* Pseudo1 for hide percentage */
	COM_FG_METER_RESISTANCE = <(100)>;
	/* compensate The resistance of PCB */
	COM_R_FG_VALUE = <(0)>;
	/* compensate R_sense resistance */
	enable_tmp_intr_suspend = <(0)>;
	/* Enable update temp when suspend */
	ACTIVE_TABLE = <(5)>;
	/* Table numbers per battery */
	MULTI_TEMP_GAUGE0 = <(1)>;
	/* Multi gauge0 enable */
	RBAT_PULL_UP_VOLT = <(2800)>;


/* mt6789_battery_prop_dim2_ext.dtsi  start */

	/*vboot voltage for gauge 0%*/
	g_PMIC_MIN_VOL_row = <4>;
	g_PMIC_MIN_VOL_col = <10>;
	g_PMIC_MIN_VOL =
	<
		33500  33500  33500  33500
		33000  33000  33000  33000
		33000  33000  33000  33000
		32200  32200  32200  32200
		31000  31000  31000  31000
		31500  31500  31500  31500
		31000  31000  31000  31000
		31000  31000  31000  31000
		31000  31000  31000  31000
		31000  31000  31000  31200
	>;
	/*boot_up current for gauge 0%*/
	g_PON_SYS_IBOOT_row = <4>;
	g_PON_SYS_IBOOT_col = <10>;
	g_PON_SYS_IBOOT =
	<
		5000  5000  5000  5000
		5000  5000  5000  5000
		5000  5000  5000  5000
		5000  5000  5000  5000
		5000  5000  5000  5000
		5000  5000  5000  5000
		5000  5000  5000  5000
		5000  5000  5000  5000
		5000  5000  5000  5000
		5000  5000  5000  5000
	>;
	/*Pseudo1 hide percentage*/
	g_QMAX_SYS_VOL_row = <4>;
	g_QMAX_SYS_VOL_col = <10>;
	g_QMAX_SYS_VOL =
	<
		34950  34950  34950  34950
		34950  34950  34950  34950
		34250  34250  34250  34250
		34250  34250  34250  34250
		34250  34250  34250  34250
		32500  32500  32500  32500
		32800  32800  32800  32800
		32800  32800  32800  32800
		32800  32800  32800  32800
		32800  32800  32800  32800
	>;

/* mt6789_battery_table.dtsi start */

battery0_profile_t0_num = <100>;
battery0_profile_t0_col = <3>;
battery0_profile_t0 =
<
0		43923	528
1000	43728	528
2000	43579	526
3000	43452	528
4000	43322	525
5000	43204	526
6000	43080	526
7000	42959	525
8000	42841	527
9000	42723	525
10000	42606	529
11000	42488	527
12000	42373	530
13000	42255	528
14000	42140	530
15000	42026	530
16000	41911	531
17000	41799	532
18000	41685	533
19000	41576	534
20000	41465	533
21000	41356	538
22000	41245	536
23000	41139	539
24000	41031	541
25000	40925	542
26000	40823	544
27000	40724	546
28000	40628	549
29000	40528	551
30000	40429	555
31000	40327	559
32000	40221	560
33000	40119	561
34000	40026	562
35000	39939	565
36000	39856	565
37000	39775	569
38000	39691	572
39000	39601	568
40000	39515	570
41000	39428	570
42000	39335	569
43000	39242	567
44000	39136	556
45000	39034	547
46000	38932	538
47000	38839	528
48000	38746	518
49000	38668	514
50000	38600	511
51000	38538	508
52000	38479	508
53000	38423	506
54000	38374	507
55000	38324	508
56000	38275	507
57000	38231	508
58000	38188	510
59000	38147	510
60000	38107	511
61000	38070	511
62000	38033	513
63000	37999	515
64000	37965	515
65000	37930	513
66000	37899	516
67000	37868	514
68000	37841	515
69000	37810	515
70000	37782	511
71000	37757	513
72000	37726	510
73000	37704	510
74000	37679	510
75000	37655	510
76000	37630	510
77000	37605	510
78000	37574	511
79000	37543	510
80000	37506	511
81000	37468	511
82000	37431	513
83000	37391	513
84000	37351	516
85000	37301	517
86000	37242	518
87000	37174	519
88000	37115	525
89000	37047	528
90000	36963	525
91000	36889	522
92000	36861	525
93000	36845	531
94000	36833	541
95000	36817	550
96000	36790	563
97000	36743	579
98000	36619	593
99000	36300	584
>;
battery0_profile_t1_num = <100>;
battery0_profile_t1_col = <3>;
battery0_profile_t1 =
<
0		43923	528
1000	43728	528
2000	43579	526
3000	43452	528
4000	43322	525
5000	43204	526
6000	43080	526
7000	42959	525
8000	42841	527
9000	42723	525
10000	42606	529
11000	42488	527
12000	42373	530
13000	42255	528
14000	42140	530
15000	42026	530
16000	41911	531
17000	41799	532
18000	41685	533
19000	41576	534
20000	41465	533
21000	41356	538
22000	41245	536
23000	41139	539
24000	41031	541
25000	40925	542
26000	40823	544
27000	40724	546
28000	40628	549
29000	40528	551
30000	40429	555
31000	40327	559
32000	40221	560
33000	40119	561
34000	40026	562
35000	39939	565
36000	39856	565
37000	39775	569
38000	39691	572
39000	39601	568
40000	39515	570
41000	39428	570
42000	39335	569
43000	39242	567
44000	39136	556
45000	39034	547
46000	38932	538
47000	38839	528
48000	38746	518
49000	38668	514
50000	38600	511
51000	38538	508
52000	38479	508
53000	38423	506
54000	38374	507
55000	38324	508
56000	38275	507
57000	38231	508
58000	38188	510
59000	38147	510
60000	38107	511
61000	38070	511
62000	38033	513
63000	37999	515
64000	37965	515
65000	37930	513
66000	37899	516
67000	37868	514
68000	37841	515
69000	37810	515
70000	37782	511
71000	37757	513
72000	37726	510
73000	37704	510
74000	37679	510
75000	37655	510
76000	37630	510
77000	37605	510
78000	37574	511
79000	37543	510
80000	37506	511
81000	37468	511
82000	37431	513
83000	37391	513
84000	37351	516
85000	37301	517
86000	37242	518
87000	37174	519
88000	37115	525
89000	37047	528
90000	36963	525
91000	36889	522
92000	36861	525
93000	36845	531
94000	36833	541
95000	36817	550
96000	36790	563
97000	36743	579
98000	36619	593
99000	36300	584
>;
battery0_profile_t2_num = <100>;
battery0_profile_t2_col = <3>;
battery0_profile_t2 =
<
0		43923	528
1000	43728	528
2000	43579	526
3000	43452	528
4000	43322	525
5000	43204	526
6000	43080	526
7000	42959	525
8000	42841	527
9000	42723	525
10000	42606	529
11000	42488	527
12000	42373	530
13000	42255	528
14000	42140	530
15000	42026	530
16000	41911	531
17000	41799	532
18000	41685	533
19000	41576	534
20000	41465	533
21000	41356	538
22000	41245	536
23000	41139	539
24000	41031	541
25000	40925	542
26000	40823	544
27000	40724	546
28000	40628	549
29000	40528	551
30000	40429	555
31000	40327	559
32000	40221	560
33000	40119	561
34000	40026	562
35000	39939	565
36000	39856	565
37000	39775	569
38000	39691	572
39000	39601	568
40000	39515	570
41000	39428	570
42000	39335	569
43000	39242	567
44000	39136	556
45000	39034	547
46000	38932	538
47000	38839	528
48000	38746	518
49000	38668	514
50000	38600	511
51000	38538	508
52000	38479	508
53000	38423	506
54000	38374	507
55000	38324	508
56000	38275	507
57000	38231	508
58000	38188	510
59000	38147	510
60000	38107	511
61000	38070	511
62000	38033	513
63000	37999	515
64000	37965	515
65000	37930	513
66000	37899	516
67000	37868	514
68000	37841	515
69000	37810	515
70000	37782	511
71000	37757	513
72000	37726	510
73000	37704	510
74000	37679	510
75000	37655	510
76000	37630	510
77000	37605	510
78000	37574	511
79000	37543	510
80000	37506	511
81000	37468	511
82000	37431	513
83000	37391	513
84000	37351	516
85000	37301	517
86000	37242	518
87000	37174	519
88000	37115	525
89000	37047	528
90000	36963	525
91000	36889	522
92000	36861	525
93000	36845	531
94000	36833	541
95000	36817	550
96000	36790	563
97000	36743	579
98000	36619	593
99000	36300	584
>;
battery0_profile_t3_num = <100>;
battery0_profile_t3_col = <3>;
battery0_profile_t3 =
<
0		43923	528
1000	43728	528
2000	43579	526
3000	43452	528
4000	43322	525
5000	43204	526
6000	43080	526
7000	42959	525
8000	42841	527
9000	42723	525
10000	42606	529
11000	42488	527
12000	42373	530
13000	42255	528
14000	42140	530
15000	42026	530
16000	41911	531
17000	41799	532
18000	41685	533
19000	41576	534
20000	41465	533
21000	41356	538
22000	41245	536
23000	41139	539
24000	41031	541
25000	40925	542
26000	40823	544
27000	40724	546
28000	40628	549
29000	40528	551
30000	40429	555
31000	40327	559
32000	40221	560
33000	40119	561
34000	40026	562
35000	39939	565
36000	39856	565
37000	39775	569
38000	39691	572
39000	39601	568
40000	39515	570
41000	39428	570
42000	39335	569
43000	39242	567
44000	39136	556
45000	39034	547
46000	38932	538
47000	38839	528
48000	38746	518
49000	38668	514
50000	38600	511
51000	38538	508
52000	38479	508
53000	38423	506
54000	38374	507
55000	38324	508
56000	38275	507
57000	38231	508
58000	38188	510
59000	38147	510
60000	38107	511
61000	38070	511
62000	38033	513
63000	37999	515
64000	37965	515
65000	37930	513
66000	37899	516
67000	37868	514
68000	37841	515
69000	37810	515
70000	37782	511
71000	37757	513
72000	37726	510
73000	37704	510
74000	37679	510
75000	37655	510
76000	37630	510
77000	37605	510
78000	37574	511
79000	37543	510
80000	37506	511
81000	37468	511
82000	37431	513
83000	37391	513
84000	37351	516
85000	37301	517
86000	37242	518
87000	37174	519
88000	37115	525
89000	37047	528
90000	36963	525
91000	36889	522
92000	36861	525
93000	36845	531
94000	36833	541
95000	36817	550
96000	36790	563
97000	36743	579
98000	36619	593
99000	36300	584
>;
battery0_profile_t4_num = <100>;
battery0_profile_t4_col = <3>;
battery0_profile_t4 =
<
0		43923	528
1000	43728	528
2000	43579	526
3000	43452	528
4000	43322	525
5000	43204	526
6000	43080	526
7000	42959	525
8000	42841	527
9000	42723	525
10000	42606	529
11000	42488	527
12000	42373	530
13000	42255	528
14000	42140	530
15000	42026	530
16000	41911	531
17000	41799	532
18000	41685	533
19000	41576	534
20000	41465	533
21000	41356	538
22000	41245	536
23000	41139	539
24000	41031	541
25000	40925	542
26000	40823	544
27000	40724	546
28000	40628	549
29000	40528	551
30000	40429	555
31000	40327	559
32000	40221	560
33000	40119	561
34000	40026	562
35000	39939	565
36000	39856	565
37000	39775	569
38000	39691	572
39000	39601	568
40000	39515	570
41000	39428	570
42000	39335	569
43000	39242	567
44000	39136	556
45000	39034	547
46000	38932	538
47000	38839	528
48000	38746	518
49000	38668	514
50000	38600	511
51000	38538	508
52000	38479	508
53000	38423	506
54000	38374	507
55000	38324	508
56000	38275	507
57000	38231	508
58000	38188	510
59000	38147	510
60000	38107	511
61000	38070	511
62000	38033	513
63000	37999	515
64000	37965	515
65000	37930	513
66000	37899	516
67000	37868	514
68000	37841	515
69000	37810	515
70000	37782	511
71000	37757	513
72000	37726	510
73000	37704	510
74000	37679	510
75000	37655	510
76000	37630	510
77000	37605	510
78000	37574	511
79000	37543	510
80000	37506	511
81000	37468	511
82000	37431	513
83000	37391	513
84000	37351	516
85000	37301	517
86000	37242	518
87000	37174	519
88000	37115	525
89000	37047	528
90000	36963	525
91000	36889	522
92000	36861	525
93000	36845	531
94000	36833	541
95000	36817	550
96000	36790	563
97000	36743	579
98000	36619	593
99000	36300	584
>;

/* mt6789_battery_table.dtsi end */
};
