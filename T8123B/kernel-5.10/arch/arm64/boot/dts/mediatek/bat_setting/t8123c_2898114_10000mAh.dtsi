// SPDX-License-Identifier: GPL-2.0
/*
 * Copyright (c) 2021 MediaTek Inc.
 * Author: Wy Chuang<wy.chuang@mediatek.com>
 *
 */

&mtk_gauge {
	DIFFERENCE_FULLOCV_ITH = <(200)>;
	/* Charging termination current */
	SHUTDOWN_1_TIME = <(5)>;
	/* If ui_soc shows 1% more than X minites, system will shutdown */
	KEEP_100_PERCENT = <(1)>;
	R_FG_VALUE = <(5)>;
	/* R_sense resistance */
	EMBEDDED_SEL = <(0)>;
	/* Configures whether using embedded battery or not */
	PMIC_SHUTDOWN_CURRENT = <(20)>;
	/* System shutdown current */
	FG_METER_RESISTANCE = <(70)>;
	/* The resistance of PCB */
	CAR_TUNE_VALUE = <(103)>;
	/* Tune value for current measurement */
	PMIC_MIN_VOL = <(33500)>;
	/* vboot voltage for gauge 0%*/
	POWERON_SYSTEM_IBOOT = <(500)>;
	/* power on system iboot */
	SHUTDOWN_GAUGE0_VOLTAGE = <(34000)>;
	/* shutdown gauge 0% voltage */
	TEMPERATURE_T0 = <(50)>;
	/* Battery temperature T0 */
	TEMPERATURE_T1 = <(25)>;
	/* Battery temperature T1 */
	TEMPERATURE_T2 = <(10)>;
	/* Battery temperature T2 */
	TEMPERATURE_T3 = <(0)>;
	/* Battery temperature T3 */
	TEMPERATURE_T4 = <(-10)>;
	/* Battery temperature T4 */
	g_FG_PSEUDO100_T0 = <(100)>;
	/* Pseudo 100% percentage at T0 */
	g_FG_PSEUDO100_T1 = <(100)>;
	/* Pseudo 100% percentage at T1 */
	g_FG_PSEUDO100_T2 = <(100)>;
	/* Pseudo 100% percentage at T2 */
	g_FG_PSEUDO100_T3 = <(100)>;
	/* Pseudo 100% percentage at T3 */
	g_FG_PSEUDO100_T4 = <(100)>;
	/* Pseudo 100% percentage at T4 */
	Q_MAX_SYS_VOLTAGE_BAT0 = <(3350)>;
	/* Pseudo1 for hide percentage */
	Q_MAX_SYS_VOLTAGE_BAT1 = <(3350)>;
	/* Pseudo1 for hide percentage */
	Q_MAX_SYS_VOLTAGE_BAT2 = <(3350)>;
	/* Pseudo1 for hide percentage */
	Q_MAX_SYS_VOLTAGE_BAT3 = <(3350)>;
	/* Pseudo1 for hide percentage */
	COM_FG_METER_RESISTANCE = <(100)>;
	/* compensate The resistance of PCB */
	COM_R_FG_VALUE = <(0)>;
	/* compensate R_sense resistance */
	enable_tmp_intr_suspend = <(0)>;
	/* Enable update temp when suspend */
	ACTIVE_TABLE = <(5)>;
	/* Table numbers per battery */
	MULTI_TEMP_GAUGE0 = <(1)>;
	/* Multi gauge0 enable */
	RBAT_PULL_UP_VOLT = <(2800)>;


/* mt6789_battery_prop_dim2_ext.dtsi  start */

	/*vboot voltage for gauge 0%*/
	g_PMIC_MIN_VOL_row = <4>;
	g_PMIC_MIN_VOL_col = <10>;
	g_PMIC_MIN_VOL =
	<
		33500  33500  33500  33500
		33000  33000  33000  33000
		33000  33000  33000  33000
		32200  32200  32200  32200
		31000  31000  31000  31000
		31500  31500  31500  31500
		31000  31000  31000  31000
		31000  31000  31000  31000
		31000  31000  31000  31000
		31000  31000  31000  31200
	>;
	/*boot_up current for gauge 0%*/
	g_PON_SYS_IBOOT_row = <4>;
	g_PON_SYS_IBOOT_col = <10>;
	g_PON_SYS_IBOOT =
	<
		5000  5000  5000  5000
		5000  5000  5000  5000
		5000  5000  5000  5000
		5000  5000  5000  5000
		5000  5000  5000  5000
		5000  5000  5000  5000
		5000  5000  5000  5000
		5000  5000  5000  5000
		5000  5000  5000  5000
		5000  5000  5000  5000
	>;
	/*Pseudo1 hide percentage*/
	g_QMAX_SYS_VOL_row = <4>;
	g_QMAX_SYS_VOL_col = <10>;
	g_QMAX_SYS_VOL =
	<
		34950  34950  34950  34950
		34950  34950  34950  34950
		34250  34250  34250  34250
		34250  34250  34250  34250
		34250  34250  34250  34250
		32500  32500  32500  32500
		32800  32800  32800  32800
		32800  32800  32800  32800
		32800  32800  32800  32800
		32800  32800  32800  32800
	>;

/* mt6789_battery_table.dtsi start */

battery0_profile_t0_num = <100>;
battery0_profile_t0_col = <3>;
battery0_profile_t0 =
<
0	43950	472
1064	43749	472
2128	43571	469
3192	43411	468
4256	43254	466
5320	43108	465
6384	42970	465
7448	42836	465
8512	42703	465
9576	42576	465
10640	42452	466
11704	42324	466
12768	42204	468
13833	42087	469
14897	41970	470
15961	41853	471
17025	41736	473
18089	41619	473
19153	41504	474
20217	41395	476
21281	41278	478
22345	41165	478
23409	41058	480
24473	40952	481
25537	40845	483
26601	40739	482
27665	40632	484
28729	40533	486
29793	40437	489
30857	40332	493
31921	40226	491
32985	40130	494
34049	40034	496
35113	39949	499
36177	39864	499
37241	39776	501
38305	39684	503
39369	39603	505
40434	39519	506
41498	39429	507
42562	39343	508
43626	39252	506
44690	39156	503
45754	39060	497
46818	38956	489
47882	38859	482
48946	38763	473
50010	38677	470
51074	38603	467
52138	38530	465
53202	38468	463
54266	38415	465
55330	38362	465
56394	38309	465
57458	38260	466
58522	38212	466
59586	38172	468
60650	38133	470
61714	38090	472
62778	38056	473
63842	38015	473
64906	37982	476
65971	37950	478
67035	37918	478
68099	37886	479
69163	37854	481
70227	37822	480
71291	37790	480
72355	37758	481
73419	37726	480
74483	37689	477
75547	37641	473
76611	37594	470
77675	37544	469
78739	37499	468
79803	37456	466
80867	37423	467
81931	37381	467
82995	37339	468
84059	37306	469
85123	37265	470
86187	37229	473
87251	37175	473
88315	37119	472
89379	37059	472
90443	37000	474
91507	36931	472
92572	36863	468
93636	36819	467
94700	36803	474
95764	36792	484
96828	36772	494
97892	36751	511
98956	36679	521
100020	36484	514
101084	36073	493
102148	35505	497
103212	34709	505
104276	33449	537
105340	31120	563
>;
battery0_profile_t1_num = <100>;
battery0_profile_t1_col = <3>;
battery0_profile_t1 =
<
0	43920	528
1064	43720	528
2128	43563	527
3192	43425	527
4256	43289	526
5320	43162	527
6384	43034	526
7448	42906	526
8512	42779	526
9576	42657	528
10640	42533	528
11704	42405	529
12768	42285	528
13833	42160	530
14897	42041	530
15961	41915	532
17025	41796	533
18089	41679	533
19153	41562	535
20217	41445	534
21281	41328	538
22345	41211	538
23409	41094	540
24473	40982	542
25537	40870	544
26601	40759	545
27665	40659	548
28729	40556	551
29793	40450	554
30857	40343	558
31921	40228	561
32985	40120	561
34049	40025	563
35113	39930	566
36177	39845	567
37241	39757	570
38305	39662	571
39369	39570	569
40434	39480	571
41498	39384	570
42562	39283	568
43626	39176	560
44690	39063	550
45754	38954	540
46818	38856	531
47882	38760	519
48946	38674	515
50010	38599	512
51074	38534	509
52138	38471	509
53202	38409	507
54266	38356	508
55330	38306	508
56394	38259	507
57458	38211	509
58522	38168	510
59586	38126	511
60650	38083	512
61714	38041	513
62778	38006	515
63842	37974	515
64906	37933	513
65971	37900	516
67035	37868	515
68099	37836	515
69163	37805	514
70227	37775	511
71291	37751	512
72355	37719	510
73419	37691	510
74483	37670	510
75547	37643	510
76611	37617	510
77675	37582	511
78739	37547	510
79803	37515	511
80867	37475	512
81931	37432	513
82995	37389	513
84059	37346	516
85123	37291	518
86187	37225	519
87251	37156	522
88315	37096	527
89379	37013	527
90443	36927	525
91507	36874	525
92572	36854	530
93636	36837	538
94700	36823	548
95764	36796	560
96828	36747	578
97892	36629	593
98956	36305	585
100020	35777	592
101084	33691	702
102148	31650	825
103212	31650	825
104276	31650	825
105340	31650	825
>;
battery0_profile_t2_num = <100>;
battery0_profile_t2_col = <3>;
battery0_profile_t2 =
<
0	43990	1457
1064	43810	1457
2128	43641	1463
3192	43485	1458
4256	43344	1461
5320	43206	1461
6384	43085	1467
7448	42957	1463
8512	42835	1463
9576	42712	1460
10640	42591	1458
11704	42460	1453
12768	42344	1456
13833	42230	1457
14897	42114	1457
15961	41997	1451
17025	41889	1451
18089	41763	1451
19153	41655	1456
20217	41536	1451
21281	41414	1453
22345	41305	1455
23409	41188	1454
24473	41089	1460
25537	41015	1467
26601	40946	1473
27665	40844	1464
28729	40688	1440
29793	40487	1413
30857	40301	1408
31921	40120	1413
32985	39996	1425
34049	39889	1433
35113	39805	1439
36177	39733	1446
37241	39682	1451
38305	39631	1449
39369	39557	1443
40434	39479	1434
41498	39399	1423
42562	39324	1417
43626	39238	1411
44690	39162	1412
45754	39084	1410
46818	39014	1408
47882	38950	1408
48946	38869	1403
50010	38813	1413
51074	38749	1408
52138	38696	1414
53202	38641	1413
54266	38580	1408
55330	38529	1410
56394	38490	1416
57458	38451	1420
58522	38402	1420
59586	38359	1420
60650	38323	1424
61714	38278	1422
62778	38232	1424
63842	38189	1427
64906	38163	1426
65971	38124	1427
67035	38101	1433
68099	38070	1433
69163	38048	1433
70227	38017	1439
71291	37994	1439
72355	37965	1437
73419	37940	1435
74483	37916	1441
75547	37896	1445
76611	37870	1442
77675	37854	1446
78739	37831	1447
79803	37806	1449
80867	37769	1446
81931	37743	1450
82995	37704	1446
84059	37662	1451
85123	37609	1451
86187	37557	1446
87251	37511	1451
88315	37449	1451
89379	37396	1453
90443	37336	1457
91507	37274	1462
92572	37231	1473
93636	37199	1482
94700	37166	1496
95764	37130	1513
96828	37070	1533
97892	36948	1533
98956	36751	1532
100020	36411	1509
101084	35905	1477
102148	35887	1476
103212	35887	1476
104276	35887	1476
105340	35887	1476
>;
battery0_profile_t3_num = <100>;
battery0_profile_t3_col = <3>;
battery0_profile_t3 =
<
0	43940	1935
1064	43749	1935
2128	43571	1940
3192	43411	1935
4256	43260	1935
5320	43127	1935
6384	42989	1933
7448	42867	1926
8512	42735	1923
9576	42602	1916
10640	42468	1906
11704	42344	1904
12768	42227	1899
13833	42102	1887
14897	41975	1885
15961	41857	1885
17025	41729	1873
18089	41612	1873
19153	41493	1871
20217	41358	1860
21281	41241	1858
22345	41131	1856
23409	41043	1863
24473	40965	1870
25537	40864	1863
26601	40724	1840
27665	40527	1810
28729	40310	1790
29793	40113	1786
30857	39954	1796
31921	39832	1803
32985	39725	1804
34049	39649	1817
35113	39576	1823
36177	39513	1824
37241	39460	1829
38305	39404	1830
39369	39340	1830
40434	39265	1823
41498	39183	1811
42562	39109	1807
43626	39035	1804
44690	38972	1808
45754	38901	1807
46818	38826	1805
47882	38768	1810
48946	38706	1811
50010	38642	1811
51074	38579	1811
52138	38526	1811
53202	38473	1817
54266	38420	1818
55330	38369	1825
56394	38323	1829
57458	38270	1827
58522	38226	1826
59586	38184	1826
60650	38142	1831
61714	38111	1840
62778	38072	1842
63842	38037	1847
64906	38013	1853
65971	37983	1854
67035	37951	1854
68099	37919	1854
69163	37897	1860
70227	37867	1862
71291	37846	1870
72355	37825	1881
73419	37803	1887
74483	37774	1892
75547	37736	1895
76611	37709	1904
77675	37676	1910
78739	37627	1910
79803	37596	1928
80867	37559	1940
81931	37516	1951
82995	37483	1970
84059	37441	1996
85123	37389	2010
86187	37344	2036
87251	37282	2059
88315	37227	2098
89379	37163	2143
90443	37089	2198
91507	36977	2251
92572	36834	2320
93636	36653	2403
94700	36404	2507
95764	36108	2656
96828	35868	2886
97892	35518	2761
98956	35045	2523
100020	34404	2202
101084	33930	1966
102148	33930	1966
103212	33930	1966
104276	33930	1966
105340	33930	1966
>;
battery0_profile_t4_num = <100>;
battery0_profile_t4_col = <3>;
battery0_profile_t4 =
<
0	43908	2926
1064	43815	2929
2128	43676	2970
3192	43481	2967
4256	43299	2950
5320	43133	2939
6384	42979	2923
7448	42829	2909
8512	42683	2899
9576	42551	2885
10640	42411	2869
11704	42275	2857
12768	42143	2843
13833	42012	2835
14897	41880	2823
15961	41748	2810
17025	41616	2791
18089	41496	2783
19153	41356	2765
20217	41247	2758
21281	41135	2753
22345	41039	2753
23409	40930	2755
24473	40794	2751
25537	40629	2731
26601	40444	2712
27665	40246	2684
28729	40083	2669
29793	39947	2662
30857	39816	2650
31921	39717	2653
32985	39625	2648
34049	39532	2635
35113	39466	2642
36177	39400	2643
37241	39335	2648
38305	39265	2646
39369	39191	2642
40434	39125	2644
41498	39053	2648
42562	38980	2648
43626	38907	2645
44690	38836	2642
45754	38770	2642
46818	38714	2651
47882	38650	2654
48946	38585	2654
50010	38519	2648
51074	38478	2660
52138	38414	2667
53202	38373	2673
54266	38322	2675
55330	38276	2683
56394	38219	2681
57458	38184	2692
58522	38152	2707
59586	38113	2713
60650	38080	2723
61714	38054	2736
62778	38019	2745
63842	37989	2762
64906	37952	2771
65971	37923	2783
67035	37897	2795
68099	37872	2815
69163	37845	2842
70227	37818	2862
71291	37792	2882
72355	37765	2909
73419	37735	2935
74483	37700	2964
75547	37668	2997
76611	37629	3033
77675	37589	3073
78739	37550	3117
79803	37511	3167
80867	37470	3225
81931	37421	3289
82995	37368	3361
84059	37303	3433
85123	37250	3536
86187	37194	3599
87251	37151	3577
88315	37104	3554
89379	37059	3531
90443	37007	3505
91507	36932	3467
92572	36859	3431
93636	36786	3395
94700	36687	3345
95764	36556	3279
96828	36395	3199
97892	36162	3083
98956	35823	2913
100020	35181	2605
101084	34337	2214
102148	34337	2214
103212	34337	2214
104276	34337	2214
105340	34337	2214
>;

/* mt6789_battery_table.dtsi end */
};
