// SPDX-License-Identifier: GPL-2.0
/*
 * Copyright (c) 2021 MediaTek Inc.
 * Author: Wy Chuang<wy.chuang@mediatek.com>
 *
 */

&mtk_gauge {
	DIFFERENCE_FULLOCV_ITH = <(200)>;
	/* Charging termination current */
	SHUTDOWN_1_TIME = <(5)>;
	/* If ui_soc shows 1% more than X minites, system will shutdown */
	KEEP_100_PERCENT = <(1)>;
	R_FG_VALUE = <(5)>;
	/* R_sense resistance */
	EMBEDDED_SEL = <(0)>;
	/* Configures whether using embedded battery or not */
	PMIC_SHUTDOWN_CURRENT = <(20)>;
	/* System shutdown current */
	FG_METER_RESISTANCE = <(70)>;
	/* The resistance of PCB */
	CAR_TUNE_VALUE = <(103)>;
	/* Tune value for current measurement */
	PMIC_MIN_VOL = <(33500)>;
	/* vboot voltage for gauge 0%*/
	POWERON_SYSTEM_IBOOT = <(500)>;
	/* power on system iboot */
	SHUTDOWN_GAUGE0_VOLTAGE = <(34000)>;
	/* shutdown gauge 0% voltage */
	TEMPERATURE_T0 = <(50)>;
	/* Battery temperature T0 */
	TEMPERATURE_T1 = <(25)>;
	/* Battery temperature T1 */
	TEMPERATURE_T2 = <(10)>;
	/* Battery temperature T2 */
	TEMPERATURE_T3 = <(0)>;
	/* Battery temperature T3 */
	TEMPERATURE_T4 = <(-10)>;
	/* Battery temperature T4 */
	g_FG_PSEUDO100_T0 = <(100)>;
	/* Pseudo 100% percentage at T0 */
	g_FG_PSEUDO100_T1 = <(100)>;
	/* Pseudo 100% percentage at T1 */
	g_FG_PSEUDO100_T2 = <(100)>;
	/* Pseudo 100% percentage at T2 */
	g_FG_PSEUDO100_T3 = <(100)>;
	/* Pseudo 100% percentage at T3 */
	g_FG_PSEUDO100_T4 = <(100)>;
	/* Pseudo 100% percentage at T4 */
	Q_MAX_SYS_VOLTAGE_BAT0 = <(3350)>;
	/* Pseudo1 for hide percentage */
	Q_MAX_SYS_VOLTAGE_BAT1 = <(3350)>;
	/* Pseudo1 for hide percentage */
	Q_MAX_SYS_VOLTAGE_BAT2 = <(3350)>;
	/* Pseudo1 for hide percentage */
	Q_MAX_SYS_VOLTAGE_BAT3 = <(3350)>;
	/* Pseudo1 for hide percentage */
	COM_FG_METER_RESISTANCE = <(100)>;
	/* compensate The resistance of PCB */
	COM_R_FG_VALUE = <(0)>;
	/* compensate R_sense resistance */
	enable_tmp_intr_suspend = <(0)>;
	/* Enable update temp when suspend */
	ACTIVE_TABLE = <(5)>;
	/* Table numbers per battery */
	MULTI_TEMP_GAUGE0 = <(1)>;
	/* Multi gauge0 enable */
	RBAT_PULL_UP_VOLT = <(2800)>;


/* mt6789_battery_prop_dim2_ext.dtsi  start */

	/*vboot voltage for gauge 0%*/
	g_PMIC_MIN_VOL_row = <4>;
	g_PMIC_MIN_VOL_col = <10>;
	g_PMIC_MIN_VOL =
	<
		33500  33500  33500  33500
		33000  33000  33000  33000
		33000  33000  33000  33000
		32200  32200  32200  32200
		31000  31000  31000  31000
		31500  31500  31500  31500
		31000  31000  31000  31000
		31000  31000  31000  31000
		31000  31000  31000  31000
		31000  31000  31000  31200
	>;
	/*boot_up current for gauge 0%*/
	g_PON_SYS_IBOOT_row = <4>;
	g_PON_SYS_IBOOT_col = <10>;
	g_PON_SYS_IBOOT =
	<
		5000  5000  5000  5000
		5000  5000  5000  5000
		5000  5000  5000  5000
		5000  5000  5000  5000
		5000  5000  5000  5000
		5000  5000  5000  5000
		5000  5000  5000  5000
		5000  5000  5000  5000
		5000  5000  5000  5000
		5000  5000  5000  5000
	>;
	/*Pseudo1 hide percentage*/
	g_QMAX_SYS_VOL_row = <4>;
	g_QMAX_SYS_VOL_col = <10>;
	g_QMAX_SYS_VOL =
	<
		34950  34950  34950  34950
		34950  34950  34950  34950
		34250  34250  34250  34250
		34250  34250  34250  34250
		34250  34250  34250  34250
		32500  32500  32500  32500
		32800  32800  32800  32800
		32800  32800  32800  32800
		32800  32800  32800  32800
		32800  32800  32800  32800
	>;

/* mt6789_battery_table.dtsi start */

battery0_profile_t0_num = <100>;
battery0_profile_t0_col = <3>;
battery0_profile_t0 =
<
0	43945	580
835	43778	584
1669	43636	583
2504	43504	581
3338	43375	582
4173	43247	580
5007	43127	584
5842	43004	586
6676	42880	585
7511	42755	586
8345	42632	589
9180	42509	590
10014	42386	593
10849	42265	596
11683	42144	598
12518	42023	601
13352	41901	603
14187	41781	605
15022	41663	608
15856	41545	612
16691	41427	614
17525	41310	616
18360	41195	620
19194	41084	624
20029	40971	626
20863	40861	630
21698	40752	632
22532	40645	636
23367	40538	639
24201	40435	644
25036	40332	648
25870	40229	651
26705	40126	653
27540	40030	656
28374	39937	661
29209	39843	664
30043	39750	667
30878	39658	670
31712	39565	673
32547	39469	673
33381	39368	668
34216	39265	663
35050	39156	653
35885	39046	643
36719	38939	629
37554	38841	619
38388	38747	611
39223	38669	606
40057	38601	606
40892	38535	603
41727	38476	605
42561	38419	606
43396	38365	604
44230	38314	605
45065	38266	608
45899	38220	610
46734	38174	610
47568	38132	611
48403	38091	613
49237	38053	615
50072	38014	616
50906	37977	616
51741	37944	618
52575	37912	618
53410	37879	620
54244	37844	619
55079	37814	618
55914	37782	616
56748	37750	613
57583	37718	611
58417	37685	610
59252	37646	604
60086	37614	604
60921	37581	603
61755	37545	603
62590	37510	603
63424	37472	605
64259	37429	604
65093	37389	606
65928	37350	609
66762	37302	611
67597	37244	612
68431	37179	612
69266	37111	613
70101	37041	616
70935	36962	615
71770	36893	610
72604	36860	611
73439	36847	620
74273	36835	632
75108	36819	644
75942	36792	664
76777	36733	682
77611	36555	683
78446	36142	662
79280	35560	670
80115	34756	694
80949	33851	731
81784	33851	731
82619	33851	731
>;
battery0_profile_t1_num = <100>;
battery0_profile_t1_col = <3>;
battery0_profile_t1 =
<
0	43923	660
835	43722	661
1669	43568	659
2504	43435	660
3338	43302	657
4173	43177	659
5007	43049	658
5842	42923	657
6676	42800	658
7511	42678	659
8345	42555	660
9180	42433	661
10014	42312	662
10849	42190	662
11683	42071	663
12518	41952	664
13352	41834	666
14187	41715	667
15022	41600	668
15856	41485	667
16691	41371	672
17525	41255	671
18360	41144	674
19194	41032	676
20029	40921	678
20863	40815	680
21698	40712	683
22532	40611	687
23367	40507	690
24201	40403	695
25036	40296	700
25870	40187	701
26705	40084	702
27540	39989	705
28374	39900	707
29209	39815	709
30043	39728	713
30878	39637	712
31712	39546	712
32547	39456	713
33381	39360	712
34216	39263	710
35050	39156	698
35885	39049	685
36719	38942	674
37554	38844	661
38388	38747	648
39223	38666	643
40057	38596	639
40892	38531	636
41727	38470	635
42561	38413	633
43396	38362	634
44230	38310	635
45065	38260	634
45899	38215	636
46734	38171	638
47568	38129	638
48403	38088	639
49237	38050	640
50072	38013	643
50906	37977	644
51741	37941	642
52575	37908	644
53410	37875	644
54244	37846	644
55079	37815	644
55914	37785	640
56748	37759	641
57583	37727	638
58417	37703	638
59252	37677	638
60086	37652	638
60921	37626	638
61755	37599	638
62590	37567	639
63424	37533	638
64259	37494	639
65093	37454	640
65928	37415	641
66762	37373	643
67597	37326	646
68431	37269	648
69266	37202	649
70101	37137	654
70935	37070	659
71770	36987	658
72604	36907	654
73439	36867	656
74273	36848	663
75108	36834	675
75942	36818	687
76777	36791	703
77611	36741	725
78446	36601	741
79280	36251	731
80115	35715	742
80949	34973	778
81784	34219	825
82619	34219	825
>;
battery0_profile_t2_num = <100>;
battery0_profile_t2_col = <3>;
battery0_profile_t2 =
<
0	44035	890
835	43880	893
1669	43740	926
2504	43610	964
3338	43481	934
4173	43354	948
5007	43238	930
5842	43118	914
6676	42994	893
7511	42873	913
8345	42749	884
9180	42633	898
10014	42510	895
10849	42388	892
11683	42272	898
12518	42148	882
13352	42035	906
14187	41915	890
15022	41794	887
15856	41679	898
16691	41562	887
17525	41446	917
18360	41330	922
19194	41213	900
20029	41098	937
20863	41006	952
21698	40891	925
22532	40799	965
23367	40679	928
24201	40537	911
25036	40390	894
25870	40235	878
26705	40115	886
27540	39999	886
28374	39904	882
29209	39811	885
30043	39717	879
30878	39619	887
31712	39535	879
32547	39438	855
33381	39342	835
34216	39261	829
35050	39174	829
35885	39084	823
36719	39004	815
37554	38937	820
38388	38872	822
39223	38796	814
40057	38730	829
40892	38679	837
41727	38627	852
42561	38575	844
43396	38522	842
44230	38461	824
45065	38421	836
45899	38372	828
46734	38333	830
47568	38294	848
48403	38255	840
49237	38212	842
50072	38171	834
50906	38140	840
51741	38107	845
52575	38081	842
53410	38055	859
54244	38037	863
55079	38016	861
55914	38000	872
56748	37977	865
57583	37961	885
58417	37938	872
59252	37923	902
60086	37887	886
60921	37860	913
61755	37834	899
62590	37809	945
63424	37770	925
64259	37731	966
65093	37691	954
65928	37639	1002
66762	37585	984
67597	37521	1008
68431	37456	1012
69266	37383	1028
70101	37293	1039
70935	37218	1075
71770	37172	1149
72604	37127	1186
73439	37096	1269
74273	37075	1337
75108	37034	1370
75942	36966	1470
76777	36845	1473
77611	36602	1532
78446	36172	1460
79280	35541	1594
80115	34720	1668
80949	34154	2560
81784	34139	2589
82619	34139	2589
>;
battery0_profile_t3_num = <100>;
battery0_profile_t3_col = <3>;
battery0_profile_t3 =
<
0	44035	1010
835	43803	1566
1669	43586	1572
2504	43395	1557
3338	43229	1549
4173	43077	1541
5007	42935	1533
5842	42793	1525
6676	42655	1516
7511	42526	1511
8345	42397	1508
9180	42273	1500
10014	42152	1492
10849	42029	1488
11683	41906	1479
12518	41784	1477
13352	41668	1475
14187	41543	1462
15022	41423	1462
15856	41317	1459
16691	41204	1457
17525	41109	1477
18360	40996	1480
19194	40880	1488
20029	40752	1481
20863	40598	1449
21698	40455	1432
22532	40301	1400
23367	40161	1377
24201	40034	1361
25036	39920	1346
25870	39821	1339
26705	39730	1333
27540	39640	1331
28374	39555	1325
29209	39472	1322
30043	39382	1314
30878	39297	1310
31712	39220	1305
32547	39135	1298
33381	39053	1294
34216	38984	1294
35050	38919	1294
35885	38845	1288
36719	38777	1286
37554	38713	1293
38388	38648	1294
39223	38596	1294
40057	38544	1294
40892	38480	1294
41727	38429	1302
42561	38377	1302
43396	38338	1302
44230	38287	1302
45065	38249	1303
45899	38210	1310
46734	38175	1314
47568	38149	1328
48403	38123	1336
49237	38097	1344
50072	38077	1355
50906	38064	1375
51741	38045	1396
52575	38026	1420
53410	38006	1448
54244	37988	1477
55079	37966	1504
55914	37941	1534
56748	37915	1577
57583	37880	1608
58417	37851	1632
59252	37825	1670
60086	37788	1738
60921	37750	1796
61755	37723	1852
62590	37684	1909
63424	37633	1965
64259	37592	2021
65093	37529	2070
65928	37477	2130
66762	37425	2202
67597	37374	2277
68431	37314	2355
69266	37251	2439
70101	37207	2541
70935	37155	2651
71770	37103	2787
72604	37052	2945
73439	37000	3127
74273	36927	3311
75108	36820	3499
75942	36670	3661
76777	36466	3806
77611	36208	3882
78446	35849	3658
79280	35318	3326
80115	34483	2804
80949	34064	2542
81784	34064	2542
82619	34064	2542
>;
battery0_profile_t4_num = <100>;
battery0_profile_t4_col = <3>;
battery0_profile_t4 =
<
0	43836	1010
835	43515	2706
1669	43233	2718
2504	42978	2692
3338	42752	2654
4173	42558	2627
5007	42368	2591
5842	42191	2564
6676	42027	2537
7511	41868	2515
8345	41710	2486
9180	41568	2462
10014	41438	2445
10849	41322	2437
11683	41206	2425
12518	41082	2418
13352	40921	2383
14187	40749	2348
15022	40590	2312
15856	40435	2272
16691	40290	2232
17525	40181	2218
18360	40077	2202
19194	39973	2179
20029	39882	2170
20863	39805	2170
21698	39739	2162
22532	39650	2153
23367	39572	2138
24201	39492	2130
25036	39405	2122
25870	39331	2116
26705	39262	2113
27540	39185	2105
28374	39103	2094
29209	39024	2085
30043	38959	2081
30878	38895	2078
31712	38823	2073
32547	38760	2074
33381	38701	2072
34216	38645	2069
35050	38593	2075
35885	38541	2077
36719	38480	2071
37554	38436	2082
38388	38397	2092
39223	38347	2093
40057	38319	2107
40892	38293	2124
41727	38256	2132
42561	38242	2164
43396	38215	2179
44230	38178	2189
45065	38152	2212
45899	38129	2233
46734	38113	2269
47568	38087	2296
48403	38066	2331
49237	38048	2369
50072	38022	2408
50906	37996	2452
51741	37977	2500
52575	37957	2557
53410	37924	2604
54244	37886	2649
55079	37855	2708
55914	37829	2767
56748	37803	2835
57583	37777	2895
58417	37741	2958
59252	37703	3023
60086	37675	3087
60921	37638	3151
61755	37599	3208
62590	37561	3273
63424	37521	3329
64259	37483	3385
65093	37444	3442
65928	37408	3500
66762	37379	3563
67597	37341	3619
68431	37298	3675
69266	37251	3729
70101	37212	3787
70935	37168	3852
71770	37116	3912
72604	37065	3977
73439	36993	4046
74273	36910	4118
75108	36856	4230
75942	36816	4262
76777	36760	4227
77611	36671	4171
78446	36546	4093
79280	36373	3985
80115	36105	3818
80949	35671	3546
81784	35034	3148
82619	33990	2503
>;

/* mt6789_battery_table.dtsi end */
};
