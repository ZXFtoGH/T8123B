## T8123B/kernel-5.10/drivers/gpu/drm/panel/it6151_drv/Kconfig
```kconfig
config DRM_PANEL_EDP_IT6151_DRV
	tristate "Generic IT6151 DRV EDP panel driver"
	depends on OF
	depends on BACKLIGHT_CLASS_DEVICE
	select VIDEOMODE_HELPERS
	help
	  This driver supports IT6151 DRV EDP panels
```

## T8123B/kernel-5.10/drivers/input/misc/hx9023/Kconfig
```kconfig
#
# Mediatek SAR_HX9023
#

config SAR_HX9023
	tristate "SAR HX9023 driver"
	depends on I2C
	help
	  Say Y here if you have SAR HX9023 controller
	  chip in your system.
	  If unsure, say N.
	  To compile this driver as a module, choose M here: the
	  module will be called  HX9023 key.
```

## T8123B/kernel-5.10/drivers/input/touchscreen/chipone_tddi_9551/Kconfig
```kconfig
config TOUCHSCREEN_CHIPONE_9551
	tristate "Chipone TDDI touchscreen for Mediatek package"
	default n
	help
	  Say y here if you have chipone TDDI touch panel.
	  If unsure, say N.
```

## T8123B/kernel-5.10/drivers/input/touchscreen/focaltech_touch/Kconfig
```kconfig
#
# Focaltech Touchscreen driver configuration
#

config TOUCHSCREEN_FTS_I2C
    tristate "Focaltech Touchscreen I2c"
    default m
    help
      Say Y here if you have Focaltech touch panel.
      If unsure, say N.

config TOUCHSCREEN_FACTORY_DEBUG
    tristate "touchscreen for factory test"
    default n
    help
      Say y here if you have chipone TDDI touch panel.
```

## T8123B/kernel-5.10/drivers/input/touchscreen/focaltech_touch_ft8201p_spi/Kconfig
```kconfig
#
# Focaltech Touchscreen driver configuration
#

config TOUCHSCREEN_FTS_COMMON
    tristate "Focaltech Touchscreen"
    depends on TOUCHSCREEN_FTS_FT8205P_SPI
    default m
    help
      Say Y here if you have Focaltech touch panel.
      If unsure, say N.

config TOUCHSCREEN_FACTORY_DEBUG
	tristate "touchscreen for factory test"
	default n
	help
	  Say y here if you have chipone TDDI touch panel.
```

## T8123B/kernel-5.10/drivers/input/touchscreen/jadard_ts/Kconfig
```kconfig
config TOUCHSCREEN_JADARD_TS
	tristate "JADARD touchscreen for Mediatek package"
	default n
	help
	  Say y here if you have JADARD touch panel.
	  If unsure, say N.
```

## T8123B/kernel-5.10/drivers/misc/mediatek/pogo/Kconfig
```kconfig
config CUSTOM_MTK_KERNEL_POGO
	tristate "MediaTek USB POGO Support"
	default n
	help
	  pogo keypad for MTK pakage.
```

## T8123B/kernel-5.10/drivers/misc/mediatek/sensors-1.0/accelerometer/msa321/Kconfig
```kconfig
config MTK_MSA321
	bool "MTK_MSA321 for MediaTek package"
	help
	  The MSA321 is a highly integrated,
	  low power internal measurement unit
	  that provides precise acceleration
	  measurement.
	  this config will turn on accelerometer feature.
```

## T8123B/kernel-5.10/drivers/misc/mediatek/sensors-1.0/alsps/ls981x/Kconfig
```kconfig
config MTK_LS981X
	bool "ls981x for MediaTek package"
	help
	  It support different type sensor
	  in this platform. If this option
	  is set, it will support ambient
	  and light sensor ls981x.
```
