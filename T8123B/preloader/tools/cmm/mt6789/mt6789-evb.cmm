;*****************************************************************************
;  Copyright Statement:
;  --------------------
;  This software is protected by Copyright and the information contained
;  herein is confidential. The software may not be copied and the information
;  contained herein may not be used or disclosed except with the written
;  permission of MediaTek Inc. (C) 2011
;
;*****************************************************************************

;=================================================
; Specify Core Number
;=================================================

&NR_CPUS=1
; cluster 0 corebase: 0x8007000, 0x8007200, 0x8007400, 0x8007600
; cluster 1 corebase: 0x8009000, 0x8009200, 0x8009400, 0x8009600

;=================================================
; Initialize CPU
;=================================================
SYStem.RESet;
SYStem.Option ENRESET ON;
SYStem.Option ResBreak OFF;
SYStem.Option WaitReset 100.ms;

SYStem.JtagClock 10.MHz;

SYStem.CPU Ananke;


if &NR_CPUS==1
(
    SYStem.CONFIG CORENUMBER 1;
    SYStem.CONFIG COREBASE 0x8E010000;
    SYStem.CONFIG CTIBASE 0x8E020000;
)
;=================================================
; Attach and Stop CPU
;=================================================
SYSTEM.UP

SETUP.IMASKHLL ON
SETUP.IMASKASM ON

;=================================================
; Initialize EMI
;=================================================
&init_emi=0 ; 0: not init
            ; 1: init
IF &init_emi==1
(
    do mt6789_FPGA_DDR.cmm
)
;=================================================
; register
;=================================================
&RGU=0x10007000

;=================================================
; disable wdt (debug purpose)
;=================================================
D.S SD:&RGU+0x0000 %LE %LONG 0x22000064

; for pmic power latch (RGU + 0xA4)
D.S SD:&RGU+0x00A4 %LE %LONG 0x66000001

;=================================================
; L3C share sram init
;=================================================
; Turn off MMU
PER.SET.FIELD SPR:0x30100 %LONG 0x1 0

; L3C share enable
; 0: L3C half share. 1: L3C full share
&FULL_SHARE=1
&ENABLE_SHARE_SRAM=1
do cache_sharing.cmm

;=================================================
; Load Preloader Symbol
;=================================================
Y.SPATH.RESET ; reset all source path
Y.SPATH.SRD ../../../platform/mt6789/src/init
Y.SPATH.SRD ../../../platform/mt6789/src/core
Y.SPATH.SRD ../../../platform/mt6789/src/drivers
Y.SPATH.SRD ../../../platform/mt6789/src/security
Y.SPATH.SRD ../../../platform/common
Y.SPATH.SRD ../../../platform/common/bootctrl
Y.SPATH.SRD ../../../platform/common/emimpu
Y.SPATH.SRD ../../../platform/common/loader
Y.SPATH.SRD ../../../platform/common/mblock
Y.SPATH.SRD ../../../platform/common/partition
Y.SPATH.SRD ../../../platform/common/storage/intf
Y.SPATH.SRD ../../../platform/common/storage/mmc
Y.SPATH.SRD ../../../platform/common/storage/ufs
Y.SPATH.SRD ../../../platform/common/trustzone
Y.SPATH.SRD ../../../platform/common/uart
Y.SPATH.SRD ../../../platform/common/watchdog/wdt_v2
Y.SPATH.SRD ../../../custom/evb6789_64

Break.Select Program OnChip
Break.Select Hll OnChip
Break.Select Spot OnChip
Break.Select Read OnChip
Break.Select Write OnChip

R.S T 0

print "loading pre-loader image"
d.load.elf ../../../../../../../../../out/target/product/evb6789_64/obj/PRELOADER_OBJ/bin/preloader_evb6789_64.elf
r.s pc 0x0201000

;winclear
d.l
;go
enddo
