;DRAMC brocast on
D.S SD:0x100010B4 %LE %LONG 0x0000007f;
;EMI setting 1

d.s c:0x10002050 %le %long 0x0 ;disable dispatch
D.S SD:0x10219000 %LE %LONG 0xA053A054; ;1ch
;D.S SD:0x10219000 %LE %LONG 0xA053A154; ;2ch
D.S SD:0x10219020 %LE %LONG 0x00000000;
D.S SD:0x10219038 %LE %LONG 0x00000030;
;D.S SD:0x1021903c %LE %LONG 0x00000010;
D.S SD:0x1021903c %LE %LONG 0x00000000;
D.S SD:0x10235000 %LE %LONG 0x0400A051;
D.S SD:0x1023515c %LE %LONG 0x82410222;
D.S SD:0x10235048 %LE %LONG 0x00020027;
D.S SD:0x102190E8 %LE %LONG 0x00000020;
							   

;DRAMC brocast off
D.S SD:0x100010B4 %LE %LONG 0x00000000;




;line   500, init_golden_mini_dpy_init_flow_vseq
D.S SD:0x102384a0 %LE %LONG 0x00180101;


D.S SD:0x10238640 %LE %LONG 0x01001180;
D.S SD:0x10238640 %LE %LONG 0x81001180;
D.S SD:0x102384a0 %LE %LONG 0x00080101;
;broadcast_on();
D.S SD:0x100010B4 %LE %LONG 0x0000007f;
D.S SD:0x10238534 %LE %LONG 0x00200000;
D.S SD:0x10238160 %LE %LONG 0x00000000;
D.S SD:0x102382e0 %LE %LONG 0x00000000;
D.S SD:0x10238460 %LE %LONG 0x00000000;
D.S SD:0x10238534 %LE %LONG 0x002007fa;
D.S SD:0x10238160 %LE %LONG 0x1ffe2310;
D.S SD:0x102382e0 %LE %LONG 0x1ffe2310;
D.S SD:0x10238460 %LE %LONG 0x1ffea33e;
D.S SD:0x10238534 %LE %LONG 0x002007fa;
D.S SD:0x10238160 %LE %LONG 0xfffe6310;
D.S SD:0x102382e0 %LE %LONG 0xfffe6310;
D.S SD:0x10238460 %LE %LONG 0xfffee33e;
D.S SD:0x10238534 %LE %LONG 0x0021c7fa;
D.S SD:0x10238508 %LE %LONG 0x000bbb10;
;broadcast_off();
D.S SD:0x100010B4 %LE %LONG 0x00000000;
D.S SD:0x10238460 %LE %LONG 0xfffef33e;
D.S SD:0x10248460 %LE %LONG 0xfffee33e;
;broadcast_on();
D.S SD:0x100010B4 %LE %LONG 0x0000007f;
D.S SD:0x10238da4 %LE %LONG 0x333f3f00;
D.S SD:0x1023847c %LE %LONG 0xff40c000;
D.S SD:0x1023848c %LE %LONG 0x00214040;
D.S SD:0x10238bb8 %LE %LONG 0x00500020;
D.S SD:0x10238b70 %LE %LONG 0x00000000;
D.S SD:0x10238b98 %LE %LONG 0x0000020c;
D.S SD:0x10238b80 %LE %LONG 0x00020000;
D.S SD:0x1023817c %LE %LONG 0x00000000;
D.S SD:0x1023818c %LE %LONG 0x00244040;
D.S SD:0x102388b8 %LE %LONG 0x00000020;
D.S SD:0x10238870 %LE %LONG 0x00000000;
D.S SD:0x10238898 %LE %LONG 0x0000020c;
D.S SD:0x10238880 %LE %LONG 0x00020000;
D.S SD:0x102382fc %LE %LONG 0x00000000;
D.S SD:0x1023830c %LE %LONG 0x00244040;
D.S SD:0x10238a38 %LE %LONG 0x00000020;
D.S SD:0x102389f0 %LE %LONG 0x00000000;
D.S SD:0x10238a18 %LE %LONG 0x0000020c;
D.S SD:0x10238a00 %LE %LONG 0x00020000;
D.S SD:0x10238bb8 %LE %LONG 0x00500020;
D.S SD:0x10238bb4 %LE %LONG 0x00000000;
D.S SD:0x1023887c %LE %LONG 0x00000001;
D.S SD:0x10238b7c %LE %LONG 0x00000000;
D.S SD:0x102388b4 %LE %LONG 0x00048009;
D.S SD:0x102389fc %LE %LONG 0x00000001;
D.S SD:0x10238a34 %LE %LONG 0x00048009;
D.S SD:0x102388b8 %LE %LONG 0x00000020;
D.S SD:0x10238a38 %LE %LONG 0x00000020;
D.S SD:0x1023848c %LE %LONG 0x00200000;
D.S SD:0x10238b6c %LE %LONG 0x00000000;
D.S SD:0x102388b0 %LE %LONG 0x001e0000;
D.S SD:0x1023818c %LE %LONG 0x00210040;
D.S SD:0x10238180 %LE %LONG 0x00000402;
D.S SD:0x1023818c %LE %LONG 0x00211040;
D.S SD:0x10238a30 %LE %LONG 0x001e0000;
D.S SD:0x1023830c %LE %LONG 0x00210040;
D.S SD:0x10238300 %LE %LONG 0x00000402;
D.S SD:0x1023830c %LE %LONG 0x00211040;
D.S SD:0x10238d68 %LE %LONG 0x0b8b0000;
D.S SD:0x10238b9c %LE %LONG 0x22d2ece2;
D.S SD:0x10238494 %LE %LONG 0x00012000;
D.S SD:0x1023889c %LE %LONG 0x10e69bf3;
D.S SD:0x10238194 %LE %LONG 0x00002000;
D.S SD:0x10238a1c %LE %LONG 0x40318b99;
D.S SD:0x10238314 %LE %LONG 0x00002000;
D.S SD:0x1023886c %LE %LONG 0x0000000e;
D.S SD:0x102389ec %LE %LONG 0x0000000e;
D.S SD:0x10238b6c %LE %LONG 0x00000000;
D.S SD:0x10238da0 %LE %LONG 0x00430007;
D.S SD:0x10238540 %LE %LONG 0x40000008;
D.S SD:0x10238540 %LE %LONG 0x40000008;
D.S SD:0x10238540 %LE %LONG 0x40000008;
D.S SD:0x10238d44 %LE %LONG 0x80080004;
D.S SD:0x10238188 %LE %LONG 0x01021001;
D.S SD:0x1023818c %LE %LONG 0x10211040;
D.S SD:0x10238308 %LE %LONG 0x01021001;
D.S SD:0x1023830c %LE %LONG 0x10211040;
D.S SD:0x10238480 %LE %LONG 0x0000000c;
D.S SD:0x10238498 %LE %LONG 0x00000051;
D.S SD:0x10238180 %LE %LONG 0x0000040e;
D.S SD:0x10238198 %LE %LONG 0x00000051;
D.S SD:0x10238300 %LE %LONG 0x0000040e;
D.S SD:0x10238318 %LE %LONG 0x00000051;
D.S SD:0x10238d3c %LE %LONG 0x00000020;
D.S SD:0x10238884 %LE %LONG 0x00000000;
D.S SD:0x10238a04 %LE %LONG 0x00000000;
D.S SD:0x10238b84 %LE %LONG 0x000a0000;
D.S SD:0x10238744 %LE %LONG 0x00000011;
D.S SD:0x10238000 %LE %LONG 0x00000000;
D.S SD:0x10238004 %LE %LONG 0x00000010;
D.S SD:0x10238704 %LE %LONG 0x5b000002;
D.S SD:0x10238724 %LE %LONG 0x5b000002;
D.S SD:0x10238708 %LE %LONG 0x00040000;
D.S SD:0x10238728 %LE %LONG 0x00040000;
D.S SD:0x10238700 %LE %LONG 0xe57800fe;
D.S SD:0x10238720 %LE %LONG 0xe57800fe;
D.S SD:0x1023870c %LE %LONG 0x00001223;
D.S SD:0x1023872c %LE %LONG 0x00000023;
D.S SD:0x10238008 %LE %LONG 0x00010000;
D.S SD:0x10238000 %LE %LONG 0x80000000;
D.S SD:0x10238740 %LE %LONG 0x00005f53;
D.S SD:0x10230340 %LE %LONG 0x0003ffff;
D.S SD:0x10238d98 %LE %LONG 0x00000002;
D.S SD:0x102388bc %LE %LONG 0x00000002;
D.S SD:0x10238a3c %LE %LONG 0x00000002;
D.S SD:0x10238bbc %LE %LONG 0x00000002;
D.S SD:0x10238ba4 %LE %LONG 0x00020400;
D.S SD:0x102388a4 %LE %LONG 0x00020400;
D.S SD:0x10238a24 %LE %LONG 0x00020400;
;broadcast_off();
D.S SD:0x100010B4 %LE %LONG 0x00000000;
D.S SD:0x10238b74 %LE %LONG 0x00c00704;
D.S SD:0x10248b74 %LE %LONG 0x00c01f04;
;broadcast_on();
D.S SD:0x100010B4 %LE %LONG 0x0000007f;
D.S SD:0x10238874 %LE %LONG 0x00c01d04;
D.S SD:0x102389f4 %LE %LONG 0x00c01804;
D.S SD:0x1023846c %LE %LONG 0x00000008;
D.S SD:0x10238494 %LE %LONG 0x0001a000;
D.S SD:0x1023816c %LE %LONG 0x00000008;
D.S SD:0x10238194 %LE %LONG 0x0000a000;
D.S SD:0x102382ec %LE %LONG 0x00000008;
D.S SD:0x10238314 %LE %LONG 0x0000a000;
D.S SD:0x10238008 %LE %LONG 0x00610000;
D.S SD:0x10238470 %LE %LONG 0x00200000;
D.S SD:0x10238ba4 %LE %LONG 0x00000800;
D.S SD:0x102388a4 %LE %LONG 0x00000000;
D.S SD:0x10238a24 %LE %LONG 0x00000000;
D.S SD:0x10238ba8 %LE %LONG 0x000ba000;
D.S SD:0x102388a8 %LE %LONG 0x000ae800;
D.S SD:0x10238a28 %LE %LONG 0x000ae800;
;broadcast_off();
D.S SD:0x100010B4 %LE %LONG 0x00000000;
D.S SD:0x10238478 %LE %LONG 0x60000000;
D.S SD:0x10238178 %LE %LONG 0x70000000;
D.S SD:0x102382f8 %LE %LONG 0x70000000;
D.S SD:0x10248478 %LE %LONG 0x70000000;
D.S SD:0x10248178 %LE %LONG 0x70000000;
D.S SD:0x102482f8 %LE %LONG 0x70000000;
D.S SD:0x10238b94 %LE %LONG 0x00707000;
D.S SD:0x10248b94 %LE %LONG 0x00707000;
D.S SD:0x10238b98 %LE %LONG 0x00007a1c;
D.S SD:0x10248b98 %LE %LONG 0x00007a1c;
D.S SD:0x10238b78 %LE %LONG 0x00001071;
D.S SD:0x10248b78 %LE %LONG 0x00001071;
D.S SD:0x10238b98 %LE %LONG 0x00007e1c;
D.S SD:0x10248b98 %LE %LONG 0x00007e1c;
D.S SD:0x10238b94 %LE %LONG 0x04707000;
D.S SD:0x10248b94 %LE %LONG 0x04707000;
;broadcast_on();
D.S SD:0x100010B4 %LE %LONG 0x0000007f;
D.S SD:0x10238894 %LE %LONG 0x04707000;
D.S SD:0x10238898 %LE %LONG 0x00007e1c;
D.S SD:0x10238878 %LE %LONG 0x00003071;
D.S SD:0x10238a14 %LE %LONG 0x04707000;
D.S SD:0x10238a18 %LE %LONG 0x00007e1c;
D.S SD:0x102389f8 %LE %LONG 0x00003071;
;broadcast_off();
D.S SD:0x100010B4 %LE %LONG 0x00000000;
D.S SD:0x10238b8c %LE %LONG 0x3fc0417e;
D.S SD:0x10248b8c %LE %LONG 0x656736cf;
;broadcast_on();
D.S SD:0x100010B4 %LE %LONG 0x0000007f;
D.S SD:0x1023888c %LE %LONG 0xb942ad20;
D.S SD:0x10238a0c %LE %LONG 0x3fd57559;
D.S SD:0x1023851c %LE %LONG 0x00059003;
;broadcast_off();
D.S SD:0x100010B4 %LE %LONG 0x00000000;
D.S SD:0x1024851c %LE %LONG 0x000d9003;
;broadcast_on();
D.S SD:0x100010B4 %LE %LONG 0x0000007f;
D.S SD:0x102384ec %LE %LONG 0x00000102;
D.S SD:0x102384ec %LE %LONG 0x00000100;
D.S SD:0x102384ec %LE %LONG 0x00000111;
D.S SD:0x102384ec %LE %LONG 0x00000110;
D.S SD:0x102384ec %LE %LONG 0x00000190;
D.S SD:0x102384ec %LE %LONG 0x20000190;
;broadcast_off();
D.S SD:0x100010B4 %LE %LONG 0x00000000;
D.S SD:0x10238b98 %LE %LONG 0x00017e1c;
D.S SD:0x10248b98 %LE %LONG 0x00017e1c;
;broadcast_on();
D.S SD:0x100010B4 %LE %LONG 0x0000007f;
D.S SD:0x10238898 %LE %LONG 0x00017e1c;
D.S SD:0x10238a18 %LE %LONG 0x00017e1c;
D.S SD:0x10238748 %LE %LONG 0x00000001;
D.S SD:0x10230340 %LE %LONG 0x00000000;
D.S SD:0x102301fc %LE %LONG 0x80000006;
;line 6199, END
;line 6201, init_golden_mini_freq_related_vseq_0
D.S SD:0x102384ec %LE %LONG 0x20030190;
D.S SD:0x10238d48 %LE %LONG 0x3c3f0fc3;
D.S SD:0x10238d4c %LE %LONG 0xbc3f0fc3;
D.S SD:0x10238d50 %LE %LONG 0x02208822;
D.S SD:0x10238d54 %LE %LONG 0x02208822;
D.S SD:0x10238ce0 %LE %LONG 0x1e031e03;
D.S SD:0x10238ce4 %LE %LONG 0x00001e03;
D.S SD:0x10238d5c %LE %LONG 0x00000008;
D.S SD:0x10238d44 %LE %LONG 0x80480002;
D.S SD:0x10238b90 %LE %LONG 0x3f302100;
D.S SD:0x10238d0c %LE %LONG 0x00700000;
D.S SD:0x10238d7c %LE %LONG 0x010ff049;
D.S SD:0x10238d38 %LE %LONG 0x00080809;
D.S SD:0x10238d24 %LE %LONG 0x00108500;
D.S SD:0x10238d20 %LE %LONG 0x30018010;
D.S SD:0x10238d8c %LE %LONG 0x00000222;
D.S SD:0x10238be0 %LE %LONG 0x00000002;
D.S SD:0x10238c60 %LE %LONG 0x00000002;
D.S SD:0x102387a0 %LE %LONG 0x00190009;
D.S SD:0x10238820 %LE %LONG 0x00190009;
D.S SD:0x10238920 %LE %LONG 0x00190009;
D.S SD:0x102389a0 %LE %LONG 0x00190009;
D.S SD:0x10238d28 %LE %LONG 0xe0000010;
D.S SD:0x10238884 %LE %LONG 0x13008000;
D.S SD:0x10238a04 %LE %LONG 0x13008000;
D.S SD:0x102387a4 %LE %LONG 0x00000003;
D.S SD:0x10238824 %LE %LONG 0x00000003;
D.S SD:0x10238924 %LE %LONG 0x00000003;
D.S SD:0x102389a4 %LE %LONG 0x00000003;
D.S SD:0x1023168c %LE %LONG 0x00000030;
D.S SD:0x10238d78 %LE %LONG 0x00000111;
D.S SD:0x10238be8 %LE %LONG 0x0000bfe0;
D.S SD:0x10238c68 %LE %LONG 0x0000bfe0;
D.S SD:0x10238798 %LE %LONG 0x00000919;
D.S SD:0x10238918 %LE %LONG 0x00000919;
D.S SD:0x10238818 %LE %LONG 0x00000919;
D.S SD:0x10238998 %LE %LONG 0x00000919;
D.S SD:0x1023879c %LE %LONG 0x00000919;
D.S SD:0x1023891c %LE %LONG 0x00000919;
D.S SD:0x1023881c %LE %LONG 0x00000919;
D.S SD:0x1023899c %LE %LONG 0x00000919;
D.S SD:0x10231610 %LE %LONG 0x80425080;
D.S SD:0x102316ac %LE %LONG 0x80002013;
D.S SD:0x10231230 %LE %LONG 0x00000011;
D.S SD:0x10231430 %LE %LONG 0x00000011;
D.S SD:0x102316a8 %LE %LONG 0x00000000;
D.S SD:0x10231280 %LE %LONG 0x11111122;
D.S SD:0x10231284 %LE %LONG 0x11661111;
D.S SD:0x10231480 %LE %LONG 0x11111122;
D.S SD:0x10231484 %LE %LONG 0x11661111;
D.S SD:0x10231200 %LE %LONG 0x11111122;
D.S SD:0x10231204 %LE %LONG 0x11111122;
D.S SD:0x10231208 %LE %LONG 0x11771122;
D.S SD:0x1023120c %LE %LONG 0x11771122;
D.S SD:0x10231400 %LE %LONG 0x11111122;
D.S SD:0x10231404 %LE %LONG 0x11111122;
D.S SD:0x10231408 %LE %LONG 0x11771122;
D.S SD:0x1023140c %LE %LONG 0x11771122;
D.S SD:0x1023888c %LE %LONG 0xb940ad20;
D.S SD:0x10238a0c %LE %LONG 0x3fd17559;
D.S SD:0x10231618 %LE %LONG 0x00000000;
D.S SD:0x1023161c %LE %LONG 0x00010000;
D.S SD:0x10231620 %LE %LONG 0x00000000;
D.S SD:0x10231624 %LE %LONG 0x00000000;
D.S SD:0x10231628 %LE %LONG 0x11111011;
D.S SD:0x1023162c %LE %LONG 0x01000111;
D.S SD:0x10231630 %LE %LONG 0x11111111;
D.S SD:0x10231634 %LE %LONG 0x11111111;
D.S SD:0x10231668 %LE %LONG 0x03010000;
D.S SD:0x1023166c %LE %LONG 0x00000102;
D.S SD:0x10231670 %LE %LONG 0x00000080;
D.S SD:0x10231608 %LE %LONG 0x30000030;
D.S SD:0x10231614 %LE %LONG 0x00006400;
D.S SD:0x10231664 %LE %LONG 0x1c8504a6;
D.S SD:0x10231660 %LE %LONG 0x04030303;
D.S SD:0x10231644 %LE %LONG 0x23010604;
D.S SD:0x10231648 %LE %LONG 0x00000132;
D.S SD:0x1023164c %LE %LONG 0x00040040;
D.S SD:0x10231650 %LE %LONG 0x00004409;
D.S SD:0x10231654 %LE %LONG 0x0c051c3b;
D.S SD:0x10231658 %LE %LONG 0x00060808;
D.S SD:0x1023165c %LE %LONG 0x24602305;
D.S SD:0x10231678 %LE %LONG 0x03111001;
D.S SD:0x102316a4 %LE %LONG 0x00070002;
D.S SD:0x10238888 %LE %LONG 0x0120004a;
D.S SD:0x10238a08 %LE %LONG 0x0120004a;
D.S SD:0x1023886c %LE %LONG 0x0060000e;
D.S SD:0x102389ec %LE %LONG 0x0060000e;
D.S SD:0x10238774 %LE %LONG 0x5e5e5e5e;
D.S SD:0x10238778 %LE %LONG 0x5e5e5e5e;
D.S SD:0x1023877c %LE %LONG 0x5e5e5e5e;
D.S SD:0x10238780 %LE %LONG 0x5e5e5e5e;
D.S SD:0x10238784 %LE %LONG 0x00005e5e;
D.S SD:0x10238788 %LE %LONG 0x00a500a5;
D.S SD:0x102387f4 %LE %LONG 0xfcfcfcfc;
D.S SD:0x102387f8 %LE %LONG 0xfcfcfcfc;
D.S SD:0x102387fc %LE %LONG 0xfcfcfcfc;
D.S SD:0x10238800 %LE %LONG 0xfcfcfcfc;
D.S SD:0x10238804 %LE %LONG 0x0000fcfc;
D.S SD:0x10238808 %LE %LONG 0x013e013e;
D.S SD:0x102388f4 %LE %LONG 0xd0d0d0d0;
D.S SD:0x102388f8 %LE %LONG 0xd0d0d0d0;
D.S SD:0x102388fc %LE %LONG 0xd0d0d0d0;
D.S SD:0x10238900 %LE %LONG 0xd0d0d0d0;
D.S SD:0x10238904 %LE %LONG 0x0000d0d0;
D.S SD:0x10238908 %LE %LONG 0x01140114;
D.S SD:0x10238974 %LE %LONG 0x98989898;
D.S SD:0x10238978 %LE %LONG 0x98989898;
D.S SD:0x1023897c %LE %LONG 0x98989898;
D.S SD:0x10238980 %LE %LONG 0x98989898;
D.S SD:0x10238984 %LE %LONG 0x00009898;
D.S SD:0x10238988 %LE %LONG 0x00e000e0;
D.S SD:0x10238198 %LE %LONG 0x00000050;
D.S SD:0x10238318 %LE %LONG 0x00000050;
D.S SD:0x10238198 %LE %LONG 0x00000051;
D.S SD:0x10238318 %LE %LONG 0x00000051;
D.S SD:0x10238184 %LE %LONG 0x1e1e6a6a;
D.S SD:0x10238304 %LE %LONG 0x10105c5c;
D.S SD:0x10238188 %LE %LONG 0x03021001;
D.S SD:0x10238308 %LE %LONG 0x03021001;
D.S SD:0x10231604 %LE %LONG 0x00001411;
D.S SD:0x10231604 %LE %LONG 0x00000411;
D.S SD:0x10231674 %LE %LONG 0x80000036;
D.S SD:0x10231610 %LE %LONG 0xa0425080;
D.S SD:0x102316a0 %LE %LONG 0x000800bf;
D.S SD:0x10231600 %LE %LONG 0x00000012;
D.S SD:0x1023160c %LE %LONG 0x00000004;
D.S SD:0x10231688 %LE %LONG 0x1c100220;
D.S SD:0x102316c8 %LE %LONG 0x01107933;
D.S SD:0x10238d88 %LE %LONG 0x00000002;
D.S SD:0x10231260 %LE %LONG 0x00000000;
D.S SD:0x10238d88 %LE %LONG 0x00000052;
D.S SD:0x10238d18 %LE %LONG 0x03009800;
D.S SD:0x10238d14 %LE %LONG 0x00004000;
D.S SD:0x10238d14 %LE %LONG 0x00004310;
D.S SD:0x10238be4 %LE %LONG 0x00000000;
D.S SD:0x10238c64 %LE %LONG 0x00000000;
D.S SD:0x10238d2c %LE %LONG 0x000d0419;
D.S SD:0x10238d30 %LE %LONG 0x00000010;
D.S SD:0x10238d20 %LE %LONG 0x30018010;
D.S SD:0x10231264 %LE %LONG 0x00000001;
D.S SD:0x10231464 %LE %LONG 0x00000001;
D.S SD:0x102316a0 %LE %LONG 0x000800bf;
D.S SD:0x10238884 %LE %LONG 0x13008000;
D.S SD:0x10238a04 %LE %LONG 0x13008000;
D.S SD:0x10231688 %LE %LONG 0x1c100220;
D.S SD:0x1023163c %LE %LONG 0x0008000d;
D.S SD:0x10231640 %LE %LONG 0x3600000d;
D.S SD:0x10231640 %LE %LONG 0x0b00000d;
D.S SD:0x10231638 %LE %LONG 0x00120002;
D.S SD:0x102316b0 %LE %LONG 0x202b1820;
D.S SD:0x102316b4 %LE %LONG 0x00000000;
D.S SD:0x102316b8 %LE %LONG 0x00000000;
D.S SD:0x10238d1c %LE %LONG 0x004302b1;
D.S SD:0x10238da0 %LE %LONG 0x00020007;
D.S SD:0x10238da4 %LE %LONG 0x334f3000;
D.S SD:0x10238da0 %LE %LONG 0x00020007;
D.S SD:0x10238d80 %LE %LONG 0x00000000;
;broadcast_off();
D.S SD:0x100010B4 %LE %LONG 0x00000000;
D.S SD:0x10238d64 %LE %LONG 0x00000000;
D.S SD:0x10248d64 %LE %LONG 0x00000000;
;broadcast_on();
D.S SD:0x100010B4 %LE %LONG 0x0000007f;
D.S SD:0x10231694 %LE %LONG 0xffff0006;
D.S SD:0x10231690 %LE %LONG 0x00040111;
D.S SD:0x10231228 %LE %LONG 0x0b060b06;
D.S SD:0x10231428 %LE %LONG 0x0b060b06;
D.S SD:0x1023122c %LE %LONG 0x00c50128;
D.S SD:0x1023142c %LE %LONG 0x00c50128;
D.S SD:0x10231688 %LE %LONG 0x0c100220;
D.S SD:0x10231684 %LE %LONG 0x00000200;
D.S SD:0x1023169c %LE %LONG 0xf8000000;
D.S SD:0x1023169c %LE %LONG 0xf8000005;
D.S SD:0x10231614 %LE %LONG 0x00016400;
D.S SD:0x102316d4 %LE %LONG 0x00000005;
D.S SD:0x10230220 %LE %LONG 0x000001c0;
D.S SD:0x102302d8 %LE %LONG 0x000000c0;
D.S SD:0x10230128 %LE %LONG 0x04000000;
D.S SD:0x10238884 %LE %LONG 0x13008f00;
D.S SD:0x10238a04 %LE %LONG 0x13008f00;
D.S SD:0x10238880 %LE %LONG 0x00020080;
D.S SD:0x10238a00 %LE %LONG 0x00020080;
D.S SD:0x102384ec %LE %LONG 0x20000190;
;line 9280, END
;line 9282, init_golden_mini_common_settings_vseq
D.S SD:0x102384f4 %LE %LONG 0x006003bf;
D.S SD:0x102384f4 %LE %LONG 0x006003be;
D.S SD:0x102384f4 %LE %LONG 0x006003bf;
D.S SD:0x102384f4 %LE %LONG 0x006003be;
D.S SD:0x102384f4 %LE %LONG 0x006003af;
D.S SD:0x1023863c %LE %LONG 0x38000003;
D.S SD:0x10238664 %LE %LONG 0x00000101;
D.S SD:0x10238630 %LE %LONG 0x01000000;
D.S SD:0x10238498 %LE %LONG 0x00000051;
D.S SD:0x10238198 %LE %LONG 0x000004d1;
D.S SD:0x10238318 %LE %LONG 0x000004d1;
D.S SD:0x10238664 %LE %LONG 0x00000101;
D.S SD:0x10238640 %LE %LONG 0x81001180;
D.S SD:0x102388b4 %LE %LONG 0x0004800d;
D.S SD:0x10238878 %LE %LONG 0x00033071;
D.S SD:0x10238a34 %LE %LONG 0x0004800d;
D.S SD:0x102389f8 %LE %LONG 0x00033071;
D.S SD:0x10238bb4 %LE %LONG 0x00000000;
D.S SD:0x10238b78 %LE %LONG 0x00001071;
D.S SD:0x10238170 %LE %LONG 0x00000000;
D.S SD:0x102382f0 %LE %LONG 0x00000000;
D.S SD:0x10238470 %LE %LONG 0x00200000;
D.S SD:0x10238618 %LE %LONG 0x00705000;
D.S SD:0x10238498 %LE %LONG 0x00000051;
D.S SD:0x10238198 %LE %LONG 0x000000d1;
D.S SD:0x10238318 %LE %LONG 0x000000d1;
D.S SD:0x10238880 %LE %LONG 0x00020083;
D.S SD:0x1023887c %LE %LONG 0x0000800d;
D.S SD:0x10238878 %LE %LONG 0x00033071;
D.S SD:0x10238a00 %LE %LONG 0x00020083;
D.S SD:0x102389fc %LE %LONG 0x0000800d;
D.S SD:0x102389f8 %LE %LONG 0x00033071;
D.S SD:0x10238b80 %LE %LONG 0x00020000;
D.S SD:0x10238b7c %LE %LONG 0x00000000;
D.S SD:0x10238b78 %LE %LONG 0x00001071;
D.S SD:0x1023819c %LE %LONG 0x00000001;
D.S SD:0x1023831c %LE %LONG 0x00000001;
D.S SD:0x10238514 %LE %LONG 0x00000120;
D.S SD:0x10238654 %LE %LONG 0x00020002;
D.S SD:0x102384e4 %LE %LONG 0x00010305;
D.S SD:0x102384e8 %LE %LONG 0x00100004;
D.S SD:0x102384e4 %LE %LONG 0x00010305;
D.S SD:0x1023818c %LE %LONG 0x102110c0;
D.S SD:0x1023830c %LE %LONG 0x102110c0;
D.S SD:0x102384e8 %LE %LONG 0x00110004;
D.S SD:0x10238198 %LE %LONG 0x000000f1;
D.S SD:0x10238318 %LE %LONG 0x000000f1;
D.S SD:0x1023887c %LE %LONG 0x0000810d;
D.S SD:0x102389fc %LE %LONG 0x0000810d;
D.S SD:0x102384e4 %LE %LONG 0x00010325;
D.S SD:0x1023818c %LE %LONG 0x102190c0;
D.S SD:0x1023830c %LE %LONG 0x102190c0;
D.S SD:0x102384e0 %LE %LONG 0xb0100000;
D.S SD:0x102384e8 %LE %LONG 0x001d0004;
D.S SD:0x102381a4 %LE %LONG 0x10000000;
D.S SD:0x10238324 %LE %LONG 0x10000000;
D.S SD:0x1023818c %LE %LONG 0x102190c0;
D.S SD:0x1023830c %LE %LONG 0x102190c0;
D.S SD:0x10238198 %LE %LONG 0x001000f1;
D.S SD:0x10238318 %LE %LONG 0x001000f1;
D.S SD:0x102384e0 %LE %LONG 0xbc100001;
D.S SD:0x102384e4 %LE %LONG 0x00010375;
D.S SD:0x1023863c %LE %LONG 0x38000003;
D.S SD:0x102384e0 %LE %LONG 0xbc120001;
D.S SD:0x10238640 %LE %LONG 0x81001180;
D.S SD:0x10230000 %LE %LONG 0x00000100;
D.S SD:0x10230000 %LE %LONG 0x00080100;
D.S SD:0x10230310 %LE %LONG 0x00000800;
D.S SD:0x10230310 %LE %LONG 0x00000808;
D.S SD:0x10230310 %LE %LONG 0x00000828;
D.S SD:0x10230240 %LE %LONG 0x6000009c;
D.S SD:0x10230264 %LE %LONG 0x05714000;
D.S SD:0x10230170 %LE %LONG 0x00000082;
D.S SD:0x1023024c %LE %LONG 0x34082001;
D.S SD:0x10230190 %LE %LONG 0x00200000;
D.S SD:0x102384e0 %LE %LONG 0xbc120001;
D.S SD:0x10230258 %LE %LONG 0x00000080;
D.S SD:0x10230330 %LE %LONG 0x00000001;
D.S SD:0x10230190 %LE %LONG 0x00200001;
D.S SD:0x10230260 %LE %LONG 0x01340000;
D.S SD:0x102301fc %LE %LONG 0x80000006;
D.S SD:0x10230168 %LE %LONG 0x00588780;
D.S SD:0x1023017c %LE %LONG 0x00000161;
D.S SD:0x1023017c %LE %LONG 0x00000161;
D.S SD:0x1023017c %LE %LONG 0x00000163;
D.S SD:0x10230204 %LE %LONG 0x81104c00;
D.S SD:0x102301a0 %LE %LONG 0x00000a56;
D.S SD:0x102301c8 %LE %LONG 0x00020000;
D.S SD:0x102301fc %LE %LONG 0xc0000007;
D.S SD:0x102384e8 %LE %LONG 0x401d0004;
D.S SD:0x10230500 %LE %LONG 0x00080000;
D.S SD:0x10230104 %LE %LONG 0x00000200;
D.S SD:0x10230108 %LE %LONG 0x12000880;
D.S SD:0x1023010c %LE %LONG 0x4000110d;
D.S SD:0x1023021c %LE %LONG 0x00000100;
D.S SD:0x10230204 %LE %LONG 0x81104c00;
D.S SD:0x10230228 %LE %LONG 0x00000000;
D.S SD:0x10230190 %LE %LONG 0x00200001;
D.S SD:0x10230250 %LE %LONG 0x81084000;
D.S SD:0x1023017c %LE %LONG 0x00000163;
D.S SD:0x10230264 %LE %LONG 0x05734000;
D.S SD:0x10230190 %LE %LONG 0x00200001;
D.S SD:0x10230168 %LE %LONG 0x00588780;
D.S SD:0x10230174 %LE %LONG 0x00000000;
D.S SD:0x10230284 %LE %LONG 0x00000002;
D.S SD:0x10230220 %LE %LONG 0x000001c4;
D.S SD:0x10230254 %LE %LONG 0x00004f00;
D.S SD:0x1023017c %LE %LONG 0x00000163;
D.S SD:0x10230258 %LE %LONG 0x00000080;
D.S SD:0x1023020c %LE %LONG 0x0000001a;
D.S SD:0x10230210 %LE %LONG 0x00010f05;
D.S SD:0x10230208 %LE %LONG 0x08300780;
D.S SD:0x10230168 %LE %LONG 0x00588780;
D.S SD:0x10230278 %LE %LONG 0x11155555;
D.S SD:0x10230150 %LE %LONG 0x08081800;
D.S SD:0x10230268 %LE %LONG 0x0003116d;
D.S SD:0x10230238 %LE %LONG 0x01400010;
D.S SD:0x10230238 %LE %LONG 0x01400050;
D.S SD:0x10230110 %LE %LONG 0x60028010;
D.S SD:0x10230178 %LE %LONG 0x00000038;
D.S SD:0x10230168 %LE %LONG 0x00588780;
D.S SD:0x10230268 %LE %LONG 0x0003116d;
D.S SD:0x10230248 %LE %LONG 0x090e0080;
D.S SD:0x10230208 %LE %LONG 0x00300780;
D.S SD:0x10230110 %LE %LONG 0x60428010;
D.S SD:0x10230114 %LE %LONG 0x001a0068;
D.S SD:0x10230208 %LE %LONG 0x00300780;
D.S SD:0x102301fc %LE %LONG 0xc0000007;
D.S SD:0x102301b0 %LE %LONG 0x00000000;
D.S SD:0x1023024c %LE %LONG 0x34082001;
D.S SD:0x10230168 %LE %LONG 0x00588780;
D.S SD:0x10230290 %LE %LONG 0x80000000;
D.S SD:0x1023024c %LE %LONG 0x36082001;
D.S SD:0x1023024c %LE %LONG 0x34082001;
D.S SD:0x10238640 %LE %LONG 0x8100118c;
D.S SD:0x10238490 %LE %LONG 0x00000000;
D.S SD:0x10238190 %LE %LONG 0x00000000;
D.S SD:0x10238310 %LE %LONG 0x00000000;
D.S SD:0x10238640 %LE %LONG 0x8100318c;
;line 15122, END
;line 16570, lp4_dram_init_vseq
D.S SD:0x102301a4 %LE %LONG 0x00000000;
D.S SD:0x10230220 %LE %LONG 0x000001c4;
D.S SD:0x1023056c %LE %LONG 0x00000001;
D.S SD:0x1023076c %LE %LONG 0x00000001;
D.S SD:0x10230204 %LE %LONG 0x81104c40;
D.S SD:0x10230204 %LE %LONG 0x81104c50;
D.S SD:0x10230128 %LE %LONG 0x04000d80;
D.S SD:0x10230124 %LE %LONG 0x00000000;
D.S SD:0x10230124 %LE %LONG 0x00000800;
D.S SD:0x10230124 %LE %LONG 0x00000000;
D.S SD:0x10230128 %LE %LONG 0x04000156;
D.S SD:0x10230124 %LE %LONG 0x00000000;
D.S SD:0x10230124 %LE %LONG 0x00000800;
D.S SD:0x10230124 %LE %LONG 0x00000000;
D.S SD:0x10230128 %LE %LONG 0x04000212;
D.S SD:0x10230124 %LE %LONG 0x00000000;
D.S SD:0x10230124 %LE %LONG 0x00000800;
D.S SD:0x10230124 %LE %LONG 0x00000000;
D.S SD:0x10230128 %LE %LONG 0x04000329;
D.S SD:0x10230124 %LE %LONG 0x00000000;
D.S SD:0x10230124 %LE %LONG 0x00000800;
D.S SD:0x10230124 %LE %LONG 0x00000000;
D.S SD:0x10230128 %LE %LONG 0x0400330e;
D.S SD:0x10230124 %LE %LONG 0x00000000;
D.S SD:0x10230124 %LE %LONG 0x00000800;
D.S SD:0x10230124 %LE %LONG 0x00000000;
D.S SD:0x10230128 %LE %LONG 0x04000d40;
D.S SD:0x10230124 %LE %LONG 0x00000000;
D.S SD:0x10230124 %LE %LONG 0x00000800;
D.S SD:0x10230124 %LE %LONG 0x00000000;
D.S SD:0x10230128 %LE %LONG 0x04000156;
D.S SD:0x10230124 %LE %LONG 0x00000000;
D.S SD:0x10230124 %LE %LONG 0x00000800;
D.S SD:0x10230124 %LE %LONG 0x00000000;
D.S SD:0x10230128 %LE %LONG 0x04000212;
D.S SD:0x10230124 %LE %LONG 0x00000000;
D.S SD:0x10230124 %LE %LONG 0x00000800;
D.S SD:0x10230124 %LE %LONG 0x00000000;
D.S SD:0x10230128 %LE %LONG 0x040003e9;
D.S SD:0x10230124 %LE %LONG 0x00000000;
D.S SD:0x10230124 %LE %LONG 0x00000800;
D.S SD:0x10230124 %LE %LONG 0x00000000;
D.S SD:0x10230128 %LE %LONG 0x04003300;
D.S SD:0x10230124 %LE %LONG 0x00000000;
D.S SD:0x10230124 %LE %LONG 0x00000800;
D.S SD:0x10230124 %LE %LONG 0x00000000;
D.S SD:0x10230128 %LE %LONG 0x04000d00;
D.S SD:0x10230124 %LE %LONG 0x00000000;
D.S SD:0x10230124 %LE %LONG 0x00000800;
D.S SD:0x10230124 %LE %LONG 0x00000000;
D.S SD:0x10230128 %LE %LONG 0x05000d80;
D.S SD:0x10230124 %LE %LONG 0x00000000;
D.S SD:0x10230124 %LE %LONG 0x00000800;
D.S SD:0x10230124 %LE %LONG 0x00000000;
D.S SD:0x10230128 %LE %LONG 0x05000156;
D.S SD:0x10230124 %LE %LONG 0x00000000;
D.S SD:0x10230124 %LE %LONG 0x00000800;
D.S SD:0x10230124 %LE %LONG 0x00000000;
D.S SD:0x10230128 %LE %LONG 0x05000212;
D.S SD:0x10230124 %LE %LONG 0x00000000;
D.S SD:0x10230124 %LE %LONG 0x00000800;
D.S SD:0x10230124 %LE %LONG 0x00000000;
D.S SD:0x10230128 %LE %LONG 0x05000329;
D.S SD:0x10230124 %LE %LONG 0x00000000;
D.S SD:0x10230124 %LE %LONG 0x00000800;
D.S SD:0x10230124 %LE %LONG 0x00000000;
D.S SD:0x10230128 %LE %LONG 0x0500330e;
D.S SD:0x10230124 %LE %LONG 0x00000000;
D.S SD:0x10230124 %LE %LONG 0x00000800;
D.S SD:0x10230124 %LE %LONG 0x00000000;
D.S SD:0x10230128 %LE %LONG 0x05000dc0;
D.S SD:0x10230124 %LE %LONG 0x00000000;
D.S SD:0x10230124 %LE %LONG 0x00000800;
D.S SD:0x10230124 %LE %LONG 0x00000000;
D.S SD:0x10230128 %LE %LONG 0x05000156;
D.S SD:0x10230124 %LE %LONG 0x00000000;
D.S SD:0x10230124 %LE %LONG 0x00000800;
D.S SD:0x10230124 %LE %LONG 0x00000000;
D.S SD:0x10230128 %LE %LONG 0x05000212;
D.S SD:0x10230124 %LE %LONG 0x00000000;
D.S SD:0x10230124 %LE %LONG 0x00000800;
D.S SD:0x10230124 %LE %LONG 0x00000000;
D.S SD:0x10230128 %LE %LONG 0x050003e9;
D.S SD:0x10230124 %LE %LONG 0x00000000;
D.S SD:0x10230124 %LE %LONG 0x00000800;
D.S SD:0x10230124 %LE %LONG 0x00000000;
D.S SD:0x10230128 %LE %LONG 0x05000d40;
D.S SD:0x10230124 %LE %LONG 0x00000000;
D.S SD:0x10230124 %LE %LONG 0x00000800;
D.S SD:0x10230124 %LE %LONG 0x00000000;
D.S SD:0x1023013c %LE %LONG 0x06000001;
D.S SD:0x10230140 %LE %LONG 0x00000033;
D.S SD:0x10230144 %LE %LONG 0x0000000e;
D.S SD:0x10230174 %LE %LONG 0x00000000;
D.S SD:0x10230124 %LE %LONG 0x01000000;
D.S SD:0x10230124 %LE %LONG 0x00000000;
D.S SD:0x10230128 %LE %LONG 0x05000d00;
D.S SD:0x10230124 %LE %LONG 0x00000000;
D.S SD:0x10230124 %LE %LONG 0x00000800;
D.S SD:0x10230124 %LE %LONG 0x00000000;
D.S SD:0x10230204 %LE %LONG 0x81104c10;
D.S SD:0x10230204 %LE %LONG 0x81104c00;
D.S SD:0x10238bb4 %LE %LONG 0x02000000;
D.S SD:0x102388b4 %LE %LONG 0x0204800d;
D.S SD:0x10238a34 %LE %LONG 0x0204800d;
D.S SD:0x10238b60 %LE %LONG 0x00010000;
D.S SD:0x10238860 %LE %LONG 0x00010000;
D.S SD:0x102389e0 %LE %LONG 0x00010000;
D.S SD:0x10238b84 %LE %LONG 0x000a0000;
D.S SD:0x10238884 %LE %LONG 0x13008f00;
D.S SD:0x10238a04 %LE %LONG 0x13008f00;
D.S SD:0x10238490 %LE %LONG 0x00010000;
D.S SD:0x10238190 %LE %LONG 0x00010000;
D.S SD:0x10238310 %LE %LONG 0x00010000;
D.S SD:0x1023056c %LE %LONG 0x00000000;
D.S SD:0x1023076c %LE %LONG 0x00000000;
;line 26117, END
;line 26118, modify_phypll_mode
;broadcast_off();
D.S SD:0x100010B4 %LE %LONG 0x00000000;
D.S SD:0x10238538 %LE %LONG 0x00100000;
D.S SD:0x10238000 %LE %LONG 0x00000000;
D.S SD:0x10238538 %LE %LONG 0x00100000;
D.S SD:0x10248000 %LE %LONG 0x00000000;
;broadcast_on();
D.S SD:0x100010B4 %LE %LONG 0x0000007f;
;line 26236, END
;l1ne 26237, sram_init_by_dramc_shu0_0
;broadcast_off();
D.S SD:0x100010B4 %LE %LONG 0x00000000;
D.S SD:0x10248618 %LE %LONG 0x00f0500a;
D.S SD:0x10238618 %LE %LONG 0x00f0500a;
D.S SD:0x10248618 %LE %LONG 0x00f0500b;
D.S SD:0x10238618 %LE %LONG 0x00f0500b;
D.S SD:0x10248618 %LE %LONG 0x00f0500a;
D.S SD:0x10238618 %LE %LONG 0x00f0500a;
D.S SD:0x10248618 %LE %LONG 0x00f05008;
D.S SD:0x10238618 %LE %LONG 0x00f05008;
;broadcast_on();
D.S SD:0x100010B4 %LE %LONG 0x0000007f;
D.S SD:0x10238618 %LE %LONG 0x20f05008;
;line 26774, END
;line 26776, init_golden_mini_freq_related_vseq_1
D.S SD:0x102384ec %LE %LONG 0x20030190;
D.S SD:0x10239448 %LE %LONG 0x3c3f0fc3;
D.S SD:0x1023944c %LE %LONG 0xbc3f0fc3;
D.S SD:0x10239450 %LE %LONG 0x02208822;
D.S SD:0x10239454 %LE %LONG 0x02208822;
D.S SD:0x102393e0 %LE %LONG 0x1e031e03;
D.S SD:0x102393e4 %LE %LONG 0x00001e03;
D.S SD:0x1023945c %LE %LONG 0x00000008;
D.S SD:0x10239444 %LE %LONG 0x80480006;
D.S SD:0x10239290 %LE %LONG 0x3f302100;
D.S SD:0x1023940c %LE %LONG 0x00700000;
;broadcast_off();
D.S SD:0x100010B4 %LE %LONG 0x00000000;
D.S SD:0x10239270 %LE %LONG 0x20000000;
D.S SD:0x10238f70 %LE %LONG 0x20000000;
D.S SD:0x102390f0 %LE %LONG 0x20000000;
D.S SD:0x10239274 %LE %LONG 0x00c00904;
D.S SD:0x10238f74 %LE %LONG 0x00c01d04;
D.S SD:0x102390f4 %LE %LONG 0x00c00404;
D.S SD:0x102392b8 %LE %LONG 0x00500010;
D.S SD:0x102392b4 %LE %LONG 0x02000000;
D.S SD:0x10238f7c %LE %LONG 0x0000810d;
D.S SD:0x10238fb8 %LE %LONG 0x00000010;
D.S SD:0x102390fc %LE %LONG 0x0000810d;
D.S SD:0x10239138 %LE %LONG 0x00000010;
D.S SD:0x10239294 %LE %LONG 0x04707000;
D.S SD:0x10238f94 %LE %LONG 0x04707000;
D.S SD:0x10239114 %LE %LONG 0x04707000;
D.S SD:0x10238fb0 %LE %LONG 0x001e0000;
D.S SD:0x10239130 %LE %LONG 0x001e0000;
D.S SD:0x102392b0 %LE %LONG 0x001e0000;
D.S SD:0x10238e40 %LE %LONG 0x0002fe2a;
D.S SD:0x10238e44 %LE %LONG 0x00000011;
D.S SD:0x10238e48 %LE %LONG 0x00000001;
D.S SD:0x10238e00 %LE %LONG 0xe57800fe;
D.S SD:0x10238e04 %LE %LONG 0x7a000002;
D.S SD:0x10238e08 %LE %LONG 0x00040000;
D.S SD:0x10238e0c %LE %LONG 0x00001223;
D.S SD:0x10238e20 %LE %LONG 0xe57800fe;
D.S SD:0x10238e24 %LE %LONG 0x7a000002;
D.S SD:0x10238e28 %LE %LONG 0x00040000;
D.S SD:0x10238e2c %LE %LONG 0x00000123;
D.S SD:0x10239260 %LE %LONG 0x00010000;
D.S SD:0x1023926c %LE %LONG 0x00000000;
D.S SD:0x1023928c %LE %LONG 0x4cbaf0bf;
D.S SD:0x10238f60 %LE %LONG 0x00010000;
D.S SD:0x102390e0 %LE %LONG 0x00010000;
D.S SD:0x10239498 %LE %LONG 0x00000002;
D.S SD:0x1023943c %LE %LONG 0x00000023;
D.S SD:0x10238fb4 %LE %LONG 0x02048009;
D.S SD:0x10239134 %LE %LONG 0x02048009;
D.S SD:0x10238f8c %LE %LONG 0x18872389;
D.S SD:0x1023910c %LE %LONG 0x0a372db0;
D.S SD:0x10239284 %LE %LONG 0x000a0000;
D.S SD:0x10239298 %LE %LONG 0x00017d1c;
D.S SD:0x1023929c %LE %LONG 0xfdea1eb4;
D.S SD:0x10238f98 %LE %LONG 0x00017d1c;
D.S SD:0x10239118 %LE %LONG 0x00017d1c;
D.S SD:0x10238f9c %LE %LONG 0xaee50fe5;
D.S SD:0x1023911c %LE %LONG 0x0ad05a55;
D.S SD:0x10239280 %LE %LONG 0x00020000;
D.S SD:0x10238f80 %LE %LONG 0x00020003;
D.S SD:0x10239100 %LE %LONG 0x00020003;
D.S SD:0x10239278 %LE %LONG 0x00001071;
D.S SD:0x10238f78 %LE %LONG 0x00033071;
D.S SD:0x102390f8 %LE %LONG 0x00033071;
D.S SD:0x10238fbc %LE %LONG 0x00000002;
D.S SD:0x1023913c %LE %LONG 0x00000002;
D.S SD:0x102392bc %LE %LONG 0x00000002;
D.S SD:0x10249270 %LE %LONG 0x20000000;
D.S SD:0x10248f70 %LE %LONG 0x20000000;
D.S SD:0x102490f0 %LE %LONG 0x20000000;
D.S SD:0x10249274 %LE %LONG 0x00c00204;
D.S SD:0x10248f74 %LE %LONG 0x00c00804;
D.S SD:0x102490f4 %LE %LONG 0x00c01304;
D.S SD:0x102492b8 %LE %LONG 0x00500010;
D.S SD:0x102492b4 %LE %LONG 0x02000000;
D.S SD:0x10248f7c %LE %LONG 0x0000810d;
D.S SD:0x10248fb8 %LE %LONG 0x00000010;
D.S SD:0x102490fc %LE %LONG 0x0000810d;
D.S SD:0x10249138 %LE %LONG 0x00000010;
D.S SD:0x10249294 %LE %LONG 0x04707000;
D.S SD:0x10248f94 %LE %LONG 0x04707000;
D.S SD:0x10249114 %LE %LONG 0x04707000;
D.S SD:0x10248fb0 %LE %LONG 0x001e0000;
D.S SD:0x10249130 %LE %LONG 0x001e0000;
D.S SD:0x102492b0 %LE %LONG 0x001e0000;
D.S SD:0x10248e40 %LE %LONG 0x0000db7c;
D.S SD:0x10248e44 %LE %LONG 0x00000011;
D.S SD:0x10248e48 %LE %LONG 0x00000001;
D.S SD:0x10248e00 %LE %LONG 0xe57800fe;
D.S SD:0x10248e04 %LE %LONG 0x7a000002;
D.S SD:0x10248e08 %LE %LONG 0x00040000;
D.S SD:0x10248e0c %LE %LONG 0x00001223;
D.S SD:0x10248e20 %LE %LONG 0xe57800fe;
D.S SD:0x10248e24 %LE %LONG 0x7a000002;
D.S SD:0x10248e28 %LE %LONG 0x00040000;
D.S SD:0x10248e2c %LE %LONG 0x00000123;
D.S SD:0x10249260 %LE %LONG 0x00010000;
D.S SD:0x1024926c %LE %LONG 0x00000000;
D.S SD:0x1024928c %LE %LONG 0x6b75fa73;
D.S SD:0x10248f60 %LE %LONG 0x00010000;
D.S SD:0x102490e0 %LE %LONG 0x00010000;
D.S SD:0x10249498 %LE %LONG 0x00000002;
D.S SD:0x1024943c %LE %LONG 0x00000023;
D.S SD:0x10248fb4 %LE %LONG 0x02048009;
D.S SD:0x10249134 %LE %LONG 0x02048009;
D.S SD:0x10248f8c %LE %LONG 0xaca4a3a7;
D.S SD:0x1024910c %LE %LONG 0xec36108b;
D.S SD:0x10249284 %LE %LONG 0x000a0000;
D.S SD:0x10249298 %LE %LONG 0x00017d1c;
D.S SD:0x1024929c %LE %LONG 0x998574a1;
D.S SD:0x10248f98 %LE %LONG 0x00017d1c;
D.S SD:0x10249118 %LE %LONG 0x00017d1c;
D.S SD:0x10248f9c %LE %LONG 0x93dbff4b;
D.S SD:0x1024911c %LE %LONG 0xed9d7715;
D.S SD:0x10249280 %LE %LONG 0x00020000;
D.S SD:0x10248f80 %LE %LONG 0x00020003;
D.S SD:0x10249100 %LE %LONG 0x00020003;
D.S SD:0x10249278 %LE %LONG 0x00001071;
D.S SD:0x10248f78 %LE %LONG 0x00033071;
D.S SD:0x102490f8 %LE %LONG 0x00033071;
D.S SD:0x10248fbc %LE %LONG 0x00000002;
D.S SD:0x1024913c %LE %LONG 0x00000002;
D.S SD:0x102492bc %LE %LONG 0x00000002;
;broadcast_on();
D.S SD:0x100010B4 %LE %LONG 0x0000007f;
D.S SD:0x102392a8 %LE %LONG 0x000ba000;
D.S SD:0x10238fa8 %LE %LONG 0x0002e800;
D.S SD:0x10238fa8 %LE %LONG 0x000ae800;
D.S SD:0x10239128 %LE %LONG 0x0002e800;
D.S SD:0x10239128 %LE %LONG 0x000ae800;
D.S SD:0x10238fb4 %LE %LONG 0x0204800d;
D.S SD:0x10239134 %LE %LONG 0x0204800d;
D.S SD:0x10238f78 %LE %LONG 0x00033071;
D.S SD:0x102390f8 %LE %LONG 0x00033071;
D.S SD:0x102392b4 %LE %LONG 0x02000000;
D.S SD:0x10239278 %LE %LONG 0x00001071;
D.S SD:0x1023947c %LE %LONG 0x015feb4f;
D.S SD:0x10239438 %LE %LONG 0x000e0e0f;
D.S SD:0x10239424 %LE %LONG 0x01114500;
D.S SD:0x10239420 %LE %LONG 0x94448013;
D.S SD:0x102392e0 %LE %LONG 0x00000006;
D.S SD:0x10239360 %LE %LONG 0x00000006;
D.S SD:0x10238ea0 %LE %LONG 0x000b000a;
D.S SD:0x10238f20 %LE %LONG 0x000b000a;
D.S SD:0x10239020 %LE %LONG 0x000b000a;
D.S SD:0x102390a0 %LE %LONG 0x000b000a;
D.S SD:0x10239428 %LE %LONG 0xe0000050;
D.S SD:0x10238f84 %LE %LONG 0x13008000;
D.S SD:0x10239104 %LE %LONG 0x13008000;
D.S SD:0x10238ea4 %LE %LONG 0x00000001;
D.S SD:0x10238f24 %LE %LONG 0x00000001;
D.S SD:0x10239024 %LE %LONG 0x00000001;
D.S SD:0x102390a4 %LE %LONG 0x00000001;
D.S SD:0x10231d8c %LE %LONG 0x0000003c;
D.S SD:0x10238fa0 %LE %LONG 0x00210000;
D.S SD:0x10239120 %LE %LONG 0x00210000;
D.S SD:0x10239478 %LE %LONG 0x10000511;
D.S SD:0x102392e8 %LE %LONG 0x0000bfe0;
D.S SD:0x10239368 %LE %LONG 0x0000bfe0;
D.S SD:0x10238e98 %LE %LONG 0x00000a0b;
D.S SD:0x10239018 %LE %LONG 0x00000a0b;
D.S SD:0x10238f18 %LE %LONG 0x00000a0b;
D.S SD:0x10239098 %LE %LONG 0x00000a0b;
D.S SD:0x10238e9c %LE %LONG 0x00000a0b;
D.S SD:0x1023901c %LE %LONG 0x00000a0b;
D.S SD:0x10238f1c %LE %LONG 0x00000a0b;
D.S SD:0x1023909c %LE %LONG 0x00000a0b;
D.S SD:0x10231d10 %LE %LONG 0x80426080;
D.S SD:0x10231dac %LE %LONG 0x80002303;
D.S SD:0x10231930 %LE %LONG 0x00000040;
D.S SD:0x10231b30 %LE %LONG 0x00000040;
D.S SD:0x10231da8 %LE %LONG 0x02020000;
D.S SD:0x10231980 %LE %LONG 0x11331144;
D.S SD:0x10231b80 %LE %LONG 0x11331144;
D.S SD:0x10231900 %LE %LONG 0x11331144;
D.S SD:0x10231904 %LE %LONG 0x11331144;
D.S SD:0x10231908 %LE %LONG 0x11331122;
D.S SD:0x1023190c %LE %LONG 0x11331122;
D.S SD:0x10231b00 %LE %LONG 0x11331144;
D.S SD:0x10231b04 %LE %LONG 0x11331144;
D.S SD:0x10231b08 %LE %LONG 0x11331122;
D.S SD:0x10231b0c %LE %LONG 0x11331122;
D.S SD:0x10231d98 %LE %LONG 0x00000011;
D.S SD:0x10238f8c %LE %LONG 0x18812389;
D.S SD:0x1023910c %LE %LONG 0x0a312db0;
D.S SD:0x10231d18 %LE %LONG 0x00000000;
D.S SD:0x10231d1c %LE %LONG 0x00010000;
D.S SD:0x10231d20 %LE %LONG 0x00000000;
D.S SD:0x10231d24 %LE %LONG 0x00000000;
D.S SD:0x10231d28 %LE %LONG 0x11111011;
D.S SD:0x10231d2c %LE %LONG 0x01000111;
D.S SD:0x10231d30 %LE %LONG 0x11111111;
D.S SD:0x10231d34 %LE %LONG 0x11111111;
D.S SD:0x10231d68 %LE %LONG 0x08040000;
D.S SD:0x10231d6c %LE %LONG 0x000a0608;
D.S SD:0x10231d08 %LE %LONG 0x30000030;
D.S SD:0x10231d14 %LE %LONG 0x00006400;
D.S SD:0x10231d64 %LE %LONG 0x00200000;
D.S SD:0x10231d60 %LE %LONG 0x09060a07;
D.S SD:0x10231d44 %LE %LONG 0x38030f0a;
D.S SD:0x10231d48 %LE %LONG 0x00090687;
D.S SD:0x10231d4c %LE %LONG 0x080a30b0;
D.S SD:0x10231d50 %LE %LONG 0x008c8840;
D.S SD:0x10231d54 %LE %LONG 0x220c3c9b;
D.S SD:0x10231d58 %LE %LONG 0x001c1310;
D.S SD:0x10231d5c %LE %LONG 0x48d0570c;
D.S SD:0x10231d78 %LE %LONG 0x03233000;
D.S SD:0x10231da4 %LE %LONG 0x00070002;
D.S SD:0x10238f88 %LE %LONG 0x01200063;
D.S SD:0x10239108 %LE %LONG 0x01200063;
D.S SD:0x10238f6c %LE %LONG 0x0050000e;
D.S SD:0x102390ec %LE %LONG 0x0050000e;
D.S SD:0x10238e74 %LE %LONG 0x4c4c4c4c;
D.S SD:0x10238e78 %LE %LONG 0x4c4c4c4c;
D.S SD:0x10238e7c %LE %LONG 0x4c4c4c4c;
D.S SD:0x10238e80 %LE %LONG 0x4c4c4c4c;
D.S SD:0x10238e84 %LE %LONG 0x00004c4c;
D.S SD:0x10238e88 %LE %LONG 0x00620062;
D.S SD:0x10238ef4 %LE %LONG 0x14141414;
D.S SD:0x10238ef8 %LE %LONG 0x14141414;
D.S SD:0x10238efc %LE %LONG 0x14141414;
D.S SD:0x10238f00 %LE %LONG 0x14141414;
D.S SD:0x10238f04 %LE %LONG 0x00001414;
D.S SD:0x10238f08 %LE %LONG 0x002a002a;
D.S SD:0x10238ff4 %LE %LONG 0x23232323;
D.S SD:0x10238ff8 %LE %LONG 0x23232323;
D.S SD:0x10238ffc %LE %LONG 0x23232323;
D.S SD:0x10239000 %LE %LONG 0x23232323;
D.S SD:0x10239004 %LE %LONG 0x00002323;
D.S SD:0x10239008 %LE %LONG 0x003b003b;
D.S SD:0x10239074 %LE %LONG 0xa1a1a1a1;
D.S SD:0x10239078 %LE %LONG 0xa1a1a1a1;
D.S SD:0x1023907c %LE %LONG 0xa1a1a1a1;
D.S SD:0x10239080 %LE %LONG 0xa1a1a1a1;
D.S SD:0x10239084 %LE %LONG 0x0000a1a1;
D.S SD:0x10239088 %LE %LONG 0x00b300b3;
D.S SD:0x10231d04 %LE %LONG 0x00001402;
D.S SD:0x10231d04 %LE %LONG 0x00000402;
D.S SD:0x10231d74 %LE %LONG 0x80000036;
D.S SD:0x10231d10 %LE %LONG 0xa0426080;
D.S SD:0x10231da0 %LE %LONG 0x000800bf;
D.S SD:0x10231d00 %LE %LONG 0x00000012;
D.S SD:0x10231d0c %LE %LONG 0x00000000;
D.S SD:0x10231d88 %LE %LONG 0x1c102220;
D.S SD:0x10231dc8 %LE %LONG 0x10101943;
D.S SD:0x10239488 %LE %LONG 0x00000002;
D.S SD:0x10231960 %LE %LONG 0x00000000;
D.S SD:0x10239488 %LE %LONG 0x00000002;
D.S SD:0x10239418 %LE %LONG 0x03009800;
D.S SD:0x10239414 %LE %LONG 0x00004000;
D.S SD:0x10239414 %LE %LONG 0x00004310;
D.S SD:0x102392e4 %LE %LONG 0x00000010;
D.S SD:0x10239364 %LE %LONG 0x00000010;
D.S SD:0x1023942c %LE %LONG 0x000a2119;
D.S SD:0x10239430 %LE %LONG 0x00000010;
D.S SD:0x10239420 %LE %LONG 0x94448013;
D.S SD:0x10231964 %LE %LONG 0x00000001;
D.S SD:0x10231b64 %LE %LONG 0x00000001;
D.S SD:0x10231da0 %LE %LONG 0x000800bf;
D.S SD:0x10238f84 %LE %LONG 0x13008000;
D.S SD:0x10239104 %LE %LONG 0x13008000;
D.S SD:0x10231d88 %LE %LONG 0x1c102220;
D.S SD:0x10231d3c %LE %LONG 0x0008000d;
D.S SD:0x10231d40 %LE %LONG 0x3600000d;
D.S SD:0x10231d40 %LE %LONG 0x0b00000d;
D.S SD:0x10231d38 %LE %LONG 0x00120002;
D.S SD:0x10231db0 %LE %LONG 0x18200000;
D.S SD:0x10231db4 %LE %LONG 0x00000000;
D.S SD:0x10231db8 %LE %LONG 0x00000000;
D.S SD:0x1023941c %LE %LONG 0x004302b1;
D.S SD:0x102394a0 %LE %LONG 0x00020007;
D.S SD:0x102394a4 %LE %LONG 0x334f3000;
D.S SD:0x102394a0 %LE %LONG 0x00020007;
D.S SD:0x10239480 %LE %LONG 0x00000000;
;broadcast_off();
D.S SD:0x100010B4 %LE %LONG 0x00000000;
D.S SD:0x10239464 %LE %LONG 0x00000000;
D.S SD:0x10249464 %LE %LONG 0x00000000;
;broadcast_on();
D.S SD:0x100010B4 %LE %LONG 0x0000007f;
D.S SD:0x10231d94 %LE %LONG 0xffff0010;
D.S SD:0x10231d90 %LE %LONG 0x00040211;
D.S SD:0x10231928 %LE %LONG 0x08660866;
D.S SD:0x10231b28 %LE %LONG 0x08660866;
D.S SD:0x1023192c %LE %LONG 0x007200ac;
D.S SD:0x10231b2c %LE %LONG 0x007200ac;
D.S SD:0x10231d88 %LE %LONG 0x10102220;
D.S SD:0x10231d84 %LE %LONG 0x00000400;
D.S SD:0x10231d90 %LE %LONG 0x00040210;
D.S SD:0x10231d9c %LE %LONG 0xd8000005;
D.S SD:0x10231d14 %LE %LONG 0x00016400;
D.S SD:0x10231dd4 %LE %LONG 0x00000005;
D.S SD:0x10238f84 %LE %LONG 0x13008800;
D.S SD:0x10239104 %LE %LONG 0x13008800;
D.S SD:0x10238f80 %LE %LONG 0x00020083;
D.S SD:0x10239100 %LE %LONG 0x00020083;
D.S SD:0x102384ec %LE %LONG 0x20000190;
;line 31847, END
;line 31849, sram_init_by_dramc_shu0_1
;broadcast_off();
D.S SD:0x100010B4 %LE %LONG 0x00000000;
D.S SD:0x10248618 %LE %LONG 0x20f0500a;
D.S SD:0x10238618 %LE %LONG 0x20f0500a;
D.S SD:0x10248618 %LE %LONG 0x20f0511a;
D.S SD:0x10238618 %LE %LONG 0x20f0511a;
D.S SD:0x10248618 %LE %LONG 0x20f0511b;
D.S SD:0x10238618 %LE %LONG 0x20f0511b;
D.S SD:0x10248618 %LE %LONG 0x20f0511a;
D.S SD:0x10238618 %LE %LONG 0x20f0511a;
D.S SD:0x10248618 %LE %LONG 0x20f05118;
D.S SD:0x10238618 %LE %LONG 0x20f05118;
;broadcast_on();
D.S SD:0x100010B4 %LE %LONG 0x0000007f;
;line 32414. END
;line 32416, freq_group_mapping_init_vseq
D.S SD:0x10238518 %LE %LONG 0x00000010;
D.S SD:0x10238518 %LE %LONG 0x00000010;
D.S SD:0x10238518 %LE %LONG 0x0fc00010;
D.S SD:0x10238518 %LE %LONG 0x0fc00310;
D.S SD:0x10238518 %LE %LONG 0x0fc00710;
D.S SD:0x10238520 %LE %LONG 0x00000002;
D.S SD:0x10238520 %LE %LONG 0x00000003;
D.S SD:0x10238520 %LE %LONG 0x00000007;
D.S SD:0x10238518 %LE %LONG 0x04000710;
;broadcast_off();
D.S SD:0x100010B4 %LE %LONG 0x00000000;
D.S SD:0x10238514 %LE %LONG 0x00001120;
D.S SD:0x10238510 %LE %LONG 0x30003333;
D.S SD:0x10248510 %LE %LONG 0x30003336;
D.S SD:0x10238518 %LE %LONG 0x74000710;
D.S SD:0x10248518 %LE %LONG 0x94000710;
D.S SD:0x10238518 %LE %LONG 0x74000790;
D.S SD:0x10248518 %LE %LONG 0x94000790;
D.S SD:0x10248514 %LE %LONG 0x20000120;
;broadcast_on();
D.S SD:0x100010B4 %LE %LONG 0x0000007f;
;broadcast_off();
D.S SD:0x100010B4 %LE %LONG 0x00000000;
D.S SD:0x1024865c %LE %LONG 0xfffbfbfb;
D.S SD:0x1023865c %LE %LONG 0xfff7fbfb;
;broadcast_on();
D.S SD:0x100010B4 %LE %LONG 0x0000007f;
;broadcast_off();
D.S SD:0x100010B4 %LE %LONG 0x00000000;
;broadcast_on();
D.S SD:0x100010B4 %LE %LONG 0x0000007f;
;broadcast_off();
D.S SD:0x100010B4 %LE %LONG 0x00000000;
D.S SD:0x10230208 %LE %LONG 0x00300781;
D.S SD:0x10240208 %LE %LONG 0x00300782;
;broadcast_on();
D.S SD:0x100010B4 %LE %LONG 0x0000007f;
D.S SD:0x10238618 %LE %LONG 0x00f05118;
;line 32943, END
;line 33015, LP_MTCMOS_CTRL_SEL_prepare
;line 33046, END
;line 33047, SPM_FW_CTRL_SEL_prepare
;line 33078, END
;line 33079, dvfs_prepare_uP_part
;line 33548, END
;line 33549, indiv_rand_reg_settings_vseq
D.S SD:0x10230248 %LE %LONG 0x090e0080;
D.S SD:0x10230228 %LE %LONG 0x00000000;
D.S SD:0x1023012c %LE %LONG 0x00000005;
D.S SD:0x10230254 %LE %LONG 0x00004f01;
D.S SD:0x1023017c %LE %LONG 0x00000163;
D.S SD:0x10230108 %LE %LONG 0x12000880;
D.S SD:0x10230170 %LE %LONG 0x00000086;
D.S SD:0x10230238 %LE %LONG 0x01400050;
D.S SD:0x1023024c %LE %LONG 0x34082009;
D.S SD:0x10230190 %LE %LONG 0x00200001;
D.S SD:0x1023024c %LE %LONG 0x34082008;
D.S SD:0x10230174 %LE %LONG 0x00000000;
D.S SD:0x10230284 %LE %LONG 0x00000003;
D.S SD:0x10230220 %LE %LONG 0x000001c4;
D.S SD:0x10230178 %LE %LONG 0x00000039;
D.S SD:0x10230000 %LE %LONG 0x00080108;
D.S SD:0x10230234 %LE %LONG 0x00000001;
D.S SD:0x10230174 %LE %LONG 0x0000000f;
D.S SD:0x10230168 %LE %LONG 0x00588780;
D.S SD:0x10230204 %LE %LONG 0x81504c00;
D.S SD:0x10230240 %LE %LONG 0x6000009e;
D.S SD:0x102302c0 %LE %LONG 0x00000000;
D.S SD:0x10230268 %LE %LONG 0x0203116d;
D.S SD:0x1023028c %LE %LONG 0x0000041f;
D.S SD:0x10230264 %LE %LONG 0x05734009;
D.S SD:0x102302e0 %LE %LONG 0x00000001;
D.S SD:0x10230190 %LE %LONG 0x00200001;
D.S SD:0x10230310 %LE %LONG 0x00001828;
D.S SD:0x1023023c %LE %LONG 0x18000000;
D.S SD:0x1023020c %LE %LONG 0x0500051a;
D.S SD:0x10238684 %LE %LONG 0xffffffff;
D.S SD:0x10238684 %LE %LONG 0xffffffff;
D.S SD:0x10238684 %LE %LONG 0xffffffff;
D.S SD:0x10238690 %LE %LONG 0xffffffff;
D.S SD:0x1023869c %LE %LONG 0xffffffff;
D.S SD:0x1023864c %LE %LONG 0x0000003f;
D.S SD:0x10238648 %LE %LONG 0x11001135;
D.S SD:0x10238634 %LE %LONG 0x00000001;
D.S SD:0x10238638 %LE %LONG 0x00000001;
D.S SD:0x10238618 %LE %LONG 0x00f05118;
D.S SD:0x10230250 %LE %LONG 0x81084000;
D.S SD:0x10238538 %LE %LONG 0x00100000;
D.S SD:0x10238618 %LE %LONG 0x00f05118;
D.S SD:0x1023861c %LE %LONG 0x170003b0;
D.S SD:0x10238504 %LE %LONG 0x00010000;
D.S SD:0x10238510 %LE %LONG 0x38043333;
;broadcast_off();
D.S SD:0x100010B4 %LE %LONG 0x00000000;
D.S SD:0x10230208 %LE %LONG 0x00308781;
D.S SD:0x10230208 %LE %LONG 0x00108781;
D.S SD:0x10230208 %LE %LONG 0x0010a781;
D.S SD:0x10230218 %LE %LONG 0x08040f0f;
D.S SD:0x10240208 %LE %LONG 0x00308782;
D.S SD:0x10240208 %LE %LONG 0x00108782;
D.S SD:0x10240208 %LE %LONG 0x0010a782;
D.S SD:0x10240218 %LE %LONG 0x08040f0f;
;broadcast_on();
D.S SD:0x100010B4 %LE %LONG 0x0000007f;
;broadcast_off();
D.S SD:0x100010B4 %LE %LONG 0x00000000;
D.S SD:0x10230208 %LE %LONG 0x0010a681;
D.S SD:0x10240208 %LE %LONG 0x0010a682;
;broadcast_on();
D.S SD:0x100010B4 %LE %LONG 0x0000007f;
;broadcast_off();
D.S SD:0x100010B4 %LE %LONG 0x00000000;
D.S SD:0x10230208 %LE %LONG 0x0010a681;
D.S SD:0x10240208 %LE %LONG 0x0010a682;
D.S SD:0x10230208 %LE %LONG 0x0010a681;
D.S SD:0x10240208 %LE %LONG 0x0010a682;
D.S SD:0x10230208 %LE %LONG 0x0010a681;
D.S SD:0x10240208 %LE %LONG 0x0010a682;
;broadcast_on();
D.S SD:0x100010B4 %LE %LONG 0x0000007f;
;line 35923, END
; DRAMC TEST AGENT
;Configuration :
;0x108 [3   :0] TESTCNT			= 4'h1 (0 for rank 0 only)
;0x10c [16    ] TESTXTALKPAT	= l'hl (pattern)
;0x10c [30 :28] TESTAGENTRKSEL	= 3'h4
;0x104 [31 z 4] TEST2_0FF		= 28'h20( test2 length )
;JD.S SD:0x10230108 %LE %LONG 0x12000881;
;JD.S SD:0x1023010c %LE %LONG 0x40010000;
; Trigger
;0x108 [31] TEST2W (read after write)
;JD.S SD:0x10230108 %LE %LONG 0x92000881;
;Resu1t(dranc_nao) : 0x10234000
;0x120[5] DM_CMP_ERR_RK1
;0x120[4] DM_CMP_ERR_RK0
;0x120[1] DM_CMP_CPT_RK1
;0x120[0] DM_CMP_CPT_RK0
;DRAMC brocast on
D.S SD:0x100010B4 %LE %LONG 0x0000007f;
;EMI setting 2
D.S SD:0x10219060 %LE %LONG 0x00005400;
D.S SD:0x10235010 %LE %LONG 0x04000005;
;DRAMC brocast off
D.S SD:0x100010B4 %LE %LONG 0x00000000;