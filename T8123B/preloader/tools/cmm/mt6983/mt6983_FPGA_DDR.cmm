
;DPI_md32_init_entry start
;broadcast_off();
  ;CHA MD32
  D.S SD:0x100010B4 %LE %LONG 0x00000000;
  D.S SD:0x10940000 %LE %LONG 0x00000003;
  D.S SD:0x10943004 %LE %LONG 0x00410120;
  D.S SD:0x10947000 %LE %LONG 0x0fc00000;
  D.S SD:0x10947000 %LE %LONG 0x0fc00001;
  D.S SD:0x10947000 %LE %LONG 0x0fc00801;
  D.S SD:0x10947000 %LE %LONG 0x0fc00801;
  D.S SD:0x1094703c %LE %LONG 0xc1c03000;
  D.S SD:0x10947020 %LE %LONG 0xf0000000;
  D.S SD:0x10947004 %LE %LONG 0x0000f000;
  D.S SD:0x10947004 %LE %LONG 0x00003000;
  D.S SD:0x10947004 %LE %LONG 0x00000000;
  D.S SD:0x10947008 %LE %LONG 0x00000000;
  D.S SD:0x1094700c %LE %LONG 0x40000040;
  D.S SD:0x1094703c %LE %LONG 0xc1c00000;
  D.S SD:0x1094703c %LE %LONG 0xc1000000;
  D.S SD:0x1094703c %LE %LONG 0xc1000000;
  D.S SD:0x1094700c %LE %LONG 0x40000000;
  D.S SD:0x10947038 %LE %LONG 0x00000000;
  D.S SD:0x10947020 %LE %LONG 0xe0000000;
  D.S SD:0x1094700c %LE %LONG 0x00000000;
  D.S SD:0x10947004 %LE %LONG 0x00400554;
  D.S SD:0x10947038 %LE %LONG 0x00000015;
  D.S SD:0x10947000 %LE %LONG 0x0fc00809;
  D.S SD:0x10947000 %LE %LONG 0x0fc00801;
  D.S SD:0x10947010 %LE %LONG 0x0000083e;
  D.S SD:0x10947014 %LE %LONG 0x00000070;
  D.S SD:0x109472d8 %LE %LONG 0x0000703c;
  D.S SD:0x10947064 %LE %LONG 0x00000b45;
  D.S SD:0x10947054 %LE %LONG 0x0f206438;
  D.S SD:0x10947048 %LE %LONG 0x340a7221;
  D.S SD:0x1094704c %LE %LONG 0x02050c0a;
  D.S SD:0x10947050 %LE %LONG 0x0b205e4a;
  D.S SD:0x10947050 %LE %LONG 0x0f205e4a;
  D.S SD:0x10947058 %LE %LONG 0x66cb020f;
  D.S SD:0x1094705c %LE %LONG 0x0006b13c;
  D.S SD:0x10947000 %LE %LONG 0x44c00801;
  D.S SD:0x10947000 %LE %LONG 0x44c00a01;
  D.S SD:0x10947000 %LE %LONG 0x44c00b01;
  D.S SD:0x10942020 %LE %LONG 0x00030000;
  D.S SD:0x10942030 %LE %LONG 0x00030000;
  D.S SD:0x10942060 %LE %LONG 0x00010000;
  D.S SD:0x10942070 %LE %LONG 0x00020000;
  D.S SD:0x10947000 %LE %LONG 0x44c00b11;
  D.S SD:0x10943000 %LE %LONG 0x00008fdf;
  D.S SD:0x10943008 %LE %LONG 0xc0000010;
  D.S SD:0x10947000 %LE %LONG 0x44c00b15;
  D.S SD:0x10947270 %LE %LONG 0x000000c0;
  ;CHB MD32
  D.S SD:0x10A40000 %LE %LONG 0x00000003;
  D.S SD:0x10A43004 %LE %LONG 0x00410120;
  D.S SD:0x10A47000 %LE %LONG 0x0fc00000;
  D.S SD:0x10A47000 %LE %LONG 0x0fc00001;
  D.S SD:0x10A47000 %LE %LONG 0x0fc00801;
  D.S SD:0x10A47000 %LE %LONG 0x0fc00801;
  D.S SD:0x10A4703c %LE %LONG 0xc1c03000;
  D.S SD:0x10A47020 %LE %LONG 0xf0000000;
  D.S SD:0x10A47004 %LE %LONG 0x0000f000;
  D.S SD:0x10A47004 %LE %LONG 0x00003000;
  D.S SD:0x10A47004 %LE %LONG 0x00000000;
  D.S SD:0x10A47008 %LE %LONG 0x00000000;
  D.S SD:0x10A4700c %LE %LONG 0x40000040;
  D.S SD:0x10A4703c %LE %LONG 0xc1c00000;
  D.S SD:0x10A4703c %LE %LONG 0xc1000000;
  D.S SD:0x10A4703c %LE %LONG 0xc1000000;
  D.S SD:0x10A4700c %LE %LONG 0x40000000;
  D.S SD:0x10A47038 %LE %LONG 0x00000000;
  D.S SD:0x10A47020 %LE %LONG 0xe0000000;
  D.S SD:0x10A4700c %LE %LONG 0x00000000;
  D.S SD:0x10A47004 %LE %LONG 0x00400554;
  D.S SD:0x10A47038 %LE %LONG 0x00000015;
  D.S SD:0x10A47000 %LE %LONG 0x0fc00809;
  D.S SD:0x10A47000 %LE %LONG 0x0fc00801;
  D.S SD:0x10A47010 %LE %LONG 0x0000083e;
  D.S SD:0x10A47014 %LE %LONG 0x00000070;
  D.S SD:0x10A472d8 %LE %LONG 0x0000703c;
  D.S SD:0x10A47064 %LE %LONG 0x00000b45;
  D.S SD:0x10A47054 %LE %LONG 0x0f206438;
  D.S SD:0x10A47048 %LE %LONG 0x340a7221;
  D.S SD:0x10A4704c %LE %LONG 0x02050c0a;
  D.S SD:0x10A47050 %LE %LONG 0x0b205e4a;
  D.S SD:0x10A47050 %LE %LONG 0x0f205e4a;
  D.S SD:0x10A47058 %LE %LONG 0x66cb020f;
  D.S SD:0x10A4705c %LE %LONG 0x0006b13c;
  D.S SD:0x10A47000 %LE %LONG 0x44c00801;
  D.S SD:0x10A47000 %LE %LONG 0x44c00a01;
  D.S SD:0x10A47000 %LE %LONG 0x44c00b01;
  D.S SD:0x10A42020 %LE %LONG 0x00030000;
  D.S SD:0x10A42030 %LE %LONG 0x00030000;
  D.S SD:0x10A42060 %LE %LONG 0x00010000;
  D.S SD:0x10A42070 %LE %LONG 0x00020000;
  D.S SD:0x10A47000 %LE %LONG 0x44c00b11;
  D.S SD:0x10A43000 %LE %LONG 0x00008fdf;
  D.S SD:0x10A43008 %LE %LONG 0xc0000010;
  D.S SD:0x10A47000 %LE %LONG 0x44c00b15;
  D.S SD:0x10A47270 %LE %LONG 0x000000c0;

;DPI_md32_init_entry end


d.s c:0x10001ee0 %le %long 0x80000000;disable dispatch --> cpu access one channel

;DRAMC brocast on
D.S SD:0x100010B4 %LE %LONG 0x0000007f;
;EMI setting 1
D.S SD:0x10219000 %LE %LONG 0xA053A054;  ;1ch
;D.S SD:0x10219000 %LE %LONG 0xA053A154; ;2ch
D.S SD:0x10219020 %LE %LONG 0x00000000;
D.S SD:0x10219038 %LE %LONG 0x00000030;
D.S SD:0x1021903C %LE %LONG 0x00000000;
D.S SD:0x10235000 %LE %LONG 0x0400A051;
D.S SD:0x1023515C %LE %LONG 0x82410222;
D.S SD:0x10235048 %LE %LONG 0x00020027;
D.S SD:0x102190E8 %LE %LONG 0x00000020;

D.S SD:0x10219060 %LE %LONG 0x00005400;
D.S SD:0x10235010 %LE %LONG 0x04000005;

;DRAMC brocast off
D.S SD:0x100010B4 %LE %LONG 0x00000000;


;DRAMC brocast on
;D.S SD:0x100010B4 %LE %LONG 0x0000007f;
;EMI setting 1
;D.S SD:0x10219000 %LE %LONG 0xA053A054;  ;1ch
;D.S SD:0x10219000 %LE %LONG 0xA053A154; ;2ch
;D.S SD:0x10219020 %LE %LONG 0x00000000;
;D.S SD:0x10219038 %LE %LONG 0x00000030;
;D.S SD:0x1021903C %LE %LONG 0x00000010;
;D.S SD:0x10235000 %LE %LONG 0x0400A051;
;D.S SD:0x1023515C %LE %LONG 0x82410222;
;D.S SD:0x10235048 %LE %LONG 0x00020027;
;D.S SD:0x102190E8 %LE %LONG 0x00000020;

;DRAMC brocast off
;D.S SD:0x100010B4 %LE %LONG 0x00000000;

;line  4382, sv_algrithm_assitance_0
;broadcast_on();
  D.S SD:0x100010B4 %LE %LONG 0x0000007f;
  D.S SD:0x10231668 %LE %LONG 0x03020001;
  D.S SD:0x1023166c %LE %LONG 0x00000203;
  D.S SD:0x10231670 %LE %LONG 0x00000280;
  D.S SD:0x10231608 %LE %LONG 0x30000030;
  D.S SD:0x10231614 %LE %LONG 0x00006400;
  D.S SD:0x10231664 %LE %LONG 0x1c8504a6;
  D.S SD:0x10231660 %LE %LONG 0x04030303;
  D.S SD:0x10231644 %LE %LONG 0x21820704;
  D.S SD:0x10231648 %LE %LONG 0x00000863;
  D.S SD:0x1023164c %LE %LONG 0x00041041;
  D.S SD:0x10231650 %LE %LONG 0x003e880a;
  D.S SD:0x10231654 %LE %LONG 0x0c051c3b;
  D.S SD:0x10231658 %LE %LONG 0x00070808;
  D.S SD:0x1023165c %LE %LONG 0x24602305;
  D.S SD:0x10231678 %LE %LONG 0x03111001;
  D.S SD:0x102316a4 %LE %LONG 0x00070002;
  D.S SD:0x102316ec %LE %LONG 0x00000009;
  D.S SD:0x102390f0 %LE %LONG 0x00000000;
  D.S SD:0x102390f0 %LE %LONG 0x00000000;
  D.S SD:0x10238f08 %LE %LONG 0x0020004a;
  D.S SD:0x10238f88 %LE %LONG 0x0020004a;
  D.S SD:0x10238eec %LE %LONG 0x00b0000e;
  D.S SD:0x10238f6c %LE %LONG 0x00b0000e;
  D.S SD:0x10238fec %LE %LONG 0x00b0000e;
  D.S SD:0x102389f8 %LE %LONG 0x0b0b0b0b;
  D.S SD:0x102389fc %LE %LONG 0x0b0b0b0b;
  D.S SD:0x10238a00 %LE %LONG 0x0b0b0b0b;
  D.S SD:0x10238a04 %LE %LONG 0x0b0b0b0b;
  D.S SD:0x10238a08 %LE %LONG 0x00000b0b;
  D.S SD:0x10238a0c %LE %LONG 0x00a400a4;
  D.S SD:0x10238c78 %LE %LONG 0xf5f5f5f5;
  D.S SD:0x10238c7c %LE %LONG 0xf5f5f5f5;
  D.S SD:0x10238c80 %LE %LONG 0xf5f5f5f5;
  D.S SD:0x10238c84 %LE %LONG 0xf5f5f5f5;
  D.S SD:0x10238c88 %LE %LONG 0x0000f5f5;
  D.S SD:0x10238c8c %LE %LONG 0x018f018f;
  D.S SD:0x10238a78 %LE %LONG 0x15151515;
  D.S SD:0x10238a7c %LE %LONG 0x15151515;
  D.S SD:0x10238a80 %LE %LONG 0x15151515;
  D.S SD:0x10238a84 %LE %LONG 0x15151515;
  D.S SD:0x10238a88 %LE %LONG 0x00001515;
  D.S SD:0x10238a8c %LE %LONG 0x00ad00ad;
  D.S SD:0x10238cf8 %LE %LONG 0x3c3c3c3c;
  D.S SD:0x10238cfc %LE %LONG 0x3c3c3c3c;
  D.S SD:0x10238d00 %LE %LONG 0x3c3c3c3c;
  D.S SD:0x10238d04 %LE %LONG 0x3c3c3c3c;
  D.S SD:0x10238d08 %LE %LONG 0x00003c3c;
  D.S SD:0x10238d0c %LE %LONG 0x00d200d2;
  D.S SD:0x10238518 %LE %LONG 0x00000041;
  D.S SD:0x10238598 %LE %LONG 0x00000041;
  D.S SD:0x10238504 %LE %LONG 0x0b0b2121;
  D.S SD:0x10238584 %LE %LONG 0x15152b2b;
  D.S SD:0x10238508 %LE %LONG 0x02000e01;
  D.S SD:0x10238588 %LE %LONG 0x02000e01;
;broadcast_off();
  D.S SD:0x100010B4 %LE %LONG 0x00000000;
  D.S SD:0x102390e4 %LE %LONG 0x00000000;
  D.S SD:0x102490e4 %LE %LONG 0x00000000;
;broadcast_on();
  D.S SD:0x100010B4 %LE %LONG 0x0000007f;
  D.S SD:0x10231694 %LE %LONG 0x001e0006;
  D.S SD:0x10231690 %LE %LONG 0x00020111;
  D.S SD:0x102316f8 %LE %LONG 0x00001300;
  D.S SD:0x102312c0 %LE %LONG 0x00000000;
  D.S SD:0x102314c0 %LE %LONG 0x00000000;
  D.S SD:0x10231228 %LE %LONG 0x03f003f0;
  D.S SD:0x10231428 %LE %LONG 0x03f003f0;
  D.S SD:0x1023122c %LE %LONG 0x00190026;
  D.S SD:0x1023142c %LE %LONG 0x00190026;
  D.S SD:0x10231230 %LE %LONG 0x00190026;
  D.S SD:0x10231430 %LE %LONG 0x00190026;
  D.S SD:0x10231688 %LE %LONG 0x18000020;
  D.S SD:0x10231684 %LE %LONG 0x40000200;
  D.S SD:0x10231614 %LE %LONG 0x00036400;
  D.S SD:0x102316d4 %LE %LONG 0x00000005;
  D.S SD:0x10231264 %LE %LONG 0x00000001;
  D.S SD:0x10231464 %LE %LONG 0x00000001;
  D.S SD:0x102316d4 %LE %LONG 0x00000015;
  D.S SD:0x102390b4 %LE %LONG 0x0080c010;
;line  5347, END
;line  5351, DPI_DRAMC_initial_entry
;broadcast_on();
  D.S SD:0x100010B4 %LE %LONG 0x0000007f;
  D.S SD:0x102301c0 %LE %LONG 0x1c000240;
  D.S SD:0x1023866c %LE %LONG 0x00000101;
  D.S SD:0x1023866c %LE %LONG 0x00000100;
  D.S SD:0x1023866c %LE %LONG 0x00000100;
  D.S SD:0x1023866c %LE %LONG 0x00000102;
  D.S SD:0x1023866c %LE %LONG 0x00000100;
  D.S SD:0x10238f18 %LE %LONG 0x0000000c;
  D.S SD:0x10238f98 %LE %LONG 0x0000000c;
  D.S SD:0x10239018 %LE %LONG 0x00000000;
  D.S SD:0x10238e98 %LE %LONG 0x0000000c;
  D.S SD:0x10238f24 %LE %LONG 0x880aec00;
  D.S SD:0x10238fa4 %LE %LONG 0x880aec00;
  D.S SD:0x10239024 %LE %LONG 0x880aec00;
  D.S SD:0x10238ea4 %LE %LONG 0x880bac00;
  D.S SD:0x10238948 %LE %LONG 0x00000000;
  D.S SD:0x10238008 %LE %LONG 0x00000000;
  D.S SD:0x10238000 %LE %LONG 0x00000000;
  D.S SD:0x10238008 %LE %LONG 0x00000000;
  D.S SD:0x102384a0 %LE %LONG 0x00180101;
  D.S SD:0x102387bc %LE %LONG 0x01001000;
  D.S SD:0x102387bc %LE %LONG 0x81001000;
  D.S SD:0x102384a0 %LE %LONG 0x00080101;
  D.S SD:0x102386b4 %LE %LONG 0x007ffffa;
  D.S SD:0x102384e0 %LE %LONG 0xfffeef1e;
  D.S SD:0x10238560 %LE %LONG 0xfffeef1e;
  D.S SD:0x102385e0 %LE %LONG 0x00000000;
  D.S SD:0x10238460 %LE %LONG 0xfffeff5e;
  D.S SD:0x102386b4 %LE %LONG 0x0061c7fa;
  D.S SD:0x102384e0 %LE %LONG 0xfffeefde;
  D.S SD:0x10238560 %LE %LONG 0xfffeefde;
  D.S SD:0x102385e0 %LE %LONG 0x1ffe23d0;
  D.S SD:0x10238460 %LE %LONG 0xfffffffe;
  D.S SD:0x10238688 %LE %LONG 0x00bbbb30;
  D.S SD:0x102384e0 %LE %LONG 0xfffeefde;
  D.S SD:0x10238560 %LE %LONG 0xfffeefde;
  D.S SD:0x102385e0 %LE %LONG 0xe0004000;
  D.S SD:0x10238460 %LE %LONG 0xfffffffe;
  D.S SD:0x102386b4 %LE %LONG 0x0061c7fa;
  D.S SD:0x102387d0 %LE %LONG 0x000b2402;
  D.S SD:0x10238460 %LE %LONG 0xfffffffe;
  D.S SD:0x1023848c %LE %LONG 0x00214040;
  D.S SD:0x1023850c %LE %LONG 0x00244040;
  D.S SD:0x1023858c %LE %LONG 0x00244040;
  D.S SD:0x1023860c %LE %LONG 0x00200000;
  D.S SD:0x1023847c %LE %LONG 0x0000c000;
  D.S SD:0x102384fc %LE %LONG 0x00000000;
  D.S SD:0x1023857c %LE %LONG 0x00000000;
  D.S SD:0x102385fc %LE %LONG 0x00000000;
  D.S SD:0x10238480 %LE %LONG 0x0000000c;
  D.S SD:0x10238500 %LE %LONG 0x0000000c;
  D.S SD:0x10238580 %LE %LONG 0x0000000c;
  D.S SD:0x10238600 %LE %LONG 0x0000000c;
  D.S SD:0x10238534 %LE %LONG 0x00000000;
  D.S SD:0x102385b4 %LE %LONG 0x00000000;
  D.S SD:0x10238634 %LE %LONG 0x00000000;
  D.S SD:0x102384b4 %LE %LONG 0x00000000;
  D.S SD:0x10238530 %LE %LONG 0x00000000;
  D.S SD:0x10238530 %LE %LONG 0x00000000;
  D.S SD:0x10238530 %LE %LONG 0x00000000;
  D.S SD:0x10238530 %LE %LONG 0x00000000;
  D.S SD:0x10238530 %LE %LONG 0x00000000;
  D.S SD:0x10238530 %LE %LONG 0x00000000;
  D.S SD:0x10238530 %LE %LONG 0x00000000;
  D.S SD:0x10238530 %LE %LONG 0x00000000;
  D.S SD:0x10238530 %LE %LONG 0x00000000;
  D.S SD:0x10238530 %LE %LONG 0x00000000;
  D.S SD:0x10238530 %LE %LONG 0x00000000;
  D.S SD:0x10238530 %LE %LONG 0x00000000;
  D.S SD:0x10238530 %LE %LONG 0x00000000;
  D.S SD:0x10238530 %LE %LONG 0x00000000;
  D.S SD:0x10238530 %LE %LONG 0x00000000;
  D.S SD:0x10238530 %LE %LONG 0x00000000;
  D.S SD:0x10238530 %LE %LONG 0x00000000;
  D.S SD:0x10238530 %LE %LONG 0x00000000;
  D.S SD:0x10238630 %LE %LONG 0x00000000;
  D.S SD:0x10238630 %LE %LONG 0x00000000;
  D.S SD:0x10238630 %LE %LONG 0x00000000;
  D.S SD:0x10238630 %LE %LONG 0x00000000;
  D.S SD:0x10238630 %LE %LONG 0x00000000;
  D.S SD:0x10238630 %LE %LONG 0x00000000;
  D.S SD:0x10238630 %LE %LONG 0x00000000;
  D.S SD:0x10238630 %LE %LONG 0x00000000;
  D.S SD:0x10238630 %LE %LONG 0x00000000;
  D.S SD:0x10238630 %LE %LONG 0x00000000;
  D.S SD:0x10238630 %LE %LONG 0x00000000;
  D.S SD:0x10238630 %LE %LONG 0x00000000;
  D.S SD:0x10238630 %LE %LONG 0x00000000;
  D.S SD:0x10238630 %LE %LONG 0x00000000;
  D.S SD:0x10238630 %LE %LONG 0x00000000;
  D.S SD:0x10238630 %LE %LONG 0x00000000;
  D.S SD:0x10238630 %LE %LONG 0x00000000;
  D.S SD:0x10238630 %LE %LONG 0x00000000;
  D.S SD:0x1023848c %LE %LONG 0x00200000;
  D.S SD:0x1023850c %LE %LONG 0x00211040;
  D.S SD:0x10238500 %LE %LONG 0x0000040e;
  D.S SD:0x1023858c %LE %LONG 0x00211040;
  D.S SD:0x10238580 %LE %LONG 0x0000040e;
  D.S SD:0x1023860c %LE %LONG 0x00011040;
  D.S SD:0x10238600 %LE %LONG 0x00000402;
  D.S SD:0x10238498 %LE %LONG 0x00000051;
  D.S SD:0x10238518 %LE %LONG 0x00000051;
  D.S SD:0x10238598 %LE %LONG 0x00000051;
  D.S SD:0x10238618 %LE %LONG 0x00000011;
  D.S SD:0x10238494 %LE %LONG 0x00000500;
  D.S SD:0x10238514 %LE %LONG 0x00002000;
  D.S SD:0x10238594 %LE %LONG 0x00002000;
  D.S SD:0x10238614 %LE %LONG 0x00002000;
  D.S SD:0x10239120 %LE %LONG 0x00030007;
  D.S SD:0x102386cc %LE %LONG 0x0007e010;
  D.S SD:0x102386c0 %LE %LONG 0x40000000;
  D.S SD:0x102386c0 %LE %LONG 0x40000004;
  D.S SD:0x102386c0 %LE %LONG 0x40000004;
  D.S SD:0x10238478 %LE %LONG 0x60000000;
  D.S SD:0x102384f8 %LE %LONG 0x70000000;
  D.S SD:0x10238578 %LE %LONG 0x70000000;
  D.S SD:0x102385f8 %LE %LONG 0x70000000;
  D.S SD:0x10238470 %LE %LONG 0x00200000;
  D.S SD:0x102384f0 %LE %LONG 0x00000000;
  D.S SD:0x10238570 %LE %LONG 0x00000000;
  D.S SD:0x102385f0 %LE %LONG 0x00000000;
  D.S SD:0x10238478 %LE %LONG 0x60000000;
  D.S SD:0x102384f8 %LE %LONG 0x70000000;
  D.S SD:0x10238578 %LE %LONG 0x70000000;
  D.S SD:0x102385f8 %LE %LONG 0x00000000;
  D.S SD:0x10238900 %LE %LONG 0xe47800ff;
  D.S SD:0x10238920 %LE %LONG 0xe47800ff;
  D.S SD:0x10238908 %LE %LONG 0x00040000;
  D.S SD:0x10238928 %LE %LONG 0x00040000;
  D.S SD:0x10238904 %LE %LONG 0x5a000002;
  D.S SD:0x10238924 %LE %LONG 0x5a000002;
  D.S SD:0x10238944 %LE %LONG 0x00000011;
  D.S SD:0x1023890c %LE %LONG 0x00000121;
  D.S SD:0x1023892c %LE %LONG 0x00000121;
  D.S SD:0x102390c0 %LE %LONG 0x00000000;
  D.S SD:0x1023890c %LE %LONG 0x00000121;
  D.S SD:0x1023892c %LE %LONG 0x00000121;
  D.S SD:0x10238918 %LE %LONG 0x00000002;
  D.S SD:0x10238938 %LE %LONG 0x00000002;
  D.S SD:0x10238ea8 %LE %LONG 0x00012000;
  D.S SD:0x10238f28 %LE %LONG 0x0002e800;
  D.S SD:0x10238f28 %LE %LONG 0x000ae800;
  D.S SD:0x10238fa8 %LE %LONG 0x0002e800;
  D.S SD:0x10238fa8 %LE %LONG 0x000ae800;
  D.S SD:0x10239028 %LE %LONG 0x0002e800;
  D.S SD:0x10239028 %LE %LONG 0x00080000;
  D.S SD:0x10238e78 %LE %LONG 0x00001071;
  D.S SD:0x10238ef8 %LE %LONG 0x00003071;
  D.S SD:0x10238f78 %LE %LONG 0x00003071;
  D.S SD:0x10238ff8 %LE %LONG 0x00003071;
  D.S SD:0x10238f04 %LE %LONG 0x00000000;
  D.S SD:0x10238f84 %LE %LONG 0x00000000;
  D.S SD:0x10239004 %LE %LONG 0x00000000;
  D.S SD:0x10238e84 %LE %LONG 0x000a0000;
  D.S SD:0x10238ef4 %LE %LONG 0x80000000;
  D.S SD:0x10238f74 %LE %LONG 0x80000000;
  D.S SD:0x10238ff4 %LE %LONG 0x80000000;
  D.S SD:0x10238e74 %LE %LONG 0x80000000;
  D.S SD:0x10238eb8 %LE %LONG 0x00480000;
  D.S SD:0x10238ec4 %LE %LONG 0x00005000;
  D.S SD:0x10238eb4 %LE %LONG 0x00000001;
  D.S SD:0x10238f34 %LE %LONG 0xa0068009;
  D.S SD:0x10238fb4 %LE %LONG 0xa0068009;
  D.S SD:0x10239034 %LE %LONG 0xa0068009;
  D.S SD:0x10238f38 %LE %LONG 0x00000000;
  D.S SD:0x10238fb8 %LE %LONG 0x00000000;
  D.S SD:0x10239038 %LE %LONG 0x00000000;
  D.S SD:0x10238f34 %LE %LONG 0xa0068009;
  D.S SD:0x10238fb4 %LE %LONG 0xa0068009;
  D.S SD:0x10239034 %LE %LONG 0x00000000;
  D.S SD:0x10238f38 %LE %LONG 0x00000000;
  D.S SD:0x10238f44 %LE %LONG 0x00000000;
  D.S SD:0x10238fb8 %LE %LONG 0x00000000;
  D.S SD:0x10238fc4 %LE %LONG 0x00000000;
  D.S SD:0x10239038 %LE %LONG 0x00000000;
  D.S SD:0x10239038 %LE %LONG 0x00000000;
  D.S SD:0x10238f34 %LE %LONG 0xa006800d;
  D.S SD:0x10238fb4 %LE %LONG 0xa006800d;
  D.S SD:0x10239034 %LE %LONG 0x00000004;
  D.S SD:0x10238eb4 %LE %LONG 0x00000001;
  D.S SD:0x10238e78 %LE %LONG 0x00001071;
  D.S SD:0x10238efc %LE %LONG 0x0000810c;
  D.S SD:0x10238f00 %LE %LONG 0x00000003;
  D.S SD:0x10238ef8 %LE %LONG 0x00033071;
  D.S SD:0x10238f30 %LE %LONG 0x001e0000;
  D.S SD:0x10238f7c %LE %LONG 0x0000810c;
  D.S SD:0x10238f80 %LE %LONG 0x00000003;
  D.S SD:0x10238f78 %LE %LONG 0x00033071;
  D.S SD:0x10238fb0 %LE %LONG 0x001e0000;
  D.S SD:0x10238ffc %LE %LONG 0x0000810c;
  D.S SD:0x10239000 %LE %LONG 0x00000003;
  D.S SD:0x10238ff8 %LE %LONG 0x00030000;
  D.S SD:0x10239030 %LE %LONG 0x001e0000;
  D.S SD:0x10238a4c %LE %LONG 0x00001000;
  D.S SD:0x10238acc %LE %LONG 0x00001000;
  D.S SD:0x10238ccc %LE %LONG 0x00001000;
  D.S SD:0x10238d4c %LE %LONG 0x00001000;
  D.S SD:0x10238eec %LE %LONG 0x00b3000e;
  D.S SD:0x10238f6c %LE %LONG 0x00b3000e;
  D.S SD:0x10238fec %LE %LONG 0x00030000;
  D.S SD:0x10238f1c %LE %LONG 0x00000020;
  D.S SD:0x10238f9c %LE %LONG 0x00000020;
  D.S SD:0x1023901c %LE %LONG 0x00000020;
  D.S SD:0x10238e9c %LE %LONG 0x00000060;
  D.S SD:0x10239124 %LE %LONG 0x333f3f00;
  D.S SD:0x10238f38 %LE %LONG 0x00000020;
  D.S SD:0x10238fb8 %LE %LONG 0x00000020;
  D.S SD:0x10239038 %LE %LONG 0x00000020;
  D.S SD:0x10238ef0 %LE %LONG 0x00000000;
  D.S SD:0x10238f70 %LE %LONG 0x00000000;
  D.S SD:0x10238ff0 %LE %LONG 0x00000000;
  D.S SD:0x10238e80 %LE %LONG 0x00020000;
  D.S SD:0x10238f00 %LE %LONG 0x00020003;
  D.S SD:0x10238f80 %LE %LONG 0x00020003;
  D.S SD:0x10239000 %LE %LONG 0x00020000;
  D.S SD:0x10238e60 %LE %LONG 0x00000000;
  D.S SD:0x10238ee0 %LE %LONG 0x00000000;
  D.S SD:0x10238f60 %LE %LONG 0x00000000;
  D.S SD:0x10238fe0 %LE %LONG 0x00000000;
  D.S SD:0x10238eb8 %LE %LONG 0x00480000;
  D.S SD:0x10238f38 %LE %LONG 0x00000020;
  D.S SD:0x10238fb8 %LE %LONG 0x00000020;
  D.S SD:0x10239038 %LE %LONG 0x00000000;
  D.S SD:0x10238e60 %LE %LONG 0x00000000;
  D.S SD:0x10238ee0 %LE %LONG 0x00000000;
  D.S SD:0x10238f60 %LE %LONG 0x00000000;
  D.S SD:0x10238fe0 %LE %LONG 0x00000000;
  D.S SD:0x10238e64 %LE %LONG 0x00000000;
  D.S SD:0x10238ee4 %LE %LONG 0x00008888;
  D.S SD:0x10238f64 %LE %LONG 0x00008888;
  D.S SD:0x10238fe4 %LE %LONG 0x00000000;
  D.S SD:0x10238e64 %LE %LONG 0x00000000;
  D.S SD:0x10238ee4 %LE %LONG 0x00008888;
  D.S SD:0x10238f64 %LE %LONG 0x00008888;
  D.S SD:0x10238fe4 %LE %LONG 0x00000000;
  D.S SD:0x10238eb8 %LE %LONG 0x00480020;
  D.S SD:0x10238e70 %LE %LONG 0x00000000;
  D.S SD:0x10238f18 %LE %LONG 0x0000000c;
  D.S SD:0x10238f98 %LE %LONG 0x0000000c;
  D.S SD:0x10239018 %LE %LONG 0x00000000;
  D.S SD:0x10238e98 %LE %LONG 0x0000030c;
  D.S SD:0x10238ef0 %LE %LONG 0x00100000;
  D.S SD:0x10238f70 %LE %LONG 0x00100000;
  D.S SD:0x10238ff0 %LE %LONG 0x00100000;
  D.S SD:0x10238ef4 %LE %LONG 0x84000000;
  D.S SD:0x10238f74 %LE %LONG 0x84000000;
  D.S SD:0x10238ff4 %LE %LONG 0x04000000;
  D.S SD:0x10238e70 %LE %LONG 0x04100010;
  D.S SD:0x10238ea8 %LE %LONG 0x0003a000;
  D.S SD:0x10238ea8 %LE %LONG 0x000ba000;
  D.S SD:0x10238e70 %LE %LONG 0x04500010;
  D.S SD:0x10238eb4 %LE %LONG 0x00000001;
  D.S SD:0x10238e74 %LE %LONG 0x84002c00;
  D.S SD:0x10238e74 %LE %LONG 0x84002c00;
  D.S SD:0x10238e70 %LE %LONG 0x0c500010;
  D.S SD:0x10238f18 %LE %LONG 0x0000000c;
  D.S SD:0x10238f98 %LE %LONG 0x0000000c;
  D.S SD:0x10239018 %LE %LONG 0x00000000;
  D.S SD:0x10238ea4 %LE %LONG 0x880bac00;
  D.S SD:0x10238ea4 %LE %LONG 0x880bac00;
  D.S SD:0x10238e94 %LE %LONG 0x04707000;
  D.S SD:0x10238e98 %LE %LONG 0x00007f1c;
  D.S SD:0x10238e9c %LE %LONG 0x00000061;
  D.S SD:0x10238f14 %LE %LONG 0x04707000;
  D.S SD:0x10238f18 %LE %LONG 0x00007c1c;
  D.S SD:0x10238f94 %LE %LONG 0x04707000;
  D.S SD:0x10238f98 %LE %LONG 0x00007c1c;
  D.S SD:0x10239014 %LE %LONG 0x04707000;
  D.S SD:0x10239018 %LE %LONG 0x00007c10;
  D.S SD:0x10238f18 %LE %LONG 0x00007c1c;
  D.S SD:0x10238f98 %LE %LONG 0x00007c1c;
  D.S SD:0x10239018 %LE %LONG 0x00000000;
  D.S SD:0x10238008 %LE %LONG 0x00010000;
  D.S SD:0x10238004 %LE %LONG 0x00000000;
  D.S SD:0x10238000 %LE %LONG 0x80000000;
  D.S SD:0x102387c4 %LE %LONG 0x11251125;
  D.S SD:0x10238f24 %LE %LONG 0x880aec00;
  D.S SD:0x10238fa4 %LE %LONG 0x880aec00;
  D.S SD:0x10239024 %LE %LONG 0x00020400;
  D.S SD:0x10238ea4 %LE %LONG 0x880bac00;
  D.S SD:0x10238f24 %LE %LONG 0x880aec00;
  D.S SD:0x10238fa4 %LE %LONG 0x880aec00;
  D.S SD:0x10239024 %LE %LONG 0x880aec00;
  D.S SD:0x10238ea4 %LE %LONG 0x880bac00;
  D.S SD:0x10238940 %LE %LONG 0x00000003;
  D.S SD:0x10238948 %LE %LONG 0x00000000;
  D.S SD:0x10238008 %LE %LONG 0x00010000;
  D.S SD:0x10238e74 %LE %LONG 0x84002c01;
  D.S SD:0x10238e74 %LE %LONG 0x84002c01;
  D.S SD:0x10238f3c %LE %LONG 0x00000001;
  D.S SD:0x10238fbc %LE %LONG 0x00000001;
  D.S SD:0x1023903c %LE %LONG 0x00000001;
  D.S SD:0x10238ebc %LE %LONG 0x00000001;
  D.S SD:0x1023846c %LE %LONG 0x00000000;
  D.S SD:0x102384ec %LE %LONG 0x00000000;
  D.S SD:0x1023856c %LE %LONG 0x00000000;
  D.S SD:0x102385ec %LE %LONG 0x00000000;
  D.S SD:0x1023846c %LE %LONG 0x00000008;
  D.S SD:0x102384ec %LE %LONG 0x00000008;
  D.S SD:0x1023856c %LE %LONG 0x00000008;
  D.S SD:0x102385ec %LE %LONG 0x00000008;
  D.S SD:0x10238948 %LE %LONG 0x00000001;
  D.S SD:0x10238008 %LE %LONG 0x00610000;
  D.S SD:0x10238534 %LE %LONG 0x00200000;
  D.S SD:0x102385b4 %LE %LONG 0x00200000;
  D.S SD:0x10238634 %LE %LONG 0x00200000;
  D.S SD:0x102384b4 %LE %LONG 0x00200000;
  D.S SD:0x10238f24 %LE %LONG 0x00000400;
  D.S SD:0x10238fa4 %LE %LONG 0x00000400;
  D.S SD:0x10239024 %LE %LONG 0x00000400;
  D.S SD:0x10238ea4 %LE %LONG 0x00000000;
  D.S SD:0x1023869c %LE %LONG 0x0005b003;
  D.S SD:0x10238684 %LE %LONG 0x81f80000;
  D.S SD:0x10238674 %LE %LONG 0x03e003be;
  D.S SD:0x10238674 %LE %LONG 0x03e003bf;
;broadcast_off();
  D.S SD:0x100010B4 %LE %LONG 0x00000000;
  D.S SD:0x10230208 %LE %LONG 0x00100780;
  D.S SD:0x10240208 %LE %LONG 0x00100782;
  D.S SD:0x1023869c %LE %LONG 0x0001b003;
  D.S SD:0x1024869c %LE %LONG 0x0001b003;
;broadcast_on();
  D.S SD:0x100010B4 %LE %LONG 0x0000007f;
  D.S SD:0x1023866c %LE %LONG 0x00000102;
  D.S SD:0x1023866c %LE %LONG 0x00000100;
  D.S SD:0x1023866c %LE %LONG 0x00000111;
  D.S SD:0x1023866c %LE %LONG 0x00000110;
  D.S SD:0x1023866c %LE %LONG 0x20000110;
  D.S SD:0x10238854 %LE %LONG 0x5be003bf;
  D.S SD:0x10238854 %LE %LONG 0x4be003bf;
  D.S SD:0x1023866c %LE %LONG 0x20000190;
  D.S SD:0x10238494 %LE %LONG 0x00000700;
  D.S SD:0x10238514 %LE %LONG 0x0000a000;
  D.S SD:0x10238594 %LE %LONG 0x0000a000;
  D.S SD:0x10238614 %LE %LONG 0x00008000;
  D.S SD:0x10238e98 %LE %LONG 0x00017f1c;
  D.S SD:0x10238f18 %LE %LONG 0x00007c1c;
  D.S SD:0x10238f98 %LE %LONG 0x00007c1c;
  D.S SD:0x10239018 %LE %LONG 0x00000000;
  D.S SD:0x102387c4 %LE %LONG 0x11351135;
  D.S SD:0x1023866c %LE %LONG 0x260bff90;
  D.S SD:0x10238674 %LE %LONG 0x00600b6f;
  D.S SD:0x1023867c %LE %LONG 0x7fffffff;
  D.S SD:0x10238680 %LE %LONG 0x00000000;
  D.S SD:0x102387a4 %LE %LONG 0x00000020;
  D.S SD:0x102387c4 %LE %LONG 0x1d001100;
  D.S SD:0x102387c8 %LE %LONG 0x00000100;
  D.S SD:0x102387e8 %LE %LONG 0x00000000;
  D.S SD:0x10238840 %LE %LONG 0x00000008;
  D.S SD:0x10238854 %LE %LONG 0x4be003ff;
  D.S SD:0x10238858 %LE %LONG 0x000fffff;
  D.S SD:0x1023885c %LE %LONG 0x00000000;
  D.S SD:0x10230000 %LE %LONG 0x00000121;
  D.S SD:0x10230110 %LE %LONG 0x61028010;
  D.S SD:0x10230168 %LE %LONG 0x04589780;
  D.S SD:0x10230190 %LE %LONG 0x00200001;
  D.S SD:0x102301fc %LE %LONG 0x001f0068;
  D.S SD:0x10230200 %LE %LONG 0x00020604;
  D.S SD:0x10230208 %LE %LONG 0x00180780;
  D.S SD:0x1023021c %LE %LONG 0x00000110;
  D.S SD:0x1023023c %LE %LONG 0x1800003e;
  D.S SD:0x10230244 %LE %LONG 0xc0000000;
  D.S SD:0x10230250 %LE %LONG 0x91080002;
  D.S SD:0x10230260 %LE %LONG 0x08347fff;
  D.S SD:0x10230288 %LE %LONG 0xc0000000;
  D.S SD:0x10230340 %LE %LONG 0x000fffff;
  D.S SD:0x10230240 %LE %LONG 0x7000001c;
  D.S SD:0x10230310 %LE %LONG 0x00003000;
  D.S SD:0x10238674 %LE %LONG 0x00600b6f;
  D.S SD:0x10238674 %LE %LONG 0x00600b7e;
  D.S SD:0x10238674 %LE %LONG 0x00600b7f;
  D.S SD:0x10238674 %LE %LONG 0x00600b7e;
  D.S SD:0x10238674 %LE %LONG 0x00600b6f;
  D.S SD:0x102387b8 %LE %LONG 0x38000001;
  D.S SD:0x102387e0 %LE %LONG 0x00000100;
  D.S SD:0x102387ac %LE %LONG 0x01000000;
  D.S SD:0x10238518 %LE %LONG 0x000000d1;
  D.S SD:0x10238598 %LE %LONG 0x000000d1;
  D.S SD:0x10238618 %LE %LONG 0x00000080;
  D.S SD:0x102387bc %LE %LONG 0x81001000;
  D.S SD:0x10238518 %LE %LONG 0x000000d1;
  D.S SD:0x10238598 %LE %LONG 0x000000d1;
  D.S SD:0x10238618 %LE %LONG 0x00000040;
  D.S SD:0x1023851c %LE %LONG 0x00000001;
  D.S SD:0x1023859c %LE %LONG 0x00000001;
  D.S SD:0x1023861c %LE %LONG 0x00000001;
  D.S SD:0x10238498 %LE %LONG 0x00000051;
  D.S SD:0x102386ac %LE %LONG 0x00000b50;
  D.S SD:0x10238668 %LE %LONG 0x001d0004;
  D.S SD:0x10238664 %LE %LONG 0x00010375;
  D.S SD:0x10238664 %LE %LONG 0x00010375;
  D.S SD:0x1023850c %LE %LONG 0x002110c0;
  D.S SD:0x1023858c %LE %LONG 0x002110c0;
  D.S SD:0x1023860c %LE %LONG 0x00000080;
  D.S SD:0x10238668 %LE %LONG 0x001d0004;
  D.S SD:0x10238518 %LE %LONG 0x000000f1;
  D.S SD:0x10238598 %LE %LONG 0x000000f1;
  D.S SD:0x10238618 %LE %LONG 0x00000020;
  D.S SD:0x1023850c %LE %LONG 0x002190c0;
  D.S SD:0x1023858c %LE %LONG 0x002190c0;
  D.S SD:0x1023860c %LE %LONG 0x00008000;
  D.S SD:0x10238664 %LE %LONG 0x00010375;
  D.S SD:0x10238660 %LE %LONG 0xfc100001;
  D.S SD:0x10238664 %LE %LONG 0x00010375;
  D.S SD:0x102387b8 %LE %LONG 0x38000021;
  D.S SD:0x1023850c %LE %LONG 0x002190c0;
  D.S SD:0x10238518 %LE %LONG 0x001000f1;
  D.S SD:0x1023858c %LE %LONG 0x002190c0;
  D.S SD:0x10238598 %LE %LONG 0x001000f1;
  D.S SD:0x1023860c %LE %LONG 0x00000000;
  D.S SD:0x10238618 %LE %LONG 0x00100000;
  D.S SD:0x10238524 %LE %LONG 0x10000010;
  D.S SD:0x102385a4 %LE %LONG 0x10000010;
  D.S SD:0x10238624 %LE %LONG 0x10000010;
  D.S SD:0x102384a4 %LE %LONG 0x00000010;
  D.S SD:0x10238660 %LE %LONG 0xfc120001;
  D.S SD:0x102387bc %LE %LONG 0x81001000;
  D.S SD:0x10238668 %LE %LONG 0x401d0004;
  D.S SD:0x102387b0 %LE %LONG 0x00000001;
  D.S SD:0x102387b4 %LE %LONG 0x00000001;
  D.S SD:0x10238668 %LE %LONG 0x401d0004;
  D.S SD:0x1023021c %LE %LONG 0x00000110;
  D.S SD:0x10230000 %LE %LONG 0x00080121;
  D.S SD:0x102387bc %LE %LONG 0x81001000;
  D.S SD:0x10230264 %LE %LONG 0x05733009;
  D.S SD:0x10230268 %LE %LONG 0x3203116d;
  D.S SD:0x1023028c %LE %LONG 0x0000041f;
  D.S SD:0x10230170 %LE %LONG 0x00000002;
  D.S SD:0x1023024c %LE %LONG 0x340a2810;
  D.S SD:0x10230190 %LE %LONG 0x00200041;
  D.S SD:0x10230258 %LE %LONG 0x05050080;
  D.S SD:0x10230330 %LE %LONG 0x00000001;
  D.S SD:0x10230260 %LE %LONG 0x09347fff;
  D.S SD:0x102301fc %LE %LONG 0xc01f002b;
  D.S SD:0x10230228 %LE %LONG 0x00000000;
  D.S SD:0x10230204 %LE %LONG 0x81504c00;
  D.S SD:0x10230168 %LE %LONG 0x04589780;
  D.S SD:0x1023017c %LE %LONG 0x00000161;
  D.S SD:0x10230254 %LE %LONG 0x00004f00;
  D.S SD:0x10230178 %LE %LONG 0x00000800;
  D.S SD:0x102301a0 %LE %LONG 0x00000a56;
  D.S SD:0x102301c8 %LE %LONG 0x00020000;
  D.S SD:0x10230174 %LE %LONG 0x0000000f;
  D.S SD:0x10230220 %LE %LONG 0x00000944;
  D.S SD:0x10230500 %LE %LONG 0x00080000;
  D.S SD:0x10230104 %LE %LONG 0x00000200;
  D.S SD:0x10230108 %LE %LONG 0x12010800;
  D.S SD:0x1023010c %LE %LONG 0x4001110d;
  D.S SD:0x1023021c %LE %LONG 0x00000110;
  D.S SD:0x10230250 %LE %LONG 0x91084102;
  D.S SD:0x10230284 %LE %LONG 0x00000003;
  D.S SD:0x1023020c %LE %LONG 0x0000001a;
  D.S SD:0x10230210 %LE %LONG 0x00010f05;
  D.S SD:0x10230278 %LE %LONG 0x22255422;
  D.S SD:0x1023027c %LE %LONG 0x22335555;
  D.S SD:0x10230150 %LE %LONG 0x08081800;
  D.S SD:0x10230238 %LE %LONG 0x01400010;
  D.S SD:0x10230238 %LE %LONG 0x01400050;
  D.S SD:0x10230248 %LE %LONG 0x090e3160;
  D.S SD:0x10230110 %LE %LONG 0x69028010;
  D.S SD:0x10230590 %LE %LONG 0x00000000;
  D.S SD:0x10230790 %LE %LONG 0x00000000;
  D.S SD:0x102301b0 %LE %LONG 0x00000000;
  D.S SD:0x10230290 %LE %LONG 0x80000000;
  D.S SD:0x1023012c %LE %LONG 0x80000005;
  D.S SD:0x102302c0 %LE %LONG 0x00005563;
  D.S SD:0x102302c0 %LE %LONG 0x00005560;
  D.S SD:0x10230234 %LE %LONG 0x00000001;
  D.S SD:0x10230240 %LE %LONG 0x7000001e;
  D.S SD:0x10230174 %LE %LONG 0x0000004f;
  D.S SD:0x10238898 %LE %LONG 0x00705000;
  D.S SD:0x102388e4 %LE %LONG 0x00a00240;
  D.S SD:0x102387fc %LE %LONG 0xffffffff;
  D.S SD:0x10238808 %LE %LONG 0xffffffff;
  D.S SD:0x10238814 %LE %LONG 0xffffffff;
;broadcast_off();
  D.S SD:0x100010B4 %LE %LONG 0x00000000;
  D.S SD:0x102301a0 %LE %LONG 0x20000a56;
  D.S SD:0x102401a0 %LE %LONG 0x00000a56;
  D.S SD:0x10230168 %LE %LONG 0x04589780;
  D.S SD:0x102387b8 %LE %LONG 0x380c0021;
  D.S SD:0x102386c4 %LE %LONG 0x241a5c28;
  D.S SD:0x10240168 %LE %LONG 0x04589780;
  D.S SD:0x102487b8 %LE %LONG 0x380c0021;
  D.S SD:0x102486c4 %LE %LONG 0x241a9c28;
;broadcast_on();
  D.S SD:0x100010B4 %LE %LONG 0x0000007f;
  D.S SD:0x10230208 %LE %LONG 0x00180680;
  D.S SD:0x102386b8 %LE %LONG 0x00000000;
  D.S SD:0x10238898 %LE %LONG 0x00705000;
  D.S SD:0x1023889c %LE %LONG 0x2e01ffff;
  D.S SD:0x10238684 %LE %LONG 0x81f90000;
  D.S SD:0x10238690 %LE %LONG 0x38303333;
  D.S SD:0x10230208 %LE %LONG 0x00180680;
  D.S SD:0x10238698 %LE %LONG 0x740012b0;
  D.S SD:0x102386a0 %LE %LONG 0x00000007;
  D.S SD:0x10230210 %LE %LONG 0x00010f01;
  D.S SD:0x10238694 %LE %LONG 0x02400775;
  D.S SD:0x102387d8 %LE %LONG 0x05090909;
  D.S SD:0x10238690 %LE %LONG 0x38303333;
;broadcast_off();
  D.S SD:0x100010B4 %LE %LONG 0x00000000;
  D.S SD:0x10248694 %LE %LONG 0x02400775;
;broadcast_on();
  D.S SD:0x100010B4 %LE %LONG 0x0000007f;
;broadcast_off();
  D.S SD:0x100010B4 %LE %LONG 0x00000000;
  D.S SD:0x10248690 %LE %LONG 0x38303336;
  D.S SD:0x10248698 %LE %LONG 0x940012b0;
;broadcast_on();
  D.S SD:0x100010B4 %LE %LONG 0x0000007f;
  D.S SD:0x1023868c %LE %LONG 0x80a00002;
  D.S SD:0x1023868c %LE %LONG 0x80a00002;
  D.S SD:0x1023868c %LE %LONG 0xa0a00002;
  D.S SD:0x10230208 %LE %LONG 0x00180680;
  D.S SD:0x102387c8 %LE %LONG 0x0000013f;
  D.S SD:0x102387c4 %LE %LONG 0x1d001100;
  D.S SD:0x102387bc %LE %LONG 0x8100100c;
  D.S SD:0x10238490 %LE %LONG 0x00000000;
  D.S SD:0x10238510 %LE %LONG 0x00000000;
  D.S SD:0x10238590 %LE %LONG 0x00000000;
  D.S SD:0x10238610 %LE %LONG 0x00000000;
  D.S SD:0x102387bc %LE %LONG 0x8100300c;
  D.S SD:0x10239120 %LE %LONG 0x00430000;
  D.S SD:0x10239124 %LE %LONG 0x22400000;
  D.S SD:0x10238f04 %LE %LONG 0x00000000;
  D.S SD:0x10238f84 %LE %LONG 0x00000000;
  D.S SD:0x10239004 %LE %LONG 0x00000000;
  D.S SD:0x10238f08 %LE %LONG 0xfdf8004a;
  D.S SD:0x10238f88 %LE %LONG 0xfdf8004a;
  D.S SD:0x10239008 %LE %LONG 0xfdf80000;
  D.S SD:0x10238e88 %LE %LONG 0xfc200000;
  D.S SD:0x102390a8 %LE %LONG 0x20000000;
  D.S SD:0x10239120 %LE %LONG 0x00430000;
  D.S SD:0x10239124 %LE %LONG 0x11400000;
  D.S SD:0x1023168c %LE %LONG 0x0000003f;
  D.S SD:0x102316ac %LE %LONG 0x00000000;
  D.S SD:0x10239140 %LE %LONG 0x00798142;
  D.S SD:0x10231618 %LE %LONG 0x00000000;
  D.S SD:0x1023161c %LE %LONG 0x00010000;
  D.S SD:0x10231620 %LE %LONG 0x00000000;
  D.S SD:0x10231624 %LE %LONG 0x00000000;
  D.S SD:0x10231628 %LE %LONG 0x11111011;
  D.S SD:0x1023162c %LE %LONG 0x01000111;
  D.S SD:0x10231630 %LE %LONG 0x11111111;
  D.S SD:0x10231634 %LE %LONG 0x11111111;
  D.S SD:0x1023169c %LE %LONG 0xd8000005;
  D.S SD:0x10239068 %LE %LONG 0x4c000000;
  D.S SD:0x102390c8 %LE %LONG 0xfc3f0fc3;
  D.S SD:0x102390cc %LE %LONG 0xbc3f0fc3;
  D.S SD:0x102390d0 %LE %LONG 0x02208822;
  D.S SD:0x102390d4 %LE %LONG 0x02208822;
  D.S SD:0x102390dc %LE %LONG 0x00000008;
  D.S SD:0x10239060 %LE %LONG 0x1e031e03;
  D.S SD:0x10239064 %LE %LONG 0x00001e03;
  D.S SD:0x102390c4 %LE %LONG 0x80380001;
  D.S SD:0x10238e90 %LE %LONG 0x3f30210f;
  D.S SD:0x1023908c %LE %LONG 0x70777777;
  D.S SD:0x10239090 %LE %LONG 0x00007777;
  D.S SD:0x102390a4 %LE %LONG 0x00008503;
  D.S SD:0x102390a0 %LE %LONG 0x00608020;
  D.S SD:0x102390f8 %LE %LONG 0x02000151;
  D.S SD:0x1023910c %LE %LONG 0x00000222;
  D.S SD:0x10238f20 %LE %LONG 0x00000000;
  D.S SD:0x10238fa0 %LE %LONG 0x00000000;
  D.S SD:0x10238f04 %LE %LONG 0x35008000;
  D.S SD:0x10238f84 %LE %LONG 0x35008000;
  D.S SD:0x102390ec %LE %LONG 0x00000001;
  D.S SD:0x102390b8 %LE %LONG 0x00080808;
  D.S SD:0x102390fc %LE %LONG 0x01000148;
  D.S SD:0x1023168c %LE %LONG 0x00000030;
  D.S SD:0x102390a8 %LE %LONG 0x20000001;
  D.S SD:0x10238b60 %LE %LONG 0x00000002;
  D.S SD:0x10238a2c %LE %LONG 0x0018000a;
  D.S SD:0x10238aac %LE %LONG 0x0018000a;
  D.S SD:0x10238a30 %LE %LONG 0x00000000;
  D.S SD:0x10238ab0 %LE %LONG 0x00000000;
  D.S SD:0x10238a24 %LE %LONG 0x00000a18;
  D.S SD:0x10238aa4 %LE %LONG 0x00000a18;
  D.S SD:0x10238a28 %LE %LONG 0x0e000a18;
  D.S SD:0x10238aa8 %LE %LONG 0x0e000a18;
  D.S SD:0x10238de0 %LE %LONG 0x00000002;
  D.S SD:0x10238cac %LE %LONG 0x0018000a;
  D.S SD:0x10238d2c %LE %LONG 0x0018000a;
  D.S SD:0x10238cb0 %LE %LONG 0x00000000;
  D.S SD:0x10238d30 %LE %LONG 0x00000000;
  D.S SD:0x10238ca4 %LE %LONG 0x00000a18;
  D.S SD:0x10238d24 %LE %LONG 0x00000a18;
  D.S SD:0x10238ca8 %LE %LONG 0x0e000a18;
  D.S SD:0x10238d28 %LE %LONG 0x0e000a18;
  D.S SD:0x10238b68 %LE %LONG 0x0000bfe0;
  D.S SD:0x10238de8 %LE %LONG 0x0000bfe0;
  D.S SD:0x102316c8 %LE %LONG 0x01101133;
  D.S SD:0x102316ac %LE %LONG 0x80000122;
  D.S SD:0x102316a8 %LE %LONG 0x00000000;
  D.S SD:0x10231698 %LE %LONG 0x00000000;
  D.S SD:0x10231610 %LE %LONG 0x80425080;
  D.S SD:0x102316e8 %LE %LONG 0x02000000;
  
  D.S SD:0x10231200 %LE %LONG 0x11001111;
  D.S SD:0x10231204 %LE %LONG 0x11001111;
  D.S SD:0x10231208 %LE %LONG 0x11771122;
  D.S SD:0x1023120c %LE %LONG 0x11771122;
  
  D.S SD:0x10231280 %LE %LONG 0x11001111;
  D.S SD:0x10231284 %LE %LONG 0x11661111;
  D.S SD:0x10238a20 %LE %LONG 0x00101000;
  D.S SD:0x10238aa0 %LE %LONG 0x00101000;
  D.S SD:0x10231210 %LE %LONG 0x00100010;
  D.S SD:0x1023121c %LE %LONG 0x00100010;
  D.S SD:0x10231214 %LE %LONG 0x00100010;
  D.S SD:0x10231220 %LE %LONG 0x00100010;
  D.S SD:0x10231224 %LE %LONG 0x10101010;
  D.S SD:0x102389e0 %LE %LONG 0x00000000;
  D.S SD:0x102389e4 %LE %LONG 0x00000000;
  D.S SD:0x102389ec %LE %LONG 0x00000000;
  D.S SD:0x10238a60 %LE %LONG 0x00000000;
  D.S SD:0x10238a64 %LE %LONG 0x00000000;
  D.S SD:0x10238a6c %LE %LONG 0x00000000;
  D.S SD:0x102389e8 %LE %LONG 0x00000000;
  D.S SD:0x10238a68 %LE %LONG 0x00000000;
  D.S SD:0x10231234 %LE %LONG 0x00000022;
  D.S SD:0x102389a0 %LE %LONG 0x00000000;
  D.S SD:0x10238a20 %LE %LONG 0x00101000;
  D.S SD:0x10238aa0 %LE %LONG 0x00101000;
  
  D.S SD:0x10231400 %LE %LONG 0x11111111;
  D.S SD:0x10231404 %LE %LONG 0x11111111;
  D.S SD:0x10231408 %LE %LONG 0x11001133;
  D.S SD:0x1023140c %LE %LONG 0x11001133;
  
  D.S SD:0x10231400 %LE %LONG 0x11001111;
  D.S SD:0x10231404 %LE %LONG 0x11001111;
  D.S SD:0x10231408 %LE %LONG 0x11771122;
  D.S SD:0x1023140c %LE %LONG 0x11771122;
  
  D.S SD:0x10231480 %LE %LONG 0x11001111;
  D.S SD:0x10231484 %LE %LONG 0x11661111;
  D.S SD:0x10238ca0 %LE %LONG 0x00101000;
  D.S SD:0x10238d20 %LE %LONG 0x00101000;
  D.S SD:0x10231410 %LE %LONG 0x00100010;
  D.S SD:0x1023141c %LE %LONG 0x00100010;
  D.S SD:0x10231414 %LE %LONG 0x00100010;
  D.S SD:0x10231420 %LE %LONG 0x00100010;
  D.S SD:0x10231424 %LE %LONG 0x10101010;
  D.S SD:0x10238c60 %LE %LONG 0x00000000;
  D.S SD:0x10238c64 %LE %LONG 0x00000000;
  D.S SD:0x10238c6c %LE %LONG 0x00000000;
  D.S SD:0x10238ce0 %LE %LONG 0x00000000;
  D.S SD:0x10238ce4 %LE %LONG 0x00000000;
  D.S SD:0x10238cec %LE %LONG 0x00000000;
  D.S SD:0x10238c68 %LE %LONG 0x00000000;
  D.S SD:0x10238ce8 %LE %LONG 0x00000000;
  D.S SD:0x10231434 %LE %LONG 0x00000022;
  D.S SD:0x10238c20 %LE %LONG 0x00000000;
  D.S SD:0x10238ca0 %LE %LONG 0x00101000;
  D.S SD:0x10238d20 %LE %LONG 0x00101000;
  D.S SD:0x10231610 %LE %LONG 0x80425080;
  D.S SD:0x10231684 %LE %LONG 0x00000200;
  D.S SD:0x10231604 %LE %LONG 0x40001411;
  D.S SD:0x10231674 %LE %LONG 0x80000036;
  D.S SD:0x10231610 %LE %LONG 0xa0425080;
  D.S SD:0x102316a0 %LE %LONG 0x000a10bf;
  D.S SD:0x10231680 %LE %LONG 0x00000000;
  D.S SD:0x10231600 %LE %LONG 0x00000012;
  D.S SD:0x1023160c %LE %LONG 0x00000000;
  D.S SD:0x10231688 %LE %LONG 0x18000220;
  D.S SD:0x10239098 %LE %LONG 0x03019800;
  D.S SD:0x10239108 %LE %LONG 0x00000002;
  D.S SD:0x10239108 %LE %LONG 0x00000052;
  D.S SD:0x102390bc %LE %LONG 0x00000020;
  D.S SD:0x10239094 %LE %LONG 0x00005300;
  D.S SD:0x1023910c %LE %LONG 0x00000222;
  D.S SD:0x10239094 %LE %LONG 0x00005310;
  D.S SD:0x102390a0 %LE %LONG 0x00608020;
  D.S SD:0x102316a4 %LE %LONG 0x00070001;
  D.S SD:0x10238b64 %LE %LONG 0x00000000;
  D.S SD:0x10238de4 %LE %LONG 0x00000000;
  D.S SD:0x102390ac %LE %LONG 0x000d0419;
  D.S SD:0x102390b0 %LE %LONG 0x00000000;
  D.S SD:0x10239128 %LE %LONG 0x00000001;
  D.S SD:0x10231460 %LE %LONG 0x00000000;
  D.S SD:0x10231700 %LE %LONG 0x00002204;
  D.S SD:0x10238f04 %LE %LONG 0x35008000;
  D.S SD:0x10238f84 %LE %LONG 0x35008000;
  D.S SD:0x10239004 %LE %LONG 0x00000000;
  D.S SD:0x10231688 %LE %LONG 0x18000220;
  D.S SD:0x10239120 %LE %LONG 0x00430400;
  D.S SD:0x10239100 %LE %LONG 0x00000001;
  D.S SD:0x1023163c %LE %LONG 0x0008000d;
  D.S SD:0x10231640 %LE %LONG 0x3600000d;
  D.S SD:0x10231638 %LE %LONG 0x00120002;
  D.S SD:0x102316b0 %LE %LONG 0x00000000;
  D.S SD:0x102316b4 %LE %LONG 0x00000000;
  D.S SD:0x102316b8 %LE %LONG 0x00000000;
  D.S SD:0x1023909c %LE %LONG 0x004303c1;
;line 30501, END
;line 30504, DPI_DRAM_INIT_entry
;broadcast_on();
  D.S SD:0x100010B4 %LE %LONG 0x0000007f;
  D.S SD:0x102301fc %LE %LONG 0xc01f0029;
  D.S SD:0x102301fc %LE %LONG 0x801f0029;
  D.S SD:0x102301fc %LE %LONG 0x801f0069;
  D.S SD:0x10230204 %LE %LONG 0x81504c40;
  D.S SD:0x102301fc %LE %LONG 0x801f1069;
  D.S SD:0x102301fc %LE %LONG 0x801f3069;
  D.S SD:0x10230204 %LE %LONG 0x81504c40;
  D.S SD:0x10230128 %LE %LONG 0x00000000;
  D.S SD:0x10230124 %LE %LONG 0x00010000;
  D.S SD:0x10230124 %LE %LONG 0x00000000;
  D.S SD:0x10230124 %LE %LONG 0x00020000;
  D.S SD:0x10230124 %LE %LONG 0x00000000;
  D.S SD:0x10230124 %LE %LONG 0x00000000;
  D.S SD:0x10230128 %LE %LONG 0x00000000;
  D.S SD:0x102301fc %LE %LONG 0x801f0069;
  D.S SD:0x10230204 %LE %LONG 0x81504c40;
  D.S SD:0x10230128 %LE %LONG 0x00000d98;
  D.S SD:0x10230124 %LE %LONG 0x00000000;
  D.S SD:0x10230124 %LE %LONG 0x00000800;
  D.S SD:0x10230124 %LE %LONG 0x00000000;
  D.S SD:0x10230128 %LE %LONG 0x00000d90;
  D.S SD:0x10230124 %LE %LONG 0x00000000;
  D.S SD:0x10230124 %LE %LONG 0x00000800;
  D.S SD:0x10230124 %LE %LONG 0x00000000;
  D.S SD:0x10230128 %LE %LONG 0x00000156;
  D.S SD:0x10230124 %LE %LONG 0x00000000;
  D.S SD:0x10230124 %LE %LONG 0x00000800;
  D.S SD:0x10230124 %LE %LONG 0x00000000;
  D.S SD:0x10230128 %LE %LONG 0x00000212;
  D.S SD:0x10230124 %LE %LONG 0x00000000;
  D.S SD:0x10230124 %LE %LONG 0x00000800;
  D.S SD:0x10230124 %LE %LONG 0x00000000;
  D.S SD:0x10230128 %LE %LONG 0x00000328;
  D.S SD:0x10230124 %LE %LONG 0x00000000;
  D.S SD:0x10230124 %LE %LONG 0x00000800;
  D.S SD:0x10230124 %LE %LONG 0x00000000;
  D.S SD:0x10230128 %LE %LONG 0x00000b00;
  D.S SD:0x10230124 %LE %LONG 0x00000000;
  D.S SD:0x10230124 %LE %LONG 0x00000800;
  D.S SD:0x10230124 %LE %LONG 0x00000000;
  D.S SD:0x10230128 %LE %LONG 0x00000c5d;
  D.S SD:0x10230124 %LE %LONG 0x00000000;
  D.S SD:0x10230124 %LE %LONG 0x00000800;
  D.S SD:0x10230124 %LE %LONG 0x00000000;
  D.S SD:0x10230128 %LE %LONG 0x00000e5d;
  D.S SD:0x10230124 %LE %LONG 0x00000000;
  D.S SD:0x10230124 %LE %LONG 0x00000800;
  D.S SD:0x10230124 %LE %LONG 0x00000000;
  D.S SD:0x10230128 %LE %LONG 0x00000d58;
  D.S SD:0x10230124 %LE %LONG 0x00000000;
  D.S SD:0x10230124 %LE %LONG 0x00000800;
  D.S SD:0x10230124 %LE %LONG 0x00000000;
  D.S SD:0x10230128 %LE %LONG 0x00000d50;
  D.S SD:0x10230124 %LE %LONG 0x00000000;
  D.S SD:0x10230124 %LE %LONG 0x00000800;
  D.S SD:0x10230124 %LE %LONG 0x00000000;
  D.S SD:0x10230128 %LE %LONG 0x00000156;
  D.S SD:0x10230124 %LE %LONG 0x00000000;
  D.S SD:0x10230124 %LE %LONG 0x00000800;
  D.S SD:0x10230124 %LE %LONG 0x00000000;
  D.S SD:0x10230128 %LE %LONG 0x00000212;
  D.S SD:0x10230124 %LE %LONG 0x00000000;
  D.S SD:0x10230124 %LE %LONG 0x00000800;
  D.S SD:0x10230124 %LE %LONG 0x00000000;
  D.S SD:0x10230128 %LE %LONG 0x000003ea;
  D.S SD:0x10230124 %LE %LONG 0x00000000;
  D.S SD:0x10230124 %LE %LONG 0x00000800;
  D.S SD:0x10230124 %LE %LONG 0x00000000;
  D.S SD:0x10230128 %LE %LONG 0x00000b04;
  D.S SD:0x10230124 %LE %LONG 0x00000000;
  D.S SD:0x10230124 %LE %LONG 0x00000800;
  D.S SD:0x10230124 %LE %LONG 0x00000000;
  D.S SD:0x10230128 %LE %LONG 0x00000c5d;
  D.S SD:0x10230124 %LE %LONG 0x00000000;
  D.S SD:0x10230124 %LE %LONG 0x00000800;
  D.S SD:0x10230124 %LE %LONG 0x00000000;
  D.S SD:0x10230128 %LE %LONG 0x00000e18;
  D.S SD:0x10230124 %LE %LONG 0x00000000;
  D.S SD:0x10230124 %LE %LONG 0x00000800;
  D.S SD:0x10230124 %LE %LONG 0x00000000;
  D.S SD:0x10230128 %LE %LONG 0x00000d18;
  D.S SD:0x10230124 %LE %LONG 0x00000000;
  D.S SD:0x10230124 %LE %LONG 0x00000800;
  D.S SD:0x10230124 %LE %LONG 0x00000000;
  D.S SD:0x10230128 %LE %LONG 0x00000d10;
  D.S SD:0x10230124 %LE %LONG 0x00000000;
  D.S SD:0x10230124 %LE %LONG 0x00000800;
  D.S SD:0x10230124 %LE %LONG 0x00000000;
  D.S SD:0x10230204 %LE %LONG 0x81504c00;
  D.S SD:0x10230204 %LE %LONG 0x81504c10;
  D.S SD:0x102301fc %LE %LONG 0x801f1069;
  D.S SD:0x102301fc %LE %LONG 0x801f3069;
  D.S SD:0x10230204 %LE %LONG 0x81504c10;
  D.S SD:0x10230128 %LE %LONG 0x40000d10;
  D.S SD:0x10230124 %LE %LONG 0x00010000;
  D.S SD:0x10230124 %LE %LONG 0x00000000;
  D.S SD:0x10230124 %LE %LONG 0x00020000;
  D.S SD:0x10230124 %LE %LONG 0x00000000;
  D.S SD:0x10230124 %LE %LONG 0x00000000;
  D.S SD:0x10230128 %LE %LONG 0x00000d10;
  D.S SD:0x102301fc %LE %LONG 0x801f0069;
  D.S SD:0x10230204 %LE %LONG 0x81504c10;
  D.S SD:0x10230128 %LE %LONG 0x01000d98;
  D.S SD:0x10230124 %LE %LONG 0x00000000;
  D.S SD:0x10230124 %LE %LONG 0x00000800;
  D.S SD:0x10230124 %LE %LONG 0x00000000;
  D.S SD:0x10230128 %LE %LONG 0x01000d90;
  D.S SD:0x10230124 %LE %LONG 0x00000000;
  D.S SD:0x10230124 %LE %LONG 0x00000800;
  D.S SD:0x10230124 %LE %LONG 0x00000000;
  D.S SD:0x10230128 %LE %LONG 0x01000156;
  D.S SD:0x10230124 %LE %LONG 0x00000000;
  D.S SD:0x10230124 %LE %LONG 0x00000800;
  D.S SD:0x10230124 %LE %LONG 0x00000000;
  D.S SD:0x10230128 %LE %LONG 0x01000212;
  D.S SD:0x10230124 %LE %LONG 0x00000000;
  D.S SD:0x10230124 %LE %LONG 0x00000800;
  D.S SD:0x10230124 %LE %LONG 0x00000000;
  D.S SD:0x10230128 %LE %LONG 0x01000328;
  D.S SD:0x10230124 %LE %LONG 0x00000000;
  D.S SD:0x10230124 %LE %LONG 0x00000800;
  D.S SD:0x10230124 %LE %LONG 0x00000000;
  D.S SD:0x10230128 %LE %LONG 0x01000b00;
  D.S SD:0x10230124 %LE %LONG 0x00000000;
  D.S SD:0x10230124 %LE %LONG 0x00000800;
  D.S SD:0x10230124 %LE %LONG 0x00000000;
  D.S SD:0x10230128 %LE %LONG 0x01000c5d;
  D.S SD:0x10230124 %LE %LONG 0x00000000;
  D.S SD:0x10230124 %LE %LONG 0x00000800;
  D.S SD:0x10230124 %LE %LONG 0x00000000;
  D.S SD:0x10230128 %LE %LONG 0x01000e5d;
  D.S SD:0x10230124 %LE %LONG 0x00000000;
  D.S SD:0x10230124 %LE %LONG 0x00000800;
  D.S SD:0x10230124 %LE %LONG 0x00000000;
  D.S SD:0x10230128 %LE %LONG 0x01000d58;
  D.S SD:0x10230124 %LE %LONG 0x00000000;
  D.S SD:0x10230124 %LE %LONG 0x00000800;
  D.S SD:0x10230124 %LE %LONG 0x00000000;
  D.S SD:0x10230128 %LE %LONG 0x01000d50;
  D.S SD:0x10230124 %LE %LONG 0x00000000;
  D.S SD:0x10230124 %LE %LONG 0x00000800;
  D.S SD:0x10230124 %LE %LONG 0x00000000;
  D.S SD:0x10230128 %LE %LONG 0x01000156;
  D.S SD:0x10230124 %LE %LONG 0x00000000;
  D.S SD:0x10230124 %LE %LONG 0x00000800;
  D.S SD:0x10230124 %LE %LONG 0x00000000;
  D.S SD:0x10230128 %LE %LONG 0x01000212;
  D.S SD:0x10230124 %LE %LONG 0x00000000;
  D.S SD:0x10230124 %LE %LONG 0x00000800;
  D.S SD:0x10230124 %LE %LONG 0x00000000;
  D.S SD:0x10230128 %LE %LONG 0x010003ea;
  D.S SD:0x10230124 %LE %LONG 0x00000000;
  D.S SD:0x10230124 %LE %LONG 0x00000800;
  D.S SD:0x10230124 %LE %LONG 0x00000000;
  D.S SD:0x10230128 %LE %LONG 0x01000b04;
  D.S SD:0x10230124 %LE %LONG 0x00000000;
  D.S SD:0x10230124 %LE %LONG 0x00000800;
  D.S SD:0x10230124 %LE %LONG 0x00000000;
  D.S SD:0x10230128 %LE %LONG 0x01000c5d;
  D.S SD:0x10230124 %LE %LONG 0x00000000;
  D.S SD:0x10230124 %LE %LONG 0x00000800;
  D.S SD:0x10230124 %LE %LONG 0x00000000;
  D.S SD:0x10230128 %LE %LONG 0x01000e18;
  D.S SD:0x10230124 %LE %LONG 0x00000000;
  D.S SD:0x10230124 %LE %LONG 0x00000800;
  D.S SD:0x10230124 %LE %LONG 0x00000000;
  D.S SD:0x10230128 %LE %LONG 0x01000d18;
  D.S SD:0x10230124 %LE %LONG 0x00000000;
  D.S SD:0x10230124 %LE %LONG 0x00000800;
  D.S SD:0x10230124 %LE %LONG 0x00000000;
  D.S SD:0x10230128 %LE %LONG 0x01000d10;
  D.S SD:0x10230124 %LE %LONG 0x00000000;
  D.S SD:0x10230124 %LE %LONG 0x00000800;
  D.S SD:0x10230124 %LE %LONG 0x00000000;
  D.S SD:0x10230204 %LE %LONG 0x81504c00;
  D.S SD:0x1023056c %LE %LONG 0x00000000;
  D.S SD:0x1023076c %LE %LONG 0x00000000;
  D.S SD:0x102301fc %LE %LONG 0x801f0029;
  D.S SD:0x102301fc %LE %LONG 0xc01f0029;
  D.S SD:0x102301fc %LE %LONG 0xc01f002b;
;broadcast_off();
  D.S SD:0x100010B4 %LE %LONG 0x00000000;
  D.S SD:0x10238898 %LE %LONG 0x00f0500a;
  D.S SD:0x10238898 %LE %LONG 0x00f0500a;
  D.S SD:0x10238898 %LE %LONG 0x00f0500b;
  D.S SD:0x10238898 %LE %LONG 0x00f0500a;
  D.S SD:0x10238898 %LE %LONG 0x00f05008;
  D.S SD:0x10238898 %LE %LONG 0x00f05008;
  D.S SD:0x10248898 %LE %LONG 0x00f0500a;
  D.S SD:0x10248898 %LE %LONG 0x00f0500a;
  D.S SD:0x10248898 %LE %LONG 0x00f0500b;
  D.S SD:0x10248898 %LE %LONG 0x00f0500a;
  D.S SD:0x10248898 %LE %LONG 0x00f05008;
  D.S SD:0x10248898 %LE %LONG 0x00f05008;
;broadcast_on();
  D.S SD:0x100010B4 %LE %LONG 0x0000007f;
  D.S SD:0x10947030 %LE %LONG 0x00000001;
  D.S SD:0x10947004 %LE %LONG 0x00400554;
  D.S SD:0x10947004 %LE %LONG 0x00400554;
  D.S SD:0x10947004 %LE %LONG 0x00400554;
  D.S SD:0x10947004 %LE %LONG 0x00400554;
  D.S SD:0x10947004 %LE %LONG 0x00400554;
  D.S SD:0x10947004 %LE %LONG 0x00400554;
  D.S SD:0x10947038 %LE %LONG 0x00000015;
  D.S SD:0x10947038 %LE %LONG 0x00000015;
  D.S SD:0x10947038 %LE %LONG 0x00000015;
  D.S SD:0x10947008 %LE %LONG 0x00000400;
  D.S SD:0x10947000 %LE %LONG 0x44c00b1d;
  D.S SD:0x10947000 %LE %LONG 0x44c00b15;
  D.S SD:0x10947008 %LE %LONG 0x00000000;
  D.S SD:0x109472c0 %LE %LONG 0x03ffffe0;
  D.S SD:0x109472c0 %LE %LONG 0x03ffffc0;
  D.S SD:0x109472c0 %LE %LONG 0x03ffff80;
  D.S SD:0x109472c0 %LE %LONG 0x03ffff00;
  D.S SD:0x109472c0 %LE %LONG 0x03fffe00;
  D.S SD:0x109472c0 %LE %LONG 0x03fffc00;
  D.S SD:0x109472c0 %LE %LONG 0x03fff800;
  D.S SD:0x109472c0 %LE %LONG 0x03fff000;
  D.S SD:0x109472c0 %LE %LONG 0x03ffe000;
  D.S SD:0x109472c0 %LE %LONG 0x03ffc000;
  D.S SD:0x109472c0 %LE %LONG 0x03ff8000;
  D.S SD:0x109472c0 %LE %LONG 0x03ff0000;
  D.S SD:0x109472c0 %LE %LONG 0x03fe0000;
  D.S SD:0x109472c0 %LE %LONG 0x03fc0000;
  D.S SD:0x109472c0 %LE %LONG 0x03f80000;
  D.S SD:0x109472c0 %LE %LONG 0x03f80000;
  D.S SD:0x109472c0 %LE %LONG 0x03f80000;
  D.S SD:0x109472c0 %LE %LONG 0x03f80000;
  D.S SD:0x109472c0 %LE %LONG 0x03b80000;
  D.S SD:0x109472c0 %LE %LONG 0x03380000;
  D.S SD:0x109472c0 %LE %LONG 0x02380000;
  D.S SD:0x109472c0 %LE %LONG 0x02380000;
  D.S SD:0x10947280 %LE %LONG 0x00008000;
  D.S SD:0x109472d8 %LE %LONG 0x0000703c;
  D.S SD:0x109472d8 %LE %LONG 0x0000703c;
  D.S SD:0x109472d8 %LE %LONG 0x0000703c;
  D.S SD:0x109472d8 %LE %LONG 0x0000703c;
  D.S SD:0x109472d8 %LE %LONG 0x0000703c;
  D.S SD:0x109472d8 %LE %LONG 0x0000703c;
  D.S SD:0x109472d8 %LE %LONG 0x0000703c;
  D.S SD:0x10947064 %LE %LONG 0x00000b44;
  D.S SD:0x109472c0 %LE %LONG 0x02380004;
  D.S SD:0x10947048 %LE %LONG 0x34040221;
  D.S SD:0x109472f4 %LE %LONG 0x00000001;
  D.S SD:0x10947034 %LE %LONG 0x000300ce;
  D.S SD:0x10947034 %LE %LONG 0x000310ce;
  D.S SD:0x10947034 %LE %LONG 0x000310ce;
  D.S SD:0x10947034 %LE %LONG 0x000300ce;
  D.S SD:0x10947030 %LE %LONG 0x00000001;
  D.S SD:0x10947028 %LE %LONG 0x00010000;
  D.S SD:0x10947028 %LE %LONG 0x00010000;
  D.S SD:0x10947004 %LE %LONG 0x00400554;
  D.S SD:0x10947038 %LE %LONG 0x00000015;
  D.S SD:0x10947054 %LE %LONG 0x0f206438;
  D.S SD:0x10A47030 %LE %LONG 0x00000001;
  D.S SD:0x10A47004 %LE %LONG 0x00400554;
  D.S SD:0x10A47004 %LE %LONG 0x00400554;
  D.S SD:0x10A47004 %LE %LONG 0x00400554;
  D.S SD:0x10A47004 %LE %LONG 0x00400554;
  D.S SD:0x10A47004 %LE %LONG 0x00400554;
  D.S SD:0x10A47004 %LE %LONG 0x00400554;
  D.S SD:0x10A47038 %LE %LONG 0x00000015;
  D.S SD:0x10A47038 %LE %LONG 0x00000015;
  D.S SD:0x10A47038 %LE %LONG 0x00000015;
  D.S SD:0x10A47008 %LE %LONG 0x00000400;
  D.S SD:0x10A47000 %LE %LONG 0x44c00b1d;
  D.S SD:0x10A47000 %LE %LONG 0x44c00b15;
  D.S SD:0x10A47008 %LE %LONG 0x00000000;
  D.S SD:0x10A472c0 %LE %LONG 0x03ffffe0;
  D.S SD:0x10A472c0 %LE %LONG 0x03ffffc0;
  D.S SD:0x10A472c0 %LE %LONG 0x03ffff80;
  D.S SD:0x10A472c0 %LE %LONG 0x03ffff00;
  D.S SD:0x10A472c0 %LE %LONG 0x03fffe00;
  D.S SD:0x10A472c0 %LE %LONG 0x03fffc00;
  D.S SD:0x10A472c0 %LE %LONG 0x03fff800;
  D.S SD:0x10A472c0 %LE %LONG 0x03fff000;
  D.S SD:0x10A472c0 %LE %LONG 0x03ffe000;
  D.S SD:0x10A472c0 %LE %LONG 0x03ffc000;
  D.S SD:0x10A472c0 %LE %LONG 0x03ff8000;
  D.S SD:0x10A472c0 %LE %LONG 0x03ff0000;
  D.S SD:0x10A472c0 %LE %LONG 0x03fe0000;
  D.S SD:0x10A472c0 %LE %LONG 0x03fc0000;
  D.S SD:0x10A472c0 %LE %LONG 0x03f80000;
  D.S SD:0x10A472c0 %LE %LONG 0x03f80000;
  D.S SD:0x10A472c0 %LE %LONG 0x03f80000;
  D.S SD:0x10A472c0 %LE %LONG 0x03f80000;
  D.S SD:0x10A472c0 %LE %LONG 0x03b80000;
  D.S SD:0x10A472c0 %LE %LONG 0x03380000;
  D.S SD:0x10A472c0 %LE %LONG 0x02380000;
  D.S SD:0x10A472c0 %LE %LONG 0x02380000;
  D.S SD:0x10A47280 %LE %LONG 0x00008000;
  D.S SD:0x10A472d8 %LE %LONG 0x0000703c;
  D.S SD:0x10A472d8 %LE %LONG 0x0000703c;
  D.S SD:0x10A472d8 %LE %LONG 0x0000703c;
  D.S SD:0x10A472d8 %LE %LONG 0x0000703c;
  D.S SD:0x10A472d8 %LE %LONG 0x0000703c;
  D.S SD:0x10A472d8 %LE %LONG 0x0000703c;
  D.S SD:0x10A472d8 %LE %LONG 0x0000703c;
  D.S SD:0x10A47064 %LE %LONG 0x00000b44;
  D.S SD:0x10A472c0 %LE %LONG 0x02380004;
  D.S SD:0x10A47048 %LE %LONG 0x34040221;
  D.S SD:0x10A472f4 %LE %LONG 0x00000001;
  D.S SD:0x10A47034 %LE %LONG 0x000300ce;
  D.S SD:0x10A47034 %LE %LONG 0x000310ce;
  D.S SD:0x10A47034 %LE %LONG 0x000310ce;
  D.S SD:0x10A47034 %LE %LONG 0x000300ce;
  D.S SD:0x10A47030 %LE %LONG 0x00000001;
  D.S SD:0x10A47028 %LE %LONG 0x00010000;
  D.S SD:0x10A47028 %LE %LONG 0x00010000;
  D.S SD:0x10947004 %LE %LONG 0x00400554;
  D.S SD:0x10947038 %LE %LONG 0x00000015;
  D.S SD:0x10947054 %LE %LONG 0x0f206438;
;line 53949, END
;line 53950, DPI_ESL_DPHY_FPGA_TX_entry
;line 53951, END
;line 53952, DPI_ESL_DPHY_FPGA_RX_entry
  D.S SD:0x10239094 %LE %LONG 0x00004310;
  D.S SD:0x10239094 %LE %LONG 0x00004310;
;line 54029, END
;line 54030, md32_lpif_cfg_MR_set4MD32
  D.S SD:0x10947180 %LE %LONG 0x00000056;
  D.S SD:0x10947180 %LE %LONG 0x00001256;
  D.S SD:0x10947180 %LE %LONG 0x00291256;
  D.S SD:0x10947180 %LE %LONG 0x00291256;
  D.S SD:0x10947184 %LE %LONG 0x00000000;
  D.S SD:0x10A47180 %LE %LONG 0x00000056;
  D.S SD:0x10A47180 %LE %LONG 0x00001256;
  D.S SD:0x10A47180 %LE %LONG 0x00291256;
  D.S SD:0x10A47180 %LE %LONG 0x00291256;
  D.S SD:0x10A47184 %LE %LONG 0x00000000;
;line 54151, END
;line 54152, SHUF_indiv_rand_reg_settings_vseq
  D.S SD:0x102316d8 %LE %LONG 0x00000001;
  D.S SD:0x1023024c %LE %LONG 0x360a2810;
;broadcast_off();
  D.S SD:0x100010B4 %LE %LONG 0x00000000;
;broadcast_on();
  D.S SD:0x100010B4 %LE %LONG 0x0000007f;
  D.S SD:0x1023024c %LE %LONG 0x340a2810;
  D.S SD:0x10238898 %LE %LONG 0x10f05008;
  D.S SD:0x1023889c %LE %LONG 0x2e11ffff;
  D.S SD:0x10231dd8 %LE %LONG 0x00000001;
  D.S SD:0x10238898 %LE %LONG 0x00f05008;
  D.S SD:0x1023889c %LE %LONG 0x2e01ffff;
;line 54418, END
;line 54420, DPI_POST_DCM_setting_entry
;broadcast_off();
  D.S SD:0x100010B4 %LE %LONG 0x00000000;
  D.S SD:0x102301a4 %LE %LONG 0x10000100;
  D.S SD:0x102386c4 %LE %LONG 0x241a5c28;
  D.S SD:0x102386ac %LE %LONG 0x02000b50;
  D.S SD:0x102386ac %LE %LONG 0x02000b50;
  D.S SD:0x102401a4 %LE %LONG 0x10000100;
  D.S SD:0x102486c4 %LE %LONG 0x241a9c28;
  D.S SD:0x102486ac %LE %LONG 0x02000b50;
  D.S SD:0x102486ac %LE %LONG 0x02000b50;
;broadcast_on();
  D.S SD:0x100010B4 %LE %LONG 0x0000007f;
  D.S SD:0x1023866c %LE %LONG 0x20000190;
  D.S SD:0x10238674 %LE %LONG 0x00600baf;
  D.S SD:0x1023867c %LE %LONG 0x7fffffff;
  D.S SD:0x10238680 %LE %LONG 0x70770000;
  D.S SD:0x102387a4 %LE %LONG 0x00000028;
  D.S SD:0x102387c4 %LE %LONG 0x11001100;
  D.S SD:0x102387c8 %LE %LONG 0x000001ff;
  D.S SD:0x102387e8 %LE %LONG 0x00000008;
  D.S SD:0x10238840 %LE %LONG 0x00000208;
  D.S SD:0x10238854 %LE %LONG 0x4be003bf;
  D.S SD:0x10238858 %LE %LONG 0x00000000;
  D.S SD:0x1023885c %LE %LONG 0x00000000;
  D.S SD:0x10230000 %LE %LONG 0x00080120;
  D.S SD:0x10230110 %LE %LONG 0x29028010;
  D.S SD:0x10230168 %LE %LONG 0x00588780;
  D.S SD:0x10230190 %LE %LONG 0x0020004d;
  D.S SD:0x102301fc %LE %LONG 0xc0000007;
  D.S SD:0x10230200 %LE %LONG 0x00020600;
  D.S SD:0x10230208 %LE %LONG 0x00100680;
  D.S SD:0x1023021c %LE %LONG 0x00000100;
  D.S SD:0x1023023c %LE %LONG 0x18000000;
  D.S SD:0x10230244 %LE %LONG 0x00000000;
  D.S SD:0x10230250 %LE %LONG 0x91084100;
  D.S SD:0x10230260 %LE %LONG 0x01340000;
  D.S SD:0x10230288 %LE %LONG 0x00000000;
  D.S SD:0x10230340 %LE %LONG 0x00000000;
  D.S SD:0x10230240 %LE %LONG 0x7000003e;
  D.S SD:0x10230310 %LE %LONG 0x00003000;
  D.S SD:0x10239120 %LE %LONG 0x00420407;
  D.S SD:0x10239124 %LE %LONG 0x334f3000;
  D.S SD:0x10238f04 %LE %LONG 0x35008000;
  D.S SD:0x10238f84 %LE %LONG 0x35008000;
  D.S SD:0x10239004 %LE %LONG 0x00000000;
  D.S SD:0x10238f08 %LE %LONG 0x0020004a;
  D.S SD:0x10238f88 %LE %LONG 0x0020004a;
  D.S SD:0x10239008 %LE %LONG 0x00200000;
  D.S SD:0x10238e88 %LE %LONG 0x00200000;
  D.S SD:0x102390a8 %LE %LONG 0x20000001;
  D.S SD:0x10239120 %LE %LONG 0x00420427;
  D.S SD:0x10239124 %LE %LONG 0x334f3000;
  D.S SD:0x102316ac %LE %LONG 0x80000122;
;line 56336, END
;line 56395, loggen_phypll_mode_sw
;broadcast_off();
  D.S SD:0x100010B4 %LE %LONG 0x00000000;
  D.S SD:0x10947004 %LE %LONG 0x00400554;
  D.S SD:0x10A47004 %LE %LONG 0x00400554;
  D.S SD:0x10947020 %LE %LONG 0xf0000000;
  D.S SD:0x10A47020 %LE %LONG 0xf0000000;
  D.S SD:0x102386b8 %LE %LONG 0x00100000;
  D.S SD:0x10238000 %LE %LONG 0x00000000;
  D.S SD:0x102486b8 %LE %LONG 0x00100000;
  D.S SD:0x10248000 %LE %LONG 0x00000000;
;broadcast_on();
  D.S SD:0x100010B4 %LE %LONG 0x0000007f;
;line 56612, END
;line 56613, indiv_rand_reg_settings_vseq
  D.S SD:0x10230248 %LE %LONG 0x090e3160;
  D.S SD:0x10230228 %LE %LONG 0x00000000;
  D.S SD:0x1023012c %LE %LONG 0x00000005;
  D.S SD:0x10230254 %LE %LONG 0x00004f03;
  D.S SD:0x1023017c %LE %LONG 0x00000161;
  D.S SD:0x10230108 %LE %LONG 0x12010800;
  D.S SD:0x10230170 %LE %LONG 0x00000006;
  D.S SD:0x10230238 %LE %LONG 0x01400050;
  D.S SD:0x1023024c %LE %LONG 0xb00a2810;
  D.S SD:0x10230190 %LE %LONG 0x0020004d;
  D.S SD:0x10230174 %LE %LONG 0x0000004f;
  D.S SD:0x10230284 %LE %LONG 0x00000003;
  D.S SD:0x10230220 %LE %LONG 0x00000944;
  D.S SD:0x10230178 %LE %LONG 0x00000800;
  D.S SD:0x10230258 %LE %LONG 0x05050080;
  D.S SD:0x10230000 %LE %LONG 0x00080110;
  D.S SD:0x10230234 %LE %LONG 0x00000001;
  D.S SD:0x10230174 %LE %LONG 0x0000004f;
  D.S SD:0x10230168 %LE %LONG 0x00588780;
  D.S SD:0x10230204 %LE %LONG 0x89504c00;
  D.S SD:0x10230240 %LE %LONG 0x7000003e;
  D.S SD:0x102302c0 %LE %LONG 0x00005563;
  D.S SD:0x102302c0 %LE %LONG 0x00005560;
  D.S SD:0x10230268 %LE %LONG 0x3203116d;
  D.S SD:0x1023028c %LE %LONG 0x0000041f;
  D.S SD:0x10230264 %LE %LONG 0x0573300a;
  D.S SD:0x102302e0 %LE %LONG 0x00000000;
  D.S SD:0x10230190 %LE %LONG 0x00200049;
  D.S SD:0x10230310 %LE %LONG 0x00002000;
  D.S SD:0x1023023c %LE %LONG 0x18000000;
  D.S SD:0x1023017c %LE %LONG 0x00000961;
  D.S SD:0x1023020c %LE %LONG 0x0005061a;
  D.S SD:0x102387fc %LE %LONG 0x00000000;
  D.S SD:0x102387fc %LE %LONG 0x00000000;
  D.S SD:0x102387fc %LE %LONG 0x00000000;
  D.S SD:0x10238808 %LE %LONG 0x00000000;
  D.S SD:0x10238814 %LE %LONG 0x00000000;
  D.S SD:0x102387c8 %LE %LONG 0x000001ff;
  D.S SD:0x102387c4 %LE %LONG 0x11001100;
  D.S SD:0x102387b0 %LE %LONG 0x00000001;
  D.S SD:0x102387b4 %LE %LONG 0x00000001;
  D.S SD:0x10238898 %LE %LONG 0x20705000;
  D.S SD:0x10230250 %LE %LONG 0x91084100;
  D.S SD:0x10230364 %LE %LONG 0x00003560;
  D.S SD:0x10230364 %LE %LONG 0x00003560;
  D.S SD:0x10230364 %LE %LONG 0x00003560;
  D.S SD:0x1023038c %LE %LONG 0x000070ae;
  D.S SD:0x10230370 %LE %LONG 0x00002796;
  D.S SD:0x10230374 %LE %LONG 0x00001ce3;
  D.S SD:0x10230378 %LE %LONG 0x00004f2c;
  D.S SD:0x1023037c %LE %LONG 0x000039c6;
  D.S SD:0x10230380 %LE %LONG 0x000018e1;
  D.S SD:0x10230384 %LE %LONG 0x00085447;
  D.S SD:0x10230388 %LE %LONG 0x00008544;
  D.S SD:0x1023024c %LE %LONG 0xb00a2890;
  D.S SD:0x1023024c %LE %LONG 0xb00a28d0;
  D.S SD:0x10238684 %LE %LONG 0x81f90040;
  D.S SD:0x102301c0 %LE %LONG 0x1c000248;
  D.S SD:0x102301a4 %LE %LONG 0x10000100;
  D.S SD:0x102386b8 %LE %LONG 0x00100000;
  D.S SD:0x10238898 %LE %LONG 0x20705000;
  D.S SD:0x1023889c %LE %LONG 0x2e01ffff;
  D.S SD:0x10238684 %LE %LONG 0x05f90040;
  D.S SD:0x10238674 %LE %LONG 0x00600bae;
  D.S SD:0x10238674 %LE %LONG 0x00600baf;
  D.S SD:0x10238690 %LE %LONG 0x38303333;
;broadcast_off();
  D.S SD:0x100010B4 %LE %LONG 0x00000000;
  D.S SD:0x10230208 %LE %LONG 0x00108680;
  D.S SD:0x10230208 %LE %LONG 0x00108e80;
  D.S SD:0x10230208 %LE %LONG 0x00108e80;
  D.S SD:0x10240208 %LE %LONG 0x00108680;
  D.S SD:0x10240208 %LE %LONG 0x00108e80;
  D.S SD:0x10240208 %LE %LONG 0x00108e80;
;broadcast_on();
  D.S SD:0x100010B4 %LE %LONG 0x0000007f;
;broadcast_off();
  D.S SD:0x100010B4 %LE %LONG 0x00000000;
  D.S SD:0x10230208 %LE %LONG 0x00108e80;
  D.S SD:0x10240208 %LE %LONG 0x00108e80;
  D.S SD:0x10230218 %LE %LONG 0x08040f0f;
  D.S SD:0x10240218 %LE %LONG 0x08040f0f;
;broadcast_on();
  D.S SD:0x100010B4 %LE %LONG 0x0000007f;
;broadcast_off();
  D.S SD:0x100010B4 %LE %LONG 0x00000000;
  D.S SD:0x10230208 %LE %LONG 0x00108e80;
  D.S SD:0x10230208 %LE %LONG 0x00108ea0;
  D.S SD:0x10240208 %LE %LONG 0x00108e80;
  D.S SD:0x10240208 %LE %LONG 0x00108ea0;
  D.S SD:0x10230208 %LE %LONG 0x00108ea0;
  D.S SD:0x10240208 %LE %LONG 0x00108ea0;
  D.S SD:0x10230208 %LE %LONG 0x00108ea0;
  D.S SD:0x10240208 %LE %LONG 0x00108ea0;
;broadcast_on();
  D.S SD:0x100010B4 %LE %LONG 0x0000007f;
  D.S SD:0x10943000 %LE %LONG 0x00008fdf;
  D.S SD:0x10943008 %LE %LONG 0xc0000000;
  D.S SD:0x10238690 %LE %LONG 0x38303333;
;broadcast_off();
  D.S SD:0x100010B4 %LE %LONG 0x00000000;
  D.S SD:0x10238694 %LE %LONG 0x02400775;
  D.S SD:0x10238694 %LE %LONG 0x02400775;
  D.S SD:0x10238694 %LE %LONG 0x02400775;
  D.S SD:0x10238694 %LE %LONG 0x0240077d;
  D.S SD:0x10238694 %LE %LONG 0x02c0077d;
  D.S SD:0x10248694 %LE %LONG 0x02400775;
  D.S SD:0x10248694 %LE %LONG 0x02400775;
  D.S SD:0x10248694 %LE %LONG 0x02400775;
  D.S SD:0x10248694 %LE %LONG 0x0240077d;
  D.S SD:0x10248694 %LE %LONG 0x02c0077d;
;broadcast_on();
  D.S SD:0x100010B4 %LE %LONG 0x0000007f;
  D.S SD:0x1023911c %LE %LONG 0x00000000;
;line 60339, END
;line 60351, pinmux_config
;broadcast_off();
  D.S SD:0x100010B4 %LE %LONG 0x00000000;
  D.S SD:0x1023882c %LE %LONG 0xfedcba98;
  D.S SD:0x10238828 %LE %LONG 0x76543210;
  D.S SD:0x10238834 %LE %LONG 0xfedcba98;
  D.S SD:0x10238834 %LE %LONG 0xfedcba98;
  D.S SD:0x10238830 %LE %LONG 0x76543210;
  D.S SD:0x10238830 %LE %LONG 0x76543210;
  D.S SD:0x1024882c %LE %LONG 0xfedcba98;
  D.S SD:0x10248828 %LE %LONG 0x76543210;
  D.S SD:0x10248834 %LE %LONG 0xfedcba98;
  D.S SD:0x10248834 %LE %LONG 0xfedcba98;
  D.S SD:0x10248830 %LE %LONG 0x76543210;
  D.S SD:0x10248830 %LE %LONG 0x76543210;
;line 60702, END


; CHA FPGA Dramc Cal!!!
;Configuration :  
;0x0104) = 0x00000100;    //R_DMTEST2_OFF_ADR
;0x0108) = 0x02000000;     
;0x0100) = 0x0000c0c4;    //R_DMTEST2_PAT0 R_DMTEST2_PAT1
;0x87E4) = 0x00010000;    //use [16] to enable/disable calibration for fpga_cal


;D.S SD:0x10230104 %LE %LONG 0x00000100; data access range
D.S SD:0x10230108 %LE %LONG 0x02000000;
D.S SD:0x10230100 %LE %LONG 0x0000c0c4;
;D.S SD:0x10230108 %LE %LONG 0x12070801;
;D.S SD:0x1023010c %LE %LONG 0x40020000;
;D.S SD:0x1023010c %LE %LONG 0x40000000;
D.S SD:0x102387E4 %LE %LONG 0x51010000; 

;0x1023773C[0] Calibration done //poll bit[0] while (((*((UINT32P)(DDRPHY0AO_NAO_BASE + 0x173c)) & 0x00000001) != 0x00000001))  
 wait 500.ms

 ; CHB FPGA Dramc Cal!!!
 
D.S SD:0x10240104 %LE %LONG 0x00000100;
D.S SD:0x10240108 %LE %LONG 0x02000000;
D.S SD:0x10240100 %LE %LONG 0x0000c0c4;
D.S SD:0x102487E4 %LE %LONG 0x51010000; 

;0x1024773C[0] Calibration done //poll bit[0] while (((*((UINT32P)(DDRPHY1AO_NAO_BASE + 0x173c)) & 0x00000001) != 0x00000001))  
 wait 500.ms


;disable R_DMDQSICALEN
;D.S SD:0x102387E4 %LE %LONG 0x51000000; //use [16] to enable/disable calibration for fpga_cal

; FPGA Dramc Cal Done!!

;Set TA dram test address to initial address (0x40000000)
;D.S SD:0x10230500 %LE %LONG 0x0;
;D.S SD:0x10230700 %LE %LONG 0x0;

; DRAMC TEST AGENT
;Configuration :
;0x108 [3   :0] TESTCNT         = 4'h1 (0 for rank 0 only)
;0x10c [16    ] TESTXTALKPAT    = 1'h1 (pattern)
;0x10c [30 :28] TESTAGENTRKSEL  = 3'h4
;0x104 [31 : 4] TEST2_OFF       = 28'h20( test2 length ) 
;Test1 PASS
;D.S SD:0x10230108 %LE %LONG 0x12000881;
;D.S SD:0x1023010c %LE %LONG 0x40010000;

;Test2 PASS
;D.S SD:0x10230108 %LE %LONG 0x12000881;
;D.S SD:0x1023010c %LE %LONG 0x40210000;

;Test3 FAIL
;D.S SD:0x10230108 %LE %LONG 0x12000881;
;D.S SD:0x1023010c %LE %LONG 0x40230000;

;Test4 PASS
;D.S SD:0x10230108 %LE %LONG 0x12070881;
;D.S SD:0x1023010c %LE %LONG 0x40000000;

;Test5 FAIL write over 128bit
;D.S SD:0x10230108 %LE %LONG 0x12070881;
;D.S SD:0x1023010c %LE %LONG 0x40020000;

;Test6 FAIL
;D.S SD:0x10230104 %LE %LONG 0x0;
;D.S SD:0x10230108 %LE %LONG 0x12070801;
;D.S SD:0x1023010c %LE %LONG 0x40020000; 256bit data access
;D.S SD:0x1023010c %LE %LONG 0x40220000; mask write enable

; Trigger
;0x108 [31] TEST2W (read after write)
;D.S SD:0x10230108 %LE %LONG 0x92070801;

;Test7 PASS
;D.S SD:0x10230108 %LE %LONG 0x12070801;
;D.S SD:0x1023010c %LE %LONG 0x40000000; bit17


; Trigger
;0x108 [31] TEST2W (read after write)
;D.S SD:0x10230108 %LE %LONG 0x92000881;

;Result(dranc_nao) : 0x10234000
;0x120[5] DM_CMP_ERR_RK1 
;0x120[4] DM_CMP_ERR_RK0
;0x120[1] DM_CMP_CPT_RK1
;0x120[0] DM_CMP_CPT_RK0

;DRAMC brocast on
;D.S SD:0x100010B4 %LE %LONG 0x0000007f;
;EMI setting 2
;D.S SD:0x10219060 %LE %LONG 0x00005400;
;D.S SD:0x10235010 %LE %LONG 0x04000005;
;DRAMC brocast off
;D.S SD:0x100010B4 %LE %LONG 0x00000000;